/*
 * =============================================================================
 * Xaloqi EDS
 * boards/native_sim/native_sim_realcan.overlay
 *
 * EDS#231: alternative to native_sim.overlay for connecting a native_sim
 * ECU to a REAL host SocketCAN interface (e.g. vcan0), instead of
 * Zephyr's in-process can_loopback0 device.
 *
 * native_sim.overlay unconditionally maps the `can0` alias (used by
 * examples/*/src/main.c's DEVICE_DT_GET(DT_ALIAS(can0))) to
 * &can_loopback0 -- so simply removing CONFIG_CAN_LOOPBACK from the
 * Kconfig side (see native_sim_realcan.conf) is not enough on its own;
 * the alias itself must be redirected too, to the board's own `can0`
 * devicetree node (compatible "zephyr,native-linux-can", disabled by
 * default -- boards/native/native_sim/native_sim.dts), which this
 * overlay enables.
 *
 * That node defaults to host interface "zcan0". To reach it via a real
 * vcan0 without renaming your interface, add zcan0 as an alternate name
 * (see Zephyr's own snippets/socketcan-native-sim/README.rst):
 *
 *   sudo modprobe vcan
 *   sudo ip link add dev vcan0 type vcan
 *   sudo ip link property add dev vcan0 altname zcan0
 *   sudo ip link set vcan0 up
 *
 * Use together with native_sim_realcan.conf:
 *
 *   west build -b native_sim examples/basic_ecu \
 *     -- -DEXTRA_CONF_FILE=.../native_sim_realcan.conf \
 *        -DDTC_OVERLAY_FILE=.../native_sim_realcan.overlay
 * =============================================================================
 */

/ {
	aliases {
		/* Map the 'can0' alias used in main.c to the REAL native_linux CAN
		 * device (bound to a real host SocketCAN interface), instead of
		 * native_sim.overlay's in-process loopback device. */
		can0 = &can0;
	};
};

&can0 {
	status = "okay";
};
