## CMakeLists.txt
```
# File: examples/basic_ecu/CMakeLists.txt
# =============================================================================
# Xaloqi EDS
# examples/basic_ecu/CMakeLists.txt
#
# PURPOSE: Stand-alone Zephyr build file for the BasicECU example application.
#
#          Can be built either:
#            (a) From the project root CMakeLists.txt (sources pulled in there), OR
#            (b) Directly as a stand-alone Zephyr application:
#                  cd examples/basic_ecu
#                  cmake -B build -DBOARD=<board>
#                  cmake --build build
#
# PHASE 2B CHANGES:
#   - Code generation target renamed to 'run_codegen' (matches root CMake and spec).
#   - FATAL_ERROR on missing Python3 — no silent degradation.
#   - Template glob added as dependency — codegen re-runs if any .j2 changes.
#   - Include and source paths updated for Phase 2A generated files.
#   - Version bumped to 0.3.0.
#
# STAND-ALONE USAGE:
#   cd examples/basic_ecu
#   cmake -B build -DBOARD=native_posix      # simulation target
#   cmake --build build
#   ./build/zephyr/zephyr.exe               # run on host
#
#   # Skip codegen if generated/ files are already present:
#   cmake -B build -DBOARD=<board> -DDIAG_SKIP_CODEGEN=ON
#
#   # Force codegen only:
#   cmake --build build --target run_codegen
#
# SAFETY CONTEXT : Example application — not safety-assessed.
# CODING STANDARD: MISRA C:2012 alignment intended.
# VERSION        : 0.3.0 (Phase 2B)
# SPDX-License-Identifier: Apache-2.0
# =============================================================================

cmake_minimum_required(VERSION 3.20.0)

# [#414] EDS Kconfig comes from this tree, not whichever EDS module the
# workspace has. Must precede find_package(Zephyr).
include(${CMAKE_CURRENT_SOURCE_DIR}/../../cmake/eds_zephyr_module.cmake)

find_package(Zephyr REQUIRED HINTS $ENV{ZEPHYR_BASE})

project(basic_ecu
    VERSION     0.4.0
    LANGUAGES   C
    DESCRIPTION "BasicECU example — Xaloqi EDS"
)

set(CMAKE_C_STANDARD          11)
set(CMAKE_C_STANDARD_REQUIRED ON)
set(CMAKE_C_EXTENSIONS        OFF)

# ---------------------------------------------------------------------------
# Compiler flags (mirrors root CMakeLists.txt for consistency)
# ---------------------------------------------------------------------------
# [#515] -Wundef (MISRA 20.9) below applies to EDS code only: Zephyr, module and
# HAL headers are system includes for this target. See the cmake file.
include(${CMAKE_CURRENT_SOURCE_DIR}/../../cmake/eds_third_party_headers.cmake)
eds_third_party_headers_are_system(app)

target_compile_options(app PRIVATE
    # ── Enabled ───────────────────────────────────────────────────────────
    -Wall                    # standard: most likely bugs
    -Wextra                  # extra checks beyond -Wall
    -Wshadow                 # shadowed variable declarations
    -Wdouble-promotion       # implicit float-to-double (embedded risk)
    -Wundef                  # undefined macro used in #if (MISRA 20.9; EDS code only, see #515)
    -Wno-unused-parameter    # suppress noisy unused-param warnings

    # ── Intentionally removed ──────────────────────────────────────────────

    # -Wpedantic REMOVED.
    # Zephyr headers use three C11/GCC extensions that -Wpedantic rejects,
    # all confirmed in CI logs:
    #   _Static_assert (C11): BUILD_ASSERT macro in zephyr/toolchain/gcc.h:87.
    #     Every LOG_* call expands BUILD_ASSERT. CI: "ISO C99 does not support
    #     '_Static_assert' [-Wpedantic]"
    #   _Generic (C11): cbprintf_internal.h:630,658.
    #     CI: "ISO C99 does not support '_Generic' [-Wpedantic]"
    #   Zero-arg variadic macro: LOG_INF("string") with no format args.
    #     CI: zephyr_port.c:115 "ISO C99 requires at least one argument for
    #     the '...' in variadic macro"
    # Zephyr is not written to ISO C99 pedantic conformance.

    # -Wconversion REMOVED.
    # Zephyr's cbprintf macros emit -Wsign-conversion on every LOG_* call:
    #   _pkg_offset += sizeof(*_len_loc);  [cbprintf_internal.h:828]
    # CI log: "conversion to 'int' from 'unsigned int' [-Wsign-conversion]"
    # With 20+ source files × multiple log calls, hundreds of warnings fill
    # the GitHub Actions step log and trigger the truncation limit, hiding
    # the real error completely.
    -Wno-sign-conversion     # explicit: suppress cbprintf macro side-effect

    # ── Build analysis ─────────────────────────────────────────────────────
    -fstack-usage
)

# ---------------------------------------------------------------------------
# Paths (all relative to this file's directory)
# ---------------------------------------------------------------------------

# Project root (two levels up from examples/basic_ecu/)
set(DIAG_ROOT         "${CMAKE_CURRENT_SOURCE_DIR}/../..")

# diagnostics_config.yaml — single source of truth.
set(DIAG_CONFIG_YAML  "${CMAKE_CURRENT_SOURCE_DIR}/diagnostics_config.yaml")

# tools/codegen.py — code generator script.
set(DIAG_CODEGEN_SCRIPT "${DIAG_ROOT}/tools/codegen.py")

# Output directory for generated C files — lives inside this example directory.
# This matches the pattern used by all other examples (bms_ecu, ardep_ecu, etc.)
# and mirrors what customers do in their own projects:
#   python3 tools/codegen.py --config your_ecu/diagnostics_config.yaml \
#                            --out    your_ecu/generated/ ...
set(DIAG_GENERATED_DIR  "${CMAKE_CURRENT_SOURCE_DIR}/generated")

# Sentinel: file whose timestamp CMake uses to detect when codegen must re-run.
# Use safety_config.h — only produced with --safety-wrappers, so it correctly
# triggers re-generation when the safety template changes.
set(CODEGEN_SENTINEL "${DIAG_GENERATED_DIR}/safety_config.h")

# ---------------------------------------------------------------------------
# Option: disable automatic code generation
# ---------------------------------------------------------------------------
option(DIAG_SKIP_CODEGEN
    "Skip auto-running tools/codegen.py (use pre-existing generated/ files)"
    OFF
)

# ---------------------------------------------------------------------------
# Custom target: run_codegen
#
# Generates under ${DIAG_GENERATED_DIR}/:
#   generated_config.h
#   did_handlers.h   did_handlers.c
#   uds_init.h       uds_init.c
#
# Re-runs when any of the following inputs are newer than the sentinel:
#   diagnostics_config.yaml
#   tools/codegen.py
#   tools/templates/*.j2
#
# BUILD-FAILURE POLICY:
#   If Python3 is absent and DIAG_SKIP_CODEGEN is OFF, configuration halts
#   with FATAL_ERROR. Silent generation failures can produce invisible build
#   errors that are extremely difficult to diagnose.
# ---------------------------------------------------------------------------
if(NOT DIAG_SKIP_CODEGEN)

    find_package(Python3 COMPONENTS Interpreter QUIET)

    if(NOT Python3_FOUND)
        message(FATAL_ERROR
            "\n"
            "[DIAG] ERROR: Python3 interpreter not found.\n"
            "       Cannot run tools/codegen.py to generate diagnostic sources.\n"
            "\n"
            "  Resolution options:\n"
            "    1. Install Python3 (>= 3.9) with required packages:\n"
            "         pip install pyyaml jinja2\n"
            "\n"
            "    2. Run codegen manually from the project root:\n"
            "         python3 tools/codegen.py \\\n"
            "             --config examples/basic_ecu/diagnostics_config.yaml \\\n"
            "             --out    examples/basic_ecu/generated/ \\\n"
            "             --safety-wrappers --asil-level B\n"
            "       Then re-configure with:\n"
            "         cmake -DDIAG_SKIP_CODEGEN=ON ..\n"
        )
    endif()

    # Collect Jinja2 templates as dependencies.
    file(GLOB DIAG_TEMPLATES
        "${DIAG_ROOT}/tools/templates/*.j2"
    )

    add_custom_command(
        OUTPUT   "${CODEGEN_SENTINEL}"
        COMMAND  "${Python3_EXECUTABLE}"
                 "${DIAG_CODEGEN_SCRIPT}"
                 --config "${DIAG_CONFIG_YAML}"
                 --out    "${DIAG_GENERATED_DIR}"
                 --safety-wrappers
                 --asil-level B
                 --no-manifest
        DEPENDS
            "${DIAG_CONFIG_YAML}"
            "${DIAG_CODEGEN_SCRIPT}"
            ${DIAG_TEMPLATES}
        COMMENT  "[DIAG] Generating sources from diagnostics_config.yaml (ASIL-B-oriented)..."
        VERBATIM
    )

    # Named target — invoke explicitly with:
    #   cmake --build build --target run_codegen
    add_custom_target(run_codegen
        DEPENDS "${CODEGEN_SENTINEL}"
        COMMENT "[DIAG] run_codegen complete."
    )

else()

    message(STATUS
        "[DIAG] DIAG_SKIP_CODEGEN=ON — "
        "using existing files in ${DIAG_GENERATED_DIR}"
    )

endif() # NOT DIAG_SKIP_CODEGEN

# ---------------------------------------------------------------------------
# Include directories
# ---------------------------------------------------------------------------
target_include_directories(app PRIVATE
    ${DIAG_ROOT}/core
    ${DIAG_ROOT}/core/uds_services
    ${DIAG_ROOT}/transport
    ${DIAG_ROOT}/config
    ${DIAG_ROOT}/platform
    ${DIAG_ROOT}/platform/zephyr
    ${DIAG_GENERATED_DIR}          # generated_config.h, did_handlers.h, uds_init.h
)

# ---------------------------------------------------------------------------
# Source files
#
# Explicit absolute paths (via DIAG_ROOT) so this file can be used either as
# a stand-alone Zephyr app OR included from the root CMakeLists.txt without
# relative-path ambiguity.
# ---------------------------------------------------------------------------
# UDS service source list — set EDS_SERVICE_SRCS.
include(${DIAG_ROOT}/cmake/eds_service_sources.cmake)

target_sources(app PRIVATE

    # ── Application entry point ──────────────────────────────────────────
    ${CMAKE_CURRENT_SOURCE_DIR}/src/main.c

    # ── UDS core ─────────────────────────────────────────────────────────
    ${DIAG_ROOT}/core/uds_server.c
    ${DIAG_ROOT}/core/uds_session.c
    ${DIAG_ROOT}/core/uds_security.c
    ${DIAG_ROOT}/core/uds_safety.c

    # ── UDS core: supporting modules ──────────────────────────────────────
    # FIX (B1): These files exist on disk but were absent from target_sources,
    # causing undefined-reference linker errors. Each is directly referenced
    # by a compiled translation unit in this build:
    #
    #   uds_security_algo.c  — seed/key derivation, called by service_0x27.c
    #   uds_aes_cmac.c       — AES-128-CMAC primitive, called by uds_security_algo.c
    #   uds_access_table.c   — ACL lookup/enforce, called by uds_server.c
    #   uds_comm_control.c   — comm-control state, called by service_0x28.c / 0x85.c
    #   uds_session_stats.c  — session counters, called by zephyr_port.c
    #   uds_security_nvm.c   — persistent security counters (NVM-backed)
    ${DIAG_ROOT}/core/uds_security_algo.c
    ${DIAG_ROOT}/core/uds_aes_cmac.c
    ${DIAG_ROOT}/core/uds_access_table.c
    ${DIAG_ROOT}/core/uds_comm_control.c
    ${DIAG_ROOT}/core/uds_session_stats.c
    ${DIAG_ROOT}/core/uds_security_nvm.c

    # UDS service handlers (all 16 SIDs + dispatch table).
    ${EDS_SERVICE_SRCS}
    ${DIAG_ROOT}/core/uds_transfer_ctx.c                # DFU transfer state machine + CRC-32
    ${DIAG_ROOT}/platform/uds_flash_ops.c               # Flash ops registration singleton
    ${DIAG_ROOT}/platform/uds_image_policy.c  # [#232] Image verification policy singleton

    # ── ISO-TP and CAN transport ──────────────────────────────────────────
    ${DIAG_ROOT}/transport/isotp.c
    ${DIAG_ROOT}/transport/can_transport.c
    ${DIAG_ROOT}/platform/zephyr/zephyr_can.c  # moved from transport/ — phase-housekeeping

    # ── Configuration databases ───────────────────────────────────────────
    ${DIAG_ROOT}/config/did_database.c
    ${DIAG_ROOT}/config/dtc_database.c
    ${DIAG_ROOT}/config/routine_database.c

    # ── DTC mirror ────────────────────────────────────────────────────────
    # FIX (B1): dtc_mirror.c was absent.
    # zephyr_port.c calls dtc_mirror_flush_all(); service_0x14.c calls
    # dtc_mirror_clear_all(). Both produce "undefined reference" without this.
    ${DIAG_ROOT}/config/dtc_mirror.c

    # ── Zephyr platform abstraction ───────────────────────────────────────
    ${DIAG_ROOT}/platform/zephyr/zephyr_port.c
    ${DIAG_ROOT}/platform/zephyr/zephyr_mutex.c
    ${DIAG_ROOT}/platform/zephyr/zephyr_timer.c
    ${DIAG_ROOT}/platform/zephyr/zephyr_wdt.c
    ${DIAG_ROOT}/platform/zephyr/zephyr_platform_api.c  # eds_platform_* neutral interface

    # ── Generated sources ─────────────────────────────────────────────────
    ${DIAG_GENERATED_DIR}/did_handlers.c
    ${DIAG_GENERATED_DIR}/uds_init.c
    ${DIAG_GENERATED_DIR}/did_safety_wrappers.c
    ${DIAG_GENERATED_DIR}/routine_handlers.c
)

# ──────────────────────────────────────────────────────────────────────────────
# NVM store: platform-conditional source selection
#
# Two implementations of the nvm_store_* API exist:
#
#   platform/nvm_store.c      — real Zephyr NVS backend.
#     Includes <zephyr/fs/nvs.h> and <zephyr/drivers/flash.h>.
#     Requires CONFIG_FLASH=y, CONFIG_FLASH_MAP=y, CONFIG_NVS=y (set in
#     boards/nucleo_h743zi/nucleo_h743zi.conf) and a DTS flash partition
#     (defined in boards/nucleo_h743zi/nucleo_h743zi.overlay as "diag_nvs").
#     Used for the other real hardware targets (frdm_mcxn947).
#
#   platform/nvm_store_append.c — append-only backend (#304) for STM32H7
#     boards. Their 128 KB sectors overflow NVS's uint16_t sector_size, so
#     nvm_store.c fails nvs_mount() there (EDS#504). Same diag_nvs partition
#     (2 x 128 KB) and the same nvm_store_* API. Used for nucleo_h743zi/h753zi.
#
#   platform/nvm_store_mock.c — RAM-backed mock for host simulation.
#     Self-defines NVM_STORE_HOST_MOCK at the top of the file.
#     Provides the full nvm_store_* API without any Zephyr flash/NVS
#     subsystem dependency.
#     Used for native_sim, where NVS flash infrastructure is absent.
#
# All three export the same symbols. Exactly one must be compiled per build.
# Including both would produce duplicate-symbol linker errors.
# ──────────────────────────────────────────────────────────────────────────────
if(CONFIG_BOARD_NATIVE_SIM)
    target_sources(app PRIVATE ${DIAG_ROOT}/platform/zephyr/nvm_store_mock.c)
elseif(CONFIG_BOARD_NUCLEO_H743ZI OR CONFIG_BOARD_NUCLEO_H753ZI)
    target_sources(app PRIVATE ${DIAG_ROOT}/platform/zephyr/nvm_store_append.c)
    target_compile_definitions(app PRIVATE DIAG_NVM_BACKEND_APPEND=1)
else()
    target_sources(app PRIVATE ${DIAG_ROOT}/platform/zephyr/nvm_store.c)
endif()

# ---------------------------------------------------------------------------
if(NOT DIAG_SKIP_CODEGEN AND TARGET run_codegen)
    add_dependencies(app run_codegen)
endif()

# Required for the build to compile: _Static_assert in uds_types.h fires at
# translation-unit level whenever sizeof(uds_msg_buf_t) > EDS_MSG_BUF_MAX_STACK_BYTES.
# No uds_msg_buf_t is allocated on the task stack in this build — all instances
# are static members of their respective state structs (doip_server_state_t etc.).
target_compile_definitions(app PRIVATE EDS_MSG_BUF_MAX_STACK_BYTES=8192)

# [EDS#282] Bench only: a RoutineControl (RID 0xF0F0) that answers NRC 0x78
# and busy-waits in bounded steps, to measure the response-pending path.
option(DIAG_BENCH_SLOW_ROUTINE "Bench only: slow 0x31 routine for the response-pending path" OFF)
if(DIAG_BENCH_SLOW_ROUTINE)
    target_sources(app PRIVATE ${DIAG_ROOT}/platform/zephyr/bench_slow_routine.c)
    target_compile_definitions(app PRIVATE DIAG_BENCH_SLOW_ROUTINE=1)
endif()
```

## prj.conf
```kconfig
# =============================================================================
# Xaloqi EDS
# examples/basic_ecu/prj.conf
#
# Base project configuration — applies to ALL board targets.
# Board-specific overrides live in boards/<board>/<board>.conf.
#
# FIX: Removed CONFIG_MUTEX_SPIN_ON_OWNER=n.
#   This Kconfig symbol was removed from the Zephyr kernel in Zephyr 3.x.
#   Any attempt to assign a value to an undefined symbol triggers:
#     "attempt to assign the value 'n' to the undefined symbol MUTEX_SPIN_ON_OWNER"
#   Zephyr 3.7 treats this as a fatal Kconfig error, aborting the CMake
#   configure step with "error: Aborting due to Kconfig warnings".
#   The symbol does not exist on any platform in Zephyr 3.7.
# =============================================================================

# --- CAN driver ---
CONFIG_CAN=y
CONFIG_CAN_INIT_PRIORITY=80
CONFIG_STATS=y
CONFIG_CAN_STATS=y

# --- Kernel / threading ---
CONFIG_MULTITHREADING=y
CONFIG_THREAD_STACK_INFO=y
CONFIG_THREAD_NAME=y
CONFIG_THREAD_MONITOR=y

# --- Tick rate: 1 ms required for ISO-TP timer accuracy ---
CONFIG_SYS_CLOCK_TICKS_PER_SEC=1000
CONFIG_TICKLESS_KERNEL=n

# --- Watchdog ---
CONFIG_WATCHDOG=y
CONFIG_WDT_DISABLE_AT_BOOT=n
CONFIG_DIAG_WDT_WINDOW_MS=100

# --- Logging ---
CONFIG_LOG=y
CONFIG_LOG_DEFAULT_LEVEL=3
CONFIG_LOG_BACKEND_UART=y
CONFIG_LOG_BUFFER_SIZE=2048

# --- Safety hardening ---
CONFIG_ASSERT=y
CONFIG_STACK_CANARIES=y
CONFIG_STACK_SENTINEL=y

# --- C library ---
CONFIG_NEWLIB_LIBC=y

# --- No heap (MISRA-21.3) ---
CONFIG_HEAP_MEM_POOL_SIZE=0

# --- UDS stack parameters ---
CONFIG_UDS_SESSION_S3_TIMEOUT_MS=5000
CONFIG_ISOTP_TIMEOUT_CR_MS=150
CONFIG_ISOTP_TIMEOUT_BS_MS=75
CONFIG_ISOTP_TIMEOUT_AS_MS=25

# --- Diagnostics task ---
CONFIG_DIAG_TASK_STACK_SIZE=4096
CONFIG_DIAG_TASK_PRIORITY=5

# --- Build output ---
CONFIG_BUILD_OUTPUT_BIN=y
CONFIG_BUILD_OUTPUT_HEX=y
```

## src/main.c
```c
// SPDX-License-Identifier: Apache-2.0
// Copyright (c) 2026 Xaloqi
/*
 * =============================================================================
 * Xaloqi EDS
 * FILE: examples/basic_ecu/src/main.c
 *
 * PURPOSE: BasicECU Zephyr application entry point.
 *
 *          The simplest possible EDS integration — 5 DIDs, 2 DTCs, 3 routines.
 *          Use this as a starting point for a new Zephyr ECU.
 *
 * TARGET:  native_sim (CI) and nucleo_h743zi (hardware).
 *          Portable to any Zephyr-supported board with CAN peripheral.
 *
 * THREAD MODEL:
 *   main()       — platform init → UDS init → launch diag_task → return 0
 *   diag_task    — 1 ms poll loop: CAN RX → ISO-TP → UDS dispatch → CAN TX
 *
 * DID HANDLERS:
 *   Live in generated/did_handlers.c, registered by did_handlers_register_all()
 *   via uds_generated_init() below. Each returns a deterministic stub value
 *   (see generated/did_handlers.c's own TODO markers) until replaced with real
 *   sensor/NVM access. [EDS#340]: this file used to also declare CamelCase
 *   did_read_* / did_write_* functions of its own — they were never registered
 *   with anything and were unreachable dead code; removed rather than left to
 *   mislead the next integrator copying this file as a starting point.
 *
 * BUILDING:
 *   west build -b native_sim examples/basic_ecu
 *   west build -b nucleo_h743zi examples/basic_ecu
 *
 * SAFETY   : ASIL-B candidate.
 * STANDARD : MISRA C:2012 alignment intended.
 * LICENSE  : Apache-2.0
 * =============================================================================
 */

/* --------------------------------------------------------------------------
 * Diagnostics stack headers
 * -------------------------------------------------------------------------- */
#include "uds_types.h"
#include "uds_server.h"
#include "uds_security_algo.h"
#include "uds_periodic.h"
#include "uds_session.h"
#include "isotp.h"
#include "can_transport.h"
#include "zephyr_port.h"
#include "zephyr_mutex.h"
#include "zephyr_timer.h"
#include "zephyr_wdt.h"
#include "nvm_store.h"
#if defined(DIAG_NVM_BACKEND_APPEND)
#include "nvm_store_append.h"
#endif

/* --------------------------------------------------------------------------
 * Generated headers (from diagnostics_config.yaml via codegen.py)
 * -------------------------------------------------------------------------- */
#include "uds_init.h"
#include "generated_config.h"
#include "did_handlers.h"
#if defined(DIAG_BENCH_SLOW_ROUTINE)
#include "bench_slow_routine.h"
#endif

/* --------------------------------------------------------------------------
 * Zephyr headers
 * -------------------------------------------------------------------------- */
#include <zephyr/kernel.h>
#include <zephyr/device.h>
#include <zephyr/drivers/can.h>
#include <zephyr/drivers/flash.h>
#include <zephyr/logging/log.h>
#include <zephyr/storage/flash_map.h>
#include "eds_partition.h"      /* EDS_PARTITION_* : FIXED_PARTITION_* before Zephyr 4.4, PARTITION_* after (#516) */

LOG_MODULE_REGISTER(basic_ecu, LOG_LEVEL_INF);

/* =============================================================================
 * Configuration
 * ============================================================================= */

#define DIAG_CAN_DEV         DEVICE_DT_GET(DT_ALIAS(can0))
#define DIAG_RX_CAN_ID       ((uint32_t)GEN_CAN_RX_ID)   /* 0x7DF */
#define DIAG_TX_CAN_ID       ((uint32_t)GEN_CAN_TX_ID)   /* 0x7E8 */

#ifndef CONFIG_DIAG_TASK_STACK_SIZE
#define CONFIG_DIAG_TASK_STACK_SIZE   (4096U)
#endif

#ifndef CONFIG_DIAG_TASK_PRIORITY
#define CONFIG_DIAG_TASK_PRIORITY     (5)
#endif

/* =============================================================================
 * Static allocations
 * ============================================================================= */

K_THREAD_STACK_DEFINE(s_diag_stack, CONFIG_DIAG_TASK_STACK_SIZE);
static struct k_thread s_diag_thread;

static diag_mutex_t s_session_lock;
static diag_mutex_t s_security_lock;
static diag_timer_t s_tick_timer;
static diag_wdt_t   s_wdt;

/* =============================================================================
 * ISO-TP RX completion callback
 *
 * Called by isotp_process_rx_frame() when a complete UDS PDU is reassembled.
 * Holds the session lock for the duration of dispatch + response transmission.
 * ============================================================================= */

static void on_isotp_rx_complete(
    const uint8_t *data,
    uint32_t       length,
    void          *arg)
{
    uds_server_ctx_t *srv = (uds_server_ctx_t *)arg;
    isotp_ctx_t      *tp  = uds_generated_get_isotp();

    /* Static buffers — no stack allocation of uds_msg_buf_t. */
    static uds_msg_buf_t s_req;
    static uds_msg_buf_t s_resp;

    uint16_t i;

    if ((data == NULL) || (srv == NULL) || (tp == NULL)) { return; }
    if ((length == 0U) || (length > (uint32_t)UDS_MAX_PAYLOAD_LEN)) { return; }

    (void)diag_mutex_lock(&s_session_lock);

    for (i = 0U; i < (uint16_t)length; i++) {
        s_req.data[i] = data[i];
    }
    s_req.length  = (uint16_t)length;
    s_resp.length = 0U;

    (void)uds_server_process_request(srv, &s_req, &s_resp);

    if (s_resp.length > 0U) {
        (void)isotp_transmit(tp, s_resp.data, s_resp.length);
    }

    (void)diag_mutex_unlock(&s_session_lock);

    /* [P2-0x11-01] Deferred reset: response is on the wire, now reset. */
    if (srv->pending_reset_type != (uint8_t)0U) {
        uint8_t reset_type = srv->pending_reset_type;
        srv->pending_reset_type = (uint8_t)0U;
        (void)zephyr_port_nvm_flush();
        k_msleep(50);  /* Allow ISO-TP TX to reach the wire before reset (As timer). */
        (void)zephyr_port_ecu_reset(reset_type);
        /* Does not return. */
    }
}

/* =============================================================================
 * 1 ms tick callback — drives ISO-TP and UDS session timers
 * ============================================================================= */

typedef struct { uds_server_ctx_t *srv; isotp_ctx_t *tp; } tick_ctx_t;

static void on_tick(void *arg)
{
    tick_ctx_t *ctx = (tick_ctx_t *)arg;
    if (ctx == NULL) { return; }
    (void)isotp_tick_1ms(ctx->tp);
    (void)uds_server_tick_1ms(ctx->srv);
    (void)uds_periodic_tick_1ms();
}

/* =============================================================================
 * Diagnostics task
 * ============================================================================= */

static void diag_task_entry(void *p1, void *p2, void *p3)
{
    uds_server_ctx_t *srv = (uds_server_ctx_t *)p1;
    can_transport_t  *can = (can_transport_t  *)p2;
    isotp_ctx_t      *tp  = (isotp_ctx_t      *)p3;

    uds_status_t    status;
    uds_can_frame_t rx_frame;
    bool            frame_ready;
    tick_ctx_t      tick_ctx = { .srv = srv, .tp = tp };

    LOG_INF("BasicECU diag task started");

    if (diag_timer_start(&s_tick_timer) != UDS_STATUS_OK) {
        LOG_ERR("Timer start failed."); return;
    }

    while (true) {
        (void)diag_timer_wait_tick(&s_tick_timer, 2U);

        /* [EDS#558] Drain every queued frame, at most the queue depth. The Flow
         * Control BlockSize keeps a burst within the RX queue only if each
         * iteration empties it; one frame per tick loses CFs of long requests. */
        frame_ready = true;
        for (uint32_t rx_n = 0U;
             frame_ready && (rx_n < (uint32_t)EDS_CAN_RX_QUEUE_DEPTH); rx_n++) {
            frame_ready = false;
            status = can_transport_receive(can, &rx_frame, &frame_ready);
            if ((status == UDS_STATUS_OK) && frame_ready) {
                (void)isotp_process_rx_frame(tp, &rx_frame,
                                              on_isotp_rx_complete, srv);
            }
        }

        on_tick(&tick_ctx);

        /* [EDS#282] Response-pending job (a deferred 0x31 routine or 0x34
         * erase): one bounded step per tick; 0x78 keepalives and the final
         * response come back here. On ISO-TP busy the server returns the
         * same frame next tick. Same lock as the dispatch above. */
        {
            static uds_msg_buf_t s_pending_frame;

            (void)diag_mutex_lock(&s_session_lock);
            if (uds_server_poll(srv, &s_pending_frame) == UDS_POLL_FRAME) {
                if (isotp_transmit(tp, s_pending_frame.data,
                                   (uint32_t)s_pending_frame.length) == UDS_STATUS_OK) {
                    uds_server_frame_sent(srv);
                }
            }
            (void)diag_mutex_unlock(&s_session_lock);
        }

        {
            static uds_msg_buf_t s_periodic_frame;
            while (uds_periodic_pop_due(&s_periodic_frame) == UDS_STATUS_OK) {
                /* [EDS#546] A periodic message is a UUDT frame on its own CAN ID
                 * (ISO 14229-3 §8.5): it bypasses the ISO-TP channel, so it can
                 * go out while a multi-frame response is being sent.
                 * [EDS#194] Re-queue if the CAN driver refuses it instead of
                 * silently dropping this period; retry on the next 1ms tick and
                 * stop draining this tick. */
                if (isotp_transmit_uudt(tp, s_periodic_frame.data,
                                   (uint32_t)s_periodic_frame.length) != UDS_STATUS_OK) {
                    (void)uds_periodic_requeue_last();
                    break;
                }
            }
        }

        (void)diag_wdt_feed(&s_wdt);
    }
}

/* =============================================================================
 * Session change callback — cancels periodic subscriptions on Default session
 * ============================================================================= */

static void s_on_session_change(uds_session_type_t old_sess,
                                uds_session_type_t new_sess)
{
    (void)old_sess;
    if (new_sess == UDS_SESSION_DEFAULT) {
        (void)uds_periodic_cancel_all();
    }
}

/* =============================================================================
 * main()
 * ============================================================================= */

int main(void)
{
    uds_status_t      status;
    can_transport_t  *can = NULL;
    uds_server_ctx_t *srv = NULL;
    isotp_ctx_t      *tp  = NULL;

    LOG_INF("Xaloqi EDS BasicECU starting");

    if (diag_mutex_init(&s_session_lock)  != UDS_STATUS_OK) { return -1; }
    if (diag_mutex_init(&s_security_lock) != UDS_STATUS_OK) { return -1; }

    (void)diag_wdt_init(&s_wdt);

    status = diag_timer_init(&s_tick_timer, on_tick, NULL);
    if (status != UDS_STATUS_OK) { LOG_ERR("Timer init failed."); return -1; }

    {
        const zephyr_port_cfg_t port_cfg = {
            .can_dev = DIAG_CAN_DEV,
            /* ISO 15765-4 physical addressing alongside the functional
             * 0x7DF filter above -- a real SOVD/UDS tester (e.g. the
             * Eclipse OpenSOVD CDA) probes with a physical request and
             * will not treat a functional-only ECU as discoverable. */
            .physical_rx_id = 0x7E0U,
        };
        status = zephyr_port_init(&port_cfg, &can);
        if (status != UDS_STATUS_OK) {
            LOG_ERR("Platform init failed: 0x%02X", (unsigned)status);
            return -1;
        }
    }

#if defined(DIAG_NVM_BACKEND_APPEND)
    /* [EDS#504] The append-only backend erases one 128 KB bank during
     * compaction (up to 4 s on STM32H7); it feeds the watchdog across that
     * call. Must run before nvm_store_init() below. */
    nvm_store_append_set_wdt(&s_wdt);
#endif

    /*
     * [EDS#200] Must run before uds_generated_init() (dtc_mirror_init() at
     * Step 3.5 sits on top of nvm_store and silently no-ops until this
     * succeeds).
     *
     * Unlike every other example in this repo, basic_ecu is cross-compiled
     * by CI against FOUR different board targets (see .github/workflows/
     * ci.yml jobs "zephyr-native" and 5a/5b/5c): native_sim, nucleo_h743zi,
     * frdm_mcxn947, and mr_canhubk3 — each supplying its own overlay/conf
     * from the top-level boards/<name>/ directory rather than
     * examples/basic_ecu/boards/. All four real-board overlays define a
     * "diag_nvs" fixed partition, but with three DIFFERENT flash page
     * (erase-sector) sizes (128 KB / 128 KB / 8 KB respectively — see each
     * boards/<name>/<name>.overlay's own comment block). A single hardcoded
     * sector_size, as used in safeboot_ecu/src/main.c for its one specific
     * board, would be wrong for at least two of these three. Query the
     * real page size at runtime via flash_get_page_info_by_offs() instead
     * — the portable, board-agnostic way to populate nvm_store_cfg_t.
     *
     * On native_sim, platform/zephyr/nvm_store_mock.c (RAM-backed) is
     * linked instead of the real NVS backend (see this file's CMakeLists.txt
     * "NVM store: platform-conditional source selection") — its
     * nvm_store_init() ignores cfg entirely, so NULL is correct there (see
     * nvm_store.h: "may be NULL on host") and there is no "diag_nvs"
     * partition to resolve.
     *
     * EDS_PARTITION_DEVICE/OFFSET/SIZE below (platform/zephyr/eds_partition.h: Zephyr's FIXED_PARTITION_* up to 4.3, PARTITION_* from 4.4, #516) take the DTS *node label*
     * (eds_nvs_slot), not the partition's string "label" property
     * ("diag_nvs") — passing "diag_nvs" fails to compile with
     * "'__device_dts_ord_DT_N_NODELABEL_diag_nvs...' undeclared" (caught
     * in this PR's own CI on all three real boards). All four overlays
     * name the partition node eds_nvs_slot even though its "label" string
     * is "diag_nvs" — see e.g. boards/nucleo_h743zi/nucleo_h743zi.overlay.
     *
     * mr_canhubk3 (NXP S32K344) is a further, deliberate exception: with
     * the node-label fix above it still fails to *link* --
     * "'__device_dts_ord_199' undeclared" in FIXED_PARTITION_DEVICE's
     * expansion (also caught in this PR's own CI) -- meaning &flash0 on
     * this SoC has a devicetree node but no instantiated struct device
     * behind it in this Zephyr version (v3.7.0), unlike STM32H743/MCXN947
     * where the same pattern links cleanly. Root-causing an NXP S32K3
     * flash driver gap needs real hardware or S32K3 HAL knowledge this
     * repo doesn't have -- same category of risk as ardep_ecu below, so
     * left as a documented gap here rather than guessed at a third time.
     */
#if defined(CONFIG_BOARD_NATIVE_SIM) || defined(CONFIG_BOARD_MR_CANHUBK3)
    status = nvm_store_init(NULL);
#else
    {
        const struct device    *nvs_dev = EDS_PARTITION_DEVICE(eds_nvs_slot);
        const off_t              nvs_off = EDS_PARTITION_OFFSET(eds_nvs_slot);
        const size_t              nvs_sz = EDS_PARTITION_SIZE(eds_nvs_slot);
        struct flash_pages_info  page_info;
        int rc = flash_get_page_info_by_offs(nvs_dev, nvs_off, &page_info);

        if (rc != 0) {
            LOG_ERR("NVM store: flash_get_page_info_by_offs failed: %d", rc);
            status = UDS_STATUS_ERR_PLATFORM;
        } else {
            const nvm_store_cfg_t nvm_cfg = {
                .flash_dev    = (const void *)nvs_dev,
                .flash_offset = (uint32_t)nvs_off,
                .sector_size  = (uint32_t)page_info.size,
                /* diag_nvs is sized as an exact multiple of the page size
                 * on every board this targets; NVS requires >= 2 sectors
                 * for wear levelling (see nvm_store.c). */
                .sector_count = (uint8_t)(nvs_sz / page_info.size),
            };

            status = nvm_store_init(&nvm_cfg);
        }
    }
#endif
    if (status != UDS_STATUS_OK) {
        LOG_ERR("NVM store init failed: 0x%02X — DTC mirror will not "
                "survive reset this run.", (unsigned)status);
    }

    /*
     * Security algorithm init — no TRNG on basic_ecu (CI / development build).
     * For production: call uds_security_algo_set_rng_cb() with a real TRNG
     * callback and uds_security_algo_set_level_key() with OEM keys from OTP.
     * See docs/SECURITY_NOTICE.md.
     */
    LOG_WRN("[SEC] Using placeholder AES keys — inject OEM keys before production.");
    (void)uds_security_algo_set_rng_cb(NULL);

    status = uds_generated_init(can, DIAG_RX_CAN_ID, DIAG_TX_CAN_ID);
    if (status != UDS_STATUS_OK) {
        LOG_ERR("UDS stack init failed: 0x%02X", (unsigned)status);
        return -1;
    }

    srv = uds_generated_get_server();
    tp  = uds_generated_get_isotp();
    if ((srv == NULL) || (tp == NULL)) {
        LOG_ERR("Stack context NULL after init."); return -1;
    }

#if defined(DIAG_BENCH_SLOW_ROUTINE)
    /* [EDS#282] Bench only: RID 0xF0F0 answers 0x78 (bench_slow_routine.h). */
    LOG_WRN("[BENCH] Slow routine 0xF0F0 registered (response-pending bench).");
    if (bench_slow_routine_register() != UDS_STATUS_OK) {
        LOG_ERR("Bench slow routine registration failed."); return -1;
    }
#endif

    (void)uds_periodic_init();
    (void)uds_session_register_change_cb(srv->cfg.session_ctx,
                                          s_on_session_change);

    LOG_INF("UDS stack ready: %u DIDs  %u DTCs  RX=0x%03X TX=0x%03X",
            (unsigned)GEN_DID_COUNT, (unsigned)GEN_DTC_COUNT,
            (unsigned)DIAG_RX_CAN_ID, (unsigned)DIAG_TX_CAN_ID);

    (void)k_thread_create(
        &s_diag_thread, s_diag_stack,
        K_THREAD_STACK_SIZEOF(s_diag_stack),
        diag_task_entry,
        (void *)srv, (void *)can, (void *)tp,
        CONFIG_DIAG_TASK_PRIORITY, 0U, K_NO_WAIT
    );
    k_thread_name_set(&s_diag_thread, "diag_task");

    return 0;
}
```
