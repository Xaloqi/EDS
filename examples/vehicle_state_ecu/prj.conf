## CMakeLists.txt
```
# File: examples/vehicle_state_ecu/CMakeLists.txt
# =============================================================================
# Xaloqi EDS
# examples/vehicle_state_ecu/CMakeLists.txt
#
# PURPOSE: Stand-alone Zephyr build file for the VehicleStateECU example.
#          native_sim only — see README.md.
#
#          cd examples/vehicle_state_ecu
#          west build -b native_sim .
#
# SPDX-License-Identifier: Apache-2.0
# =============================================================================

cmake_minimum_required(VERSION 3.20.0)

# [#414] EDS Kconfig comes from this tree, not whichever EDS module the
# workspace has. Must precede find_package(Zephyr).
include(${CMAKE_CURRENT_SOURCE_DIR}/../../cmake/eds_zephyr_module.cmake)

find_package(Zephyr REQUIRED HINTS $ENV{ZEPHYR_BASE})

project(vehicle_state_ecu
    VERSION     0.1.0
    LANGUAGES   C
    DESCRIPTION "VehicleStateECU example — Xaloqi EDS"
)

set(CMAKE_C_STANDARD          11)
set(CMAKE_C_STANDARD_REQUIRED ON)
set(CMAKE_C_EXTENSIONS        OFF)

# [#515] -Wundef (MISRA 20.9) below applies to EDS code only: Zephyr, module and
# HAL headers are system includes for this target. See the cmake file.
include(${CMAKE_CURRENT_SOURCE_DIR}/../../cmake/eds_third_party_headers.cmake)
eds_third_party_headers_are_system(app)

target_compile_options(app PRIVATE
    -Wall
    -Wextra
    -Wshadow
    -Wdouble-promotion
    -Wundef
    -Wno-unused-parameter
    -Wno-sign-conversion     # see examples/basic_ecu/CMakeLists.txt: Zephyr's
                             # cbprintf macros trip -Wsign-conversion on every
                             # LOG_* call.
    -fstack-usage
)

# ---------------------------------------------------------------------------
# Paths
# ---------------------------------------------------------------------------

set(DIAG_ROOT           "${CMAKE_CURRENT_SOURCE_DIR}/../..")
set(DIAG_CONFIG_YAML     "${CMAKE_CURRENT_SOURCE_DIR}/diagnostics_config.yaml")
set(DIAG_CODEGEN_SCRIPT  "${DIAG_ROOT}/tools/codegen.py")
set(DIAG_GENERATED_DIR   "${CMAKE_CURRENT_SOURCE_DIR}/generated")
set(CODEGEN_SENTINEL     "${DIAG_GENERATED_DIR}/safety_config.h")

# ---------------------------------------------------------------------------
# Codegen — OFF by default for this example (the one difference from
# basic_ecu's CMakeLists.txt pattern).
#
# generated/routine_handlers.c carries four hand-written [APP HOOK] bodies
# that delegate to src/vehicle_state.c — the actuation path's only
# attachment point (routine_database_find() returns `const`, so nothing
# can re-point a callback at runtime; see the banner at the top of that
# file and EDS#340). Re-running codegen would silently overwrite them with
# empty TODO stubs. This also means a forker without the commercial codegen
# tool (pyyaml/jinja2, tools/templates/) can still build — same OD-14
# Option 2 mechanism every other example's pre-committed generated/ relies
# on, just defaulted ON here instead of opted into with -DDIAG_SKIP_CODEGEN=ON.
#
# Regenerate deliberately (after editing diagnostics_config.yaml) with:
#   python3 tools/codegen.py --config examples/vehicle_state_ecu/diagnostics_config.yaml \
#                            --out    examples/vehicle_state_ecu/generated/ \
#                            --safety-wrappers --asil-level B --no-manifest
# then reapply the four [APP HOOK] bodies in generated/routine_handlers.c
# before committing.
# ---------------------------------------------------------------------------
option(DIAG_SKIP_CODEGEN
    "Skip auto-running tools/codegen.py (use pre-existing generated/ files)"
    ON
)

if(NOT DIAG_SKIP_CODEGEN)

    find_package(Python3 COMPONENTS Interpreter QUIET)

    if(NOT Python3_FOUND)
        message(FATAL_ERROR
            "\n"
            "[DIAG] ERROR: Python3 interpreter not found.\n"
            "       Cannot run tools/codegen.py to generate diagnostic sources.\n"
            "\n"
            "  Resolution options:\n"
            "    1. Install Python3 (>= 3.9) with required packages:\n"
            "         pip install pyyaml jinja2\n"
            "\n"
            "    2. Re-configure with -DDIAG_SKIP_CODEGEN=ON (the default for\n"
            "       this example) to use the pre-committed generated/ files.\n"
        )
    endif()

    file(GLOB DIAG_TEMPLATES "${DIAG_ROOT}/tools/templates/*.j2")

    add_custom_command(
        OUTPUT   "${CODEGEN_SENTINEL}"
        COMMAND  "${Python3_EXECUTABLE}"
                 "${DIAG_CODEGEN_SCRIPT}"
                 --config "${DIAG_CONFIG_YAML}"
                 --out    "${DIAG_GENERATED_DIR}"
                 --safety-wrappers
                 --asil-level B
                 --no-manifest
        DEPENDS
            "${DIAG_CONFIG_YAML}"
            "${DIAG_CODEGEN_SCRIPT}"
            ${DIAG_TEMPLATES}
        COMMENT  "[DIAG] Generating sources from diagnostics_config.yaml (ASIL-B-oriented)... "
                 "NOTE: this will overwrite the hand-written [APP HOOK] bodies in "
                 "generated/routine_handlers.c -- reapply them before committing."
        VERBATIM
    )

    add_custom_target(run_codegen
        DEPENDS "${CODEGEN_SENTINEL}"
        COMMENT "[DIAG] run_codegen complete."
    )

else()

    message(STATUS
        "[DIAG] DIAG_SKIP_CODEGEN=ON (default for this example) — "
        "using pre-committed files in ${DIAG_GENERATED_DIR}"
    )

endif()

# ---------------------------------------------------------------------------
# [APP HOOK] guard — fail loudly, at configure time, if
# generated/routine_handlers.c was ever regenerated without reapplying the
# four hand-written delegations to src/vehicle_state.c (see above).
# ---------------------------------------------------------------------------
file(STRINGS "${DIAG_GENERATED_DIR}/routine_handlers.c" DIAG_APP_HOOK_LINES
     REGEX "\\[APP HOOK\\]")
list(LENGTH DIAG_APP_HOOK_LINES DIAG_APP_HOOK_COUNT)
if(DIAG_APP_HOOK_COUNT LESS 4)
    message(FATAL_ERROR
        "\n"
        "[DIAG] ERROR: generated/routine_handlers.c is missing its [APP HOOK]\n"
        "       markers (found ${DIAG_APP_HOOK_COUNT}, expected >= 4).\n"
        "       This file was regenerated and the hand-written delegations to\n"
        "       src/vehicle_state.c were lost. See the banner at the top of\n"
        "       generated/routine_handlers.c and reapply them before building.\n"
    )
endif()

# ---------------------------------------------------------------------------
# Include directories
# ---------------------------------------------------------------------------
target_include_directories(app PRIVATE
    ${DIAG_ROOT}/core
    ${DIAG_ROOT}/core/uds_services
    ${DIAG_ROOT}/transport
    ${DIAG_ROOT}/config
    ${DIAG_ROOT}/platform
    ${DIAG_ROOT}/platform/zephyr
    ${DIAG_GENERATED_DIR}
    ${CMAKE_CURRENT_SOURCE_DIR}/src
)

# ---------------------------------------------------------------------------
# Source files
# ---------------------------------------------------------------------------
include(${DIAG_ROOT}/cmake/eds_service_sources.cmake)

target_sources(app PRIVATE

    # ── Application ─────────────────────────────────────────────────────
    ${CMAKE_CURRENT_SOURCE_DIR}/src/main.c
    ${CMAKE_CURRENT_SOURCE_DIR}/src/vehicle_state.c

    # ── UDS core ─────────────────────────────────────────────────────────
    ${DIAG_ROOT}/core/uds_server.c
    ${DIAG_ROOT}/core/uds_session.c
    ${DIAG_ROOT}/core/uds_security.c
    ${DIAG_ROOT}/core/uds_safety.c
    ${DIAG_ROOT}/core/uds_security_algo.c
    ${DIAG_ROOT}/core/uds_aes_cmac.c
    ${DIAG_ROOT}/core/uds_access_table.c
    ${DIAG_ROOT}/core/uds_comm_control.c
    ${DIAG_ROOT}/core/uds_session_stats.c
    ${DIAG_ROOT}/core/uds_security_nvm.c

    ${EDS_SERVICE_SRCS}
    ${DIAG_ROOT}/core/uds_transfer_ctx.c
    ${DIAG_ROOT}/platform/uds_flash_ops.c
    ${DIAG_ROOT}/platform/uds_image_policy.c

    # ── ISO-TP and CAN transport ──────────────────────────────────────────
    ${DIAG_ROOT}/transport/isotp.c
    ${DIAG_ROOT}/transport/can_transport.c
    ${DIAG_ROOT}/platform/zephyr/zephyr_can.c

    # ── Configuration databases ───────────────────────────────────────────
    ${DIAG_ROOT}/config/did_database.c
    ${DIAG_ROOT}/config/dtc_database.c
    ${DIAG_ROOT}/config/routine_database.c
    ${DIAG_ROOT}/config/dtc_mirror.c

    # ── Zephyr platform abstraction ───────────────────────────────────────
    ${DIAG_ROOT}/platform/zephyr/zephyr_port.c
    ${DIAG_ROOT}/platform/zephyr/zephyr_mutex.c
    ${DIAG_ROOT}/platform/zephyr/zephyr_timer.c
    ${DIAG_ROOT}/platform/zephyr/zephyr_wdt.c
    ${DIAG_ROOT}/platform/zephyr/zephyr_platform_api.c
    ${DIAG_ROOT}/platform/zephyr/nvm_store_mock.c   # native_sim only — see main.c

    # ── Generated sources ─────────────────────────────────────────────────
    ${DIAG_GENERATED_DIR}/did_handlers.c
    ${DIAG_GENERATED_DIR}/uds_init.c
    ${DIAG_GENERATED_DIR}/did_safety_wrappers.c
    ${DIAG_GENERATED_DIR}/routine_handlers.c
)

if(NOT DIAG_SKIP_CODEGEN AND TARGET run_codegen)
    add_dependencies(app run_codegen)
endif()

# Required for the build to compile: _Static_assert in uds_types.h fires at
# translation-unit level whenever sizeof(uds_msg_buf_t) > EDS_MSG_BUF_MAX_STACK_BYTES.
target_compile_definitions(app PRIVATE EDS_MSG_BUF_MAX_STACK_BYTES=8192)
```

## prj.conf
```kconfig
# =============================================================================
# Xaloqi EDS
# examples/vehicle_state_ecu/prj.conf
#
# Base project configuration. native_sim-specific overrides live in
# boards/native_sim.conf (this example ships no other board target).
# =============================================================================

# --- CAN driver ---
CONFIG_CAN=y
CONFIG_CAN_INIT_PRIORITY=80
CONFIG_STATS=y
CONFIG_CAN_STATS=y

# --- Kernel / threading ---
CONFIG_MULTITHREADING=y
CONFIG_THREAD_STACK_INFO=y
CONFIG_THREAD_NAME=y
CONFIG_THREAD_MONITOR=y

# --- Tick rate: 1 ms required for ISO-TP timer accuracy ---
CONFIG_SYS_CLOCK_TICKS_PER_SEC=1000
CONFIG_TICKLESS_KERNEL=n

# --- Watchdog ---
CONFIG_WATCHDOG=y
CONFIG_WDT_DISABLE_AT_BOOT=n
CONFIG_DIAG_WDT_WINDOW_MS=100

# --- Logging ---
CONFIG_LOG=y
CONFIG_LOG_DEFAULT_LEVEL=3
CONFIG_LOG_BACKEND_UART=y
CONFIG_LOG_BUFFER_SIZE=2048

# --- Safety hardening ---
CONFIG_ASSERT=y
CONFIG_STACK_CANARIES=y
# Fail the build if the canaries are not real (see Kconfig EDS_REQUIRE_STACK_CANARIES).
CONFIG_EDS_REQUIRE_STACK_CANARIES=y
CONFIG_STACK_SENTINEL=y

# --- C library ---
CONFIG_NEWLIB_LIBC=y
# [#498] Fail the build, rather than silently link picolibc, if newlib is unavailable.
CONFIG_EDS_REQUIRE_NEWLIB=y

# --- No heap (MISRA-21.3) ---
CONFIG_HEAP_MEM_POOL_SIZE=0

# --- UDS session timing / SecurityAccess lockout: diagnostics_config.yaml (EDS#455);
#     ISO-TP timeouts: EDS defaults, ISO 15765-2:2024 1000 ms (EDS#453) ---

# --- Diagnostics task ---
CONFIG_DIAG_TASK_STACK_SIZE=4096
CONFIG_DIAG_TASK_PRIORITY=5

# --- Build output ---
CONFIG_BUILD_OUTPUT_BIN=y
CONFIG_BUILD_OUTPUT_HEX=y
```

## boards/native_sim.conf
```kconfig
# =============================================================================
# Xaloqi EDS
# examples/vehicle_state_ecu/boards/native_sim.conf
#
# native_sim-specific Kconfig overrides, auto-merged by Zephyr CMake on top
# of prj.conf for this board only (Zephyr convention: <app>/boards/<BOARD>.conf
# is picked up automatically — this is why `west build -b native_sim
# examples/vehicle_state_ecu` is a single command with no extra flags).
#
# Identical to the root boards/native_sim/native_sim.conf (see that file for
# the full rationale behind each override — Zephyr 3.7 promotes Kconfig
# dependency warnings to fatal errors on native_sim for all of these).
# Duplicated here, not referenced, because this example ships no board
# target other than native_sim and keeps its own build self-contained.
# =============================================================================

CONFIG_CAN_LOOPBACK=y
CONFIG_POSIX_API=y
CONFIG_STACK_CANARIES=n
CONFIG_CAN_STATS=n
CONFIG_LOG_MODE_DEFERRED=y
CONFIG_LOG_BACKEND_UART=n
CONFIG_LOG_BACKEND_NATIVE_POSIX=y
# [#498] native_sim links picolibc, whatever is requested: on Zephyr 3.7 the
# Kconfig choice drops NEWLIB_LIBC=y for this board ("choice symbol NEWLIB_LIBC
# ... ended up as PICOLIBC"), with the host and the SDK toolchain alike. Say so
# explicitly. (The #498 guard exempts native_sim for this reason.)
CONFIG_PICOLIBC=y
CONFIG_REBOOT=y
CONFIG_LOG_DEFAULT_LEVEL=2
CONFIG_WATCHDOG=n
```

## src/main.c
```c
// SPDX-License-Identifier: Apache-2.0
// Copyright (c) 2026 Xaloqi
/*
 * =============================================================================
 * Xaloqi EDS
 * FILE: examples/vehicle_state_ecu/src/main.c
 *
 * PURPOSE: VehicleStateECU Zephyr application entry point.
 *
 *          Two vehicle-state input DIDs (engine speed, vehicle speed),
 *          two DTCs on faults those two signals can produce, and a
 *          RoutineControl actuation path over an indicator output stage —
 *          see src/vehicle_state.c for the application logic behind all
 *          three.
 *
 * TARGET:  native_sim only. This example does not ship hardware board
 *          overlays — see README.md.
 *
 * THREAD MODEL:
 *   main()       — platform init -> UDS init -> launch diag_task -> return 0
 *   diag_task    — 1 ms poll loop: CAN RX -> ISO-TP -> UDS dispatch -> CAN TX,
 *                  plus a 100 ms-cadence call into vehicle_state_monitor_tick()
 *                  (see vehicle_state.h for why that logic lives on this
 *                  thread rather than a separate one).
 *
 * BUILDING:
 *   west build -b native_sim examples/vehicle_state_ecu
 *
 * SAFETY   : Example application — not safety-assessed.
 * STANDARD : MISRA C:2012 alignment intended.
 * LICENSE  : Apache-2.0
 * =============================================================================
 */

/* --------------------------------------------------------------------------
 * Diagnostics stack headers
 * -------------------------------------------------------------------------- */
#include "uds_types.h"
#include "uds_server.h"
#include "uds_security_algo.h"
#include "uds_periodic.h"
#include "uds_session.h"
#include "isotp.h"
#include "can_transport.h"
#include "zephyr_port.h"
#include "zephyr_mutex.h"
#include "zephyr_timer.h"
#include "zephyr_wdt.h"
#include "nvm_store.h"

/* --------------------------------------------------------------------------
 * Generated headers (from diagnostics_config.yaml via codegen.py)
 * -------------------------------------------------------------------------- */
#include "uds_init.h"
#include "generated_config.h"

/* --------------------------------------------------------------------------
 * Application logic
 * -------------------------------------------------------------------------- */
#include "vehicle_state.h"

/* --------------------------------------------------------------------------
 * Zephyr headers
 * -------------------------------------------------------------------------- */
#include <zephyr/kernel.h>
#include <zephyr/device.h>
#include <zephyr/drivers/can.h>
#include <zephyr/logging/log.h>

LOG_MODULE_REGISTER(vehicle_state_ecu, LOG_LEVEL_INF);

#if !defined(CONFIG_BOARD_NATIVE_SIM)
#error "examples/vehicle_state_ecu targets native_sim only -- see README.md"
#endif

/* =============================================================================
 * Configuration
 * ============================================================================= */

#define DIAG_CAN_DEV         DEVICE_DT_GET(DT_ALIAS(can0))
#define DIAG_RX_CAN_ID       ((uint32_t)GEN_CAN_RX_ID)   /* 0x7E0 */
#define DIAG_TX_CAN_ID       ((uint32_t)GEN_CAN_TX_ID)   /* 0x7E8 */

#ifndef CONFIG_DIAG_TASK_STACK_SIZE
#define CONFIG_DIAG_TASK_STACK_SIZE   (4096U)
#endif

#ifndef CONFIG_DIAG_TASK_PRIORITY
#define CONFIG_DIAG_TASK_PRIORITY     (5)
#endif

/* =============================================================================
 * Static allocations
 * ============================================================================= */

K_THREAD_STACK_DEFINE(s_diag_stack, CONFIG_DIAG_TASK_STACK_SIZE);
static struct k_thread s_diag_thread;

static diag_mutex_t s_session_lock;
static diag_mutex_t s_security_lock;
static diag_timer_t s_tick_timer;
static diag_wdt_t   s_wdt;

/* =============================================================================
 * ISO-TP RX completion callback
 *
 * Called by isotp_process_rx_frame() when a complete UDS PDU is reassembled.
 * Holds the session lock for the duration of dispatch + response transmission.
 * ============================================================================= */

static void on_isotp_rx_complete(
    const uint8_t *data,
    uint32_t       length,
    void          *arg)
{
    uds_server_ctx_t *srv = (uds_server_ctx_t *)arg;
    isotp_ctx_t      *tp  = uds_generated_get_isotp();

    /* Static buffers — no stack allocation of uds_msg_buf_t. */
    static uds_msg_buf_t s_req;
    static uds_msg_buf_t s_resp;

    uint16_t i;

    if ((data == NULL) || (srv == NULL) || (tp == NULL)) { return; }
    if ((length == 0U) || (length > (uint32_t)UDS_MAX_PAYLOAD_LEN)) { return; }

    (void)diag_mutex_lock(&s_session_lock);

    for (i = 0U; i < (uint16_t)length; i++) {
        s_req.data[i] = data[i];
    }
    s_req.length  = (uint16_t)length;
    s_resp.length = 0U;

    /* [EDS-toolchain#165] A functional request (ISO 15765-4) must not draw
     * the NRCs ISO 14229-1 Table 4 says to suppress. */
    uds_addressing_t addressing = UDS_ADDRESSING_PHYSICAL;
    (void)isotp_get_rx_addressing(tp, &addressing);
    (void)uds_server_process_request_ex(srv, &s_req, &s_resp, addressing);

    if (s_resp.length > 0U) {
        (void)isotp_transmit(tp, s_resp.data, s_resp.length);
    }

    (void)diag_mutex_unlock(&s_session_lock);

    /* [P2-0x11-01] Deferred reset: response is on the wire, now reset. */
    if (srv->pending_reset_type != (uint8_t)0U) {
        uint8_t reset_type = srv->pending_reset_type;
        srv->pending_reset_type = (uint8_t)0U;
        (void)zephyr_port_nvm_flush();
        k_msleep(50);  /* Allow ISO-TP TX to reach the wire before reset (As timer). */
        (void)zephyr_port_ecu_reset(reset_type);
        /* Does not return. */
    }
}

/* =============================================================================
 * 1 ms tick callback — drives ISO-TP and UDS session timers
 * ============================================================================= */

typedef struct { uds_server_ctx_t *srv; isotp_ctx_t *tp; } tick_ctx_t;

static void on_tick(void *arg)
{
    tick_ctx_t *ctx = (tick_ctx_t *)arg;
    if (ctx == NULL) { return; }
    (void)isotp_tick_1ms(ctx->tp);
    (void)uds_server_tick_1ms(ctx->srv);
    (void)uds_periodic_tick_1ms();
}

/* =============================================================================
 * Diagnostics task
 *
 * Folds vehicle_state_monitor_tick() into this same loop, on this same
 * thread, immediately after on_tick() — see vehicle_state.h for why that
 * matters (it's the thread that also dispatches the 0x2E writes to the two
 * input DIDs, and the generated DID backing stores have no locking of
 * their own).
 * ============================================================================= */

static void diag_task_entry(void *p1, void *p2, void *p3)
{
    uds_server_ctx_t *srv = (uds_server_ctx_t *)p1;
    can_transport_t  *can = (can_transport_t  *)p2;
    isotp_ctx_t      *tp  = (isotp_ctx_t      *)p3;

    uds_status_t    status;
    uds_can_frame_t rx_frame;
    bool            frame_ready;
    tick_ctx_t      tick_ctx = { .srv = srv, .tp = tp };

    LOG_INF("VehicleStateECU diag task started");

    if (diag_timer_start(&s_tick_timer) != UDS_STATUS_OK) {
        LOG_ERR("Timer start failed."); return;
    }

    while (true) {
        (void)diag_timer_wait_tick(&s_tick_timer, 2U);

        /* [EDS#558] Drain every queued frame, at most the queue depth. The Flow
         * Control BlockSize keeps a burst within the RX queue only if each
         * iteration empties it; one frame per tick loses CFs of long requests. */
        frame_ready = true;
        for (uint32_t rx_n = 0U;
             frame_ready && (rx_n < (uint32_t)EDS_CAN_RX_QUEUE_DEPTH); rx_n++) {
            frame_ready = false;
            status = can_transport_receive(can, &rx_frame, &frame_ready);
            if ((status == UDS_STATUS_OK) && frame_ready) {
                (void)isotp_process_rx_frame(tp, &rx_frame,
                                              on_isotp_rx_complete, srv);
            }
        }

        on_tick(&tick_ctx);
        vehicle_state_monitor_tick();

        {
            static uds_msg_buf_t s_periodic_frame;
            while (uds_periodic_pop_due(&s_periodic_frame) == UDS_STATUS_OK) {
                /* [EDS#546] A periodic message is a UUDT frame on its own CAN ID
                 * (ISO 14229-3 §8.5): it bypasses the ISO-TP channel, so it can
                 * go out while a multi-frame response is being sent.
                 * [EDS#194] Re-queue if the CAN driver refuses it instead of
                 * silently dropping this period; retry on the next 1ms tick and
                 * stop draining this tick. */
                if (isotp_transmit_uudt(tp, s_periodic_frame.data,
                                   (uint32_t)s_periodic_frame.length) != UDS_STATUS_OK) {
                    (void)uds_periodic_requeue_last();
                    break;
                }
            }
        }

        (void)diag_wdt_feed(&s_wdt);
    }
}

/* =============================================================================
 * Session change callback — cancels periodic subscriptions and releases any
 * held IndicatorLampCheck override on return to the Default session
 * (including on S3server timeout — a diagnostic client that holds an
 * actuator override and then disappears must not leave the output stuck).
 * ============================================================================= */

static void s_on_session_change(uds_session_type_t old_sess,
                                uds_session_type_t new_sess)
{
    (void)old_sess;
    if (new_sess == UDS_SESSION_DEFAULT) {
        (void)uds_periodic_cancel_all();
        vehicle_state_release_override();
    }
}

/* =============================================================================
 * main()
 * ============================================================================= */

int main(void)
{
    uds_status_t      status;
    can_transport_t  *can = NULL;
    uds_server_ctx_t *srv = NULL;
    isotp_ctx_t      *tp  = NULL;

    LOG_INF("Xaloqi EDS VehicleStateECU starting");

    vehicle_state_init();

    if (diag_mutex_init(&s_session_lock)  != UDS_STATUS_OK) { return -1; }
    if (diag_mutex_init(&s_security_lock) != UDS_STATUS_OK) { return -1; }

    (void)diag_wdt_init(&s_wdt);

    status = diag_timer_init(&s_tick_timer, on_tick, NULL);
    if (status != UDS_STATUS_OK) { LOG_ERR("Timer init failed."); return -1; }

    {
        const zephyr_port_cfg_t port_cfg = {
            .can_dev        = DIAG_CAN_DEV,
            .physical_rx_id = DIAG_RX_CAN_ID,   /* alongside the 0x7DF functional filter */
        };
        status = zephyr_port_init(&port_cfg, &can);
        if (status != UDS_STATUS_OK) {
            LOG_ERR("Platform init failed: 0x%02X", (unsigned)status);
            return -1;
        }
    }

    /* native_sim only (enforced above): RAM-backed mock NVM, no real flash
     * partition to resolve. See platform/zephyr/nvm_store_mock.c. */
    status = nvm_store_init(NULL);
    if (status != UDS_STATUS_OK) {
        LOG_ERR("NVM store init failed: 0x%02X — DTC mirror will not "
                "survive reset this run.", (unsigned)status);
    }

    /*
     * Security algorithm init — no TRNG on native_sim (CI / development
     * build). For production: call uds_security_algo_set_rng_cb() with a
     * real TRNG callback and uds_security_algo_set_level_key() with OEM
     * keys from OTP. See docs/SECURITY_NOTICE.md.
     */
    LOG_WRN("[SEC] Using placeholder AES keys — inject OEM keys before production.");
    (void)uds_security_algo_set_rng_cb(NULL);

    status = uds_generated_init(can, DIAG_RX_CAN_ID, DIAG_TX_CAN_ID);
    if (status != UDS_STATUS_OK) {
        LOG_ERR("UDS stack init failed: 0x%02X", (unsigned)status);
        return -1;
    }

    srv = uds_generated_get_server();
    tp  = uds_generated_get_isotp();
    if ((srv == NULL) || (tp == NULL)) {
        LOG_ERR("Stack context NULL after init."); return -1;
    }

    (void)uds_periodic_init();
    (void)uds_session_register_change_cb(srv->cfg.session_ctx,
                                          s_on_session_change);

    LOG_INF("UDS stack ready: %u DIDs  %u DTCs  RX=0x%03X TX=0x%03X",
            (unsigned)GEN_DID_COUNT, (unsigned)GEN_DTC_COUNT,
            (unsigned)DIAG_RX_CAN_ID, (unsigned)DIAG_TX_CAN_ID);

    (void)k_thread_create(
        &s_diag_thread, s_diag_stack,
        K_THREAD_STACK_SIZEOF(s_diag_stack),
        diag_task_entry,
        (void *)srv, (void *)can, (void *)tp,
        CONFIG_DIAG_TASK_PRIORITY, 0U, K_NO_WAIT
    );
    k_thread_name_set(&s_diag_thread, "diag_task");

    return 0;
}
```

## src/vehicle_state.c
```c
// SPDX-License-Identifier: Apache-2.0
// Copyright (c) 2026 Xaloqi
/*
 * =============================================================================
 * Xaloqi EDS
 * FILE: examples/vehicle_state_ecu/src/vehicle_state.c
 *
 * PURPOSE: Indicator state machine, DTC monitors, and RoutineControl bodies
 *          for VehicleStateECU. See vehicle_state.h for the threading note —
 *          everything in this file runs on the diag task thread only.
 *
 * INDICATOR STATES (stand in for the LED strip a plain vehicle-state demo
 * application would drive directly):
 *   0x00 IDLE    — engine 0 rpm, speed 0
 *   0x01 RUNNING — engine > 0 rpm, speed <= 5.0 km/h
 *   0x02 CRUISE  — speed > 5.0 km/h
 *   0x03 WARN    — either DTC monitor below is currently asserting a fault
 *   0x04 LAMPCHECK — IndicatorLampCheck (RID 0xC101) override is active;
 *                    not a state the ordinary state machine ever produces.
 *
 * DTC TRIGGERS (both evaluated every monitor tick, independently of any
 * active routine — a routine overrides what the output *shows*, never
 * whether a fault is detected):
 *
 *   U0100-00 "lost communication with engine control module" —
 *     engine_rpm pinned above VSE_ENGINE_RPM_IMPLAUSIBLE_MAX for
 *     VSE_DEBOUNCE_TICKS_U0100 consecutive ticks. Modelled as an
 *     out-of-range/pinned value rather than "value hasn't changed": this
 *     ECU's two inputs are tester-injected (there is no vehicle bus on
 *     native_sim), so an injected value holding steady is the NORMAL
 *     resting state between writes, not a fault signature — unlike
 *     examples/sensor_ecu, which has a real background sensor cycling a
 *     fresh value every tick and can legitimately treat "stopped changing"
 *     as "lost comms". Sustained out-of-range is the fault model that
 *     actually fits a write-injected signal.
 *
 *   P0500-64 "vehicle speed signal implausible against engine speed" —
 *     speed > VSE_SPEED_MOVING_KPH_X10_MIN (5.0 km/h) while engine_rpm == 0,
 *     for VSE_DEBOUNCE_TICKS_P0500 consecutive ticks. A genuinely
 *     cross-signal check: moving with the engine reading exactly stopped.
 *
 * SPDX-License-Identifier: Apache-2.0
 * =============================================================================
 */

#include "vehicle_state.h"

#include "did_handlers.h"      /* generated — did_read_vehiclestate_*() accessors */
#include "dtc_database.h"
#include "uds_types.h"

#include <zephyr/logging/log.h>

LOG_MODULE_REGISTER(vehicle_state, LOG_LEVEL_INF);

/* =============================================================================
 * Tunables
 * ============================================================================= */

/* Monitor tick cadence: vehicle_state_monitor_tick() is called once every
 * this many diag_task loop iterations. The loop iterates at ~1 ms (driven by
 * the 1 ms tick timer in src/main.c's on_tick()), so 100 ticks ~= 100 ms. */
#define VSE_MONITOR_TICK_DIVISOR        (100U)

#define VSE_ENGINE_RPM_IMPLAUSIBLE_MAX  (8000U)  /* above this: pinned/stuck */
#define VSE_SPEED_MOVING_KPH_X10_MIN    (50U)    /* 5.0 km/h, in 0.1 km/h units */

#define VSE_DEBOUNCE_TICKS_U0100        (5U)     /* ~500 ms at 100 ms/tick */
#define VSE_DEBOUNCE_TICKS_P0500        (10U)    /* ~1000 ms at 100 ms/tick */

#define VSE_DTC_U0100                   (0xC10000UL)
#define VSE_DTC_P0500                   (0x050064UL)

/* Indicator state byte values — also the wire-visible routine result bytes. */
#define VSE_STATE_IDLE                  (0x00U)
#define VSE_STATE_RUNNING                (0x01U)
#define VSE_STATE_CRUISE                 (0x02U)
#define VSE_STATE_WARN                   (0x03U)
#define VSE_STATE_LAMPCHECK              (0x04U)

#define VSE_SELFTEST_ACK_STARTED         (0x01U)  /* startRoutine response byte */
#define VSE_SELFTEST_RESULT_PASS         (0x00U)  /* requestResults byte 0 */
#define VSE_SELFTEST_RESULT_FAIL         (0x01U)
#define VSE_SELFTEST_RESULT_IN_PROGRESS  (0x02U)

#define VSE_SELFTEST_PATTERN_COUNT       (4U)     /* walks IDLE..WARN, one per tick */

/* =============================================================================
 * State — single-threaded (diag task only, see vehicle_state.h)
 * ============================================================================= */

static uint8_t  s_indicator_state;       /* last computed/reported state byte */
static bool     s_lampcheck_override;    /* RID 0xC101 override active */

static uint8_t  s_u0100_debounce;        /* consecutive ticks condition held */
static uint8_t  s_p0500_debounce;
static uint8_t  s_u0100_heal_debounce;
static uint8_t  s_p0500_heal_debounce;
static bool     s_u0100_active;
static bool     s_p0500_active;

static bool     s_selftest_active;
static uint8_t  s_selftest_step;         /* 0..VSE_SELFTEST_PATTERN_COUNT */
static uint8_t  s_selftest_patterns_tested; /* bitmask, bit per pattern walked */
static uint8_t  s_selftest_result;       /* valid once !s_selftest_active */

/* =============================================================================
 * Helpers
 * ============================================================================= */

static uint16_t vse_read_be16(did_read_cb_fn read_fn)
{
    uint8_t  buf[2];
    uint16_t out_len = 0U;

    if (read_fn(buf, (uint16_t)sizeof(buf), &out_len) != UDS_STATUS_OK) {
        return 0U;
    }
    if (out_len != (uint16_t)sizeof(buf)) {
        return 0U;
    }
    return (uint16_t)(((uint16_t)buf[0] << 8U) | (uint16_t)buf[1]);
}

static uint8_t vse_compute_state(uint16_t engine_rpm, uint16_t speed_kph_x10,
                                  bool any_dtc_active)
{
    if (any_dtc_active) {
        return VSE_STATE_WARN;
    }
    if (speed_kph_x10 > (uint16_t)VSE_SPEED_MOVING_KPH_X10_MIN) {
        return VSE_STATE_CRUISE;
    }
    if (engine_rpm > 0U) {
        return VSE_STATE_RUNNING;
    }
    return VSE_STATE_IDLE;
}

/* =============================================================================
 * Public API
 * ============================================================================= */

void vehicle_state_init(void)
{
    s_indicator_state         = VSE_STATE_IDLE;
    s_lampcheck_override       = false;
    s_u0100_debounce            = 0U;
    s_p0500_debounce            = 0U;
    s_u0100_heal_debounce       = 0U;
    s_p0500_heal_debounce       = 0U;
    s_u0100_active              = false;
    s_p0500_active              = false;
    s_selftest_active            = false;
    s_selftest_step              = 0U;
    s_selftest_patterns_tested   = 0U;
    s_selftest_result            = VSE_SELFTEST_RESULT_PASS;
}

void vehicle_state_monitor_tick(void)
{
    static uint32_t s_divisor_count;
    uint16_t engine_rpm;
    uint16_t speed_kph_x10;
    bool     any_dtc_active;
    uint8_t  new_state;

    s_divisor_count++;
    if ((s_divisor_count % VSE_MONITOR_TICK_DIVISOR) != 0U) {
        return;
    }

    engine_rpm    = vse_read_be16(did_read_vehiclestate_enginespeed_rpm);
    speed_kph_x10 = vse_read_be16(did_read_vehiclestate_vehiclespeed_kph);

    /* ── U0100-00: engine signal pinned above the plausible range ──────── */
    if (engine_rpm > (uint16_t)VSE_ENGINE_RPM_IMPLAUSIBLE_MAX) {
        s_u0100_heal_debounce = 0U;
        if (s_u0100_debounce < (uint8_t)VSE_DEBOUNCE_TICKS_U0100) {
            s_u0100_debounce++;
        }
        if ((!s_u0100_active) && (s_u0100_debounce >= (uint8_t)VSE_DEBOUNCE_TICKS_U0100)) {
            s_u0100_active = true;
            LOG_WRN("DTC U0100-00 set: engine_rpm=%u exceeds plausible max", engine_rpm);
            (void)dtc_database_set_status(VSE_DTC_U0100,
                (uint8_t)(DTC_STATUS_TEST_FAILED |
                          DTC_STATUS_TEST_FAILED_THIS_OPERATION_CYCLE |
                          DTC_STATUS_CONFIRMED_DTC));
        }
    } else {
        s_u0100_debounce = 0U;
        if (s_u0100_heal_debounce < (uint8_t)VSE_DEBOUNCE_TICKS_U0100) {
            s_u0100_heal_debounce++;
        }
        if (s_u0100_active && (s_u0100_heal_debounce >= (uint8_t)VSE_DEBOUNCE_TICKS_U0100)) {
            s_u0100_active = false;
            LOG_INF("DTC U0100-00 cleared: engine_rpm=%u back in range", engine_rpm);
            (void)dtc_database_set_status(VSE_DTC_U0100, (uint8_t)0x00U);
        }
    }
    (void)dtc_database_set_fault_counter(VSE_DTC_U0100, s_u0100_debounce);

    /* ── P0500-64: moving with the engine reading exactly stopped ──────── */
    if ((speed_kph_x10 > (uint16_t)VSE_SPEED_MOVING_KPH_X10_MIN) && (engine_rpm == 0U)) {
        s_p0500_heal_debounce = 0U;
        if (s_p0500_debounce < (uint8_t)VSE_DEBOUNCE_TICKS_P0500) {
            s_p0500_debounce++;
        }
        if ((!s_p0500_active) && (s_p0500_debounce >= (uint8_t)VSE_DEBOUNCE_TICKS_P0500)) {
            s_p0500_active = true;
            LOG_WRN("DTC P0500-64 set: speed=%u (0.1 km/h) with engine_rpm=0", speed_kph_x10);
            (void)dtc_database_set_status(VSE_DTC_P0500,
                (uint8_t)(DTC_STATUS_TEST_FAILED |
                          DTC_STATUS_TEST_FAILED_THIS_OPERATION_CYCLE |
                          DTC_STATUS_CONFIRMED_DTC |
                          DTC_STATUS_WARNING_INDICATOR_REQUESTED));
        }
    } else {
        s_p0500_debounce = 0U;
        if (s_p0500_heal_debounce < (uint8_t)VSE_DEBOUNCE_TICKS_P0500) {
            s_p0500_heal_debounce++;
        }
        if (s_p0500_active && (s_p0500_heal_debounce >= (uint8_t)VSE_DEBOUNCE_TICKS_P0500)) {
            s_p0500_active = false;
            LOG_INF("DTC P0500-64 cleared: plausible again");
            (void)dtc_database_set_status(VSE_DTC_P0500, (uint8_t)0x00U);
        }
    }
    (void)dtc_database_set_fault_counter(VSE_DTC_P0500, s_p0500_debounce);

    any_dtc_active = s_u0100_active || s_p0500_active;

    /* ── Self-test walk: steps the output through all patterns regardless
     * of what the ordinary state machine would currently show. ────────── */
    if (s_selftest_active) {
        s_selftest_patterns_tested |= (uint8_t)(1U << s_selftest_step);
        /* native_sim: no physical driver feedback exists; synthesised as
         * always-healthy. On real hardware, read the actuator driver's
         * fault/feedback line here and fold a failure into s_selftest_result. */
        s_selftest_step++;
        if (s_selftest_step >= (uint8_t)VSE_SELFTEST_PATTERN_COUNT) {
            s_selftest_active = false;
            s_selftest_result = VSE_SELFTEST_RESULT_PASS;
            LOG_INF("Self-test walk complete: patterns_tested=0x%02X result=PASS",
                    s_selftest_patterns_tested);
        }
        new_state = s_selftest_step % (uint8_t)VSE_SELFTEST_PATTERN_COUNT;
    } else if (s_lampcheck_override) {
        new_state = VSE_STATE_LAMPCHECK;
    } else {
        new_state = vse_compute_state(engine_rpm, speed_kph_x10, any_dtc_active);
    }

    if (new_state != s_indicator_state) {
        LOG_INF("Indicator: 0x%02X -> 0x%02X (engine=%u rpm, speed=%u.%u km/h)",
                s_indicator_state, new_state,
                engine_rpm, (unsigned)(speed_kph_x10 / 10U), (unsigned)(speed_kph_x10 % 10U));
        s_indicator_state = new_state;
    }
}

void vehicle_state_release_override(void)
{
    if (s_lampcheck_override) {
        LOG_INF("IndicatorLampCheck override released (session returned to Default)");
        s_lampcheck_override = false;
    }
}

uds_status_t vehicle_state_selftest_start(
    uint8_t *result_buf, uint8_t result_buf_len, uint8_t *result_len)
{
    if ((result_buf == NULL) || (result_len == NULL)) {
        return UDS_STATUS_ERR_NULL_PTR;
    }
    if (result_buf_len < (uint8_t)1U) {
        return UDS_STATUS_ERR_BUFFER_OVERFLOW;
    }

    s_selftest_active          = true;
    s_selftest_step             = 0U;
    s_selftest_patterns_tested  = 0U;
    s_selftest_result           = VSE_SELFTEST_RESULT_IN_PROGRESS;

    result_buf[0] = (uint8_t)VSE_SELFTEST_ACK_STARTED;
    *result_len   = 1U;
    return UDS_STATUS_OK;
}

uds_status_t vehicle_state_selftest_results(
    uint8_t *result_buf, uint8_t result_buf_len, uint8_t *result_len)
{
    if ((result_buf == NULL) || (result_len == NULL)) {
        return UDS_STATUS_ERR_NULL_PTR;
    }
    if (result_buf_len < (uint8_t)3U) {
        return UDS_STATUS_ERR_BUFFER_OVERFLOW;
    }

    result_buf[0] = s_selftest_active ? (uint8_t)VSE_SELFTEST_RESULT_IN_PROGRESS
                                       : s_selftest_result;
    result_buf[1] = s_selftest_patterns_tested;
    result_buf[2] = s_indicator_state;
    *result_len   = 3U;
    return UDS_STATUS_OK;
}

uds_status_t vehicle_state_lampcheck_start(
    uint8_t *result_buf, uint8_t result_buf_len, uint8_t *result_len)
{
    if ((result_buf == NULL) || (result_len == NULL)) {
        return UDS_STATUS_ERR_NULL_PTR;
    }
    if (result_buf_len < (uint8_t)1U) {
        return UDS_STATUS_ERR_BUFFER_OVERFLOW;
    }

    s_lampcheck_override = true;
    LOG_INF("IndicatorLampCheck: override engaged, holding pattern 0x%02X",
            (unsigned)VSE_STATE_LAMPCHECK);

    result_buf[0] = (uint8_t)VSE_STATE_LAMPCHECK;
    *result_len   = 1U;
    return UDS_STATUS_OK;
}

uds_status_t vehicle_state_lampcheck_stop(
    uint8_t *result_buf, uint8_t result_buf_len, uint8_t *result_len)
{
    if ((result_buf == NULL) || (result_len == NULL)) {
        return UDS_STATUS_ERR_NULL_PTR;
    }
    if (result_buf_len < (uint8_t)1U) {
        return UDS_STATUS_ERR_BUFFER_OVERFLOW;
    }

    vehicle_state_release_override();

    result_buf[0] = s_indicator_state;
    *result_len   = 1U;
    return UDS_STATUS_OK;
}
```

## src/vehicle_state.h
```c
// SPDX-License-Identifier: Apache-2.0
// Copyright (c) 2026 Xaloqi
/*
 * =============================================================================
 * Xaloqi EDS
 * FILE: examples/vehicle_state_ecu/src/vehicle_state.h
 *
 * PURPOSE: Application logic for VehicleStateECU — the indicator output
 *          state machine, the two DTC monitors, and the C bodies behind the
 *          RoutineControl actuation path (RID 0xC100 / 0xC101).
 *
 *          This is the *diagnostics layer* a plain vehicle-state demo
 *          application (two inputs -> one visual output) does not have.
 *
 * THREADING: vehicle_state_monitor_tick() is called from diag_task_entry()'s
 *          own loop in src/main.c — the SAME thread that dispatches UDS
 *          requests (including the 0x2E writes to the two input DIDs). This
 *          is deliberate: generated/did_handlers.c's backing stores have no
 *          locking of their own (every shipped example assumes single-
 *          threaded access from the diag task), so calling the generated
 *          did_read_*() accessors from a second thread — the pattern
 *          examples/sensor_ecu uses for its own monitor — would race against
 *          the UDS dispatch thread's did_write_*() calls on the same static
 *          arrays. Folding the monitor into the existing tick avoids that
 *          race without touching generated/did_handlers.c at all.
 * =============================================================================
 */

#ifndef VEHICLE_STATE_H
#define VEHICLE_STATE_H

#include "uds_types.h"

#ifdef __cplusplus
extern "C" {
#endif

/**
 * @brief One-time initialisation. Call once from main() before the diag
 *        task starts.
 */
void vehicle_state_init(void);

/**
 * @brief Monitor + indicator tick. Call once every ~100 ms from
 *        diag_task_entry()'s loop (see src/main.c).
 *
 * Reads the two vehicle-state DIDs back through their generated accessors
 * (did_read_vehiclestate_enginespeed_rpm / did_read_vehiclestate_vehiclespeed_kph
 * — the same backing store a tester's 0x2E write lands in), runs the two
 * DTC monitors, and steps the indicator state machine.
 */
void vehicle_state_monitor_tick(void);

/**
 * @brief Release an active IndicatorLampCheck override, if one is active.
 *
 * Call from the UDS session-change callback on transition to the Default
 * session (including on S3server timeout) — a diagnostic client that holds
 * an actuator override and then disappears must not leave the output
 * stuck. See src/main.c's s_on_session_change().
 */
void vehicle_state_release_override(void);

/* --------------------------------------------------------------------------
 * RoutineControl bodies — called from generated/routine_handlers.c's four
 * stub bodies (the one hand-edited "generated/ delta" this example makes;
 * see CMakeLists.txt and the banner at the top of that file).
 * -------------------------------------------------------------------------- */

/** RID 0xC100 startRoutine — begin the asynchronous output self-test walk. */
uds_status_t vehicle_state_selftest_start(
    uint8_t *result_buf, uint8_t result_buf_len, uint8_t *result_len);

/** RID 0xC100 requestRoutineResults — poll the self-test walk's verdict. */
uds_status_t vehicle_state_selftest_results(
    uint8_t *result_buf, uint8_t result_buf_len, uint8_t *result_len);

/** RID 0xC101 startRoutine — take over the output, hold the lamp-check pattern. */
uds_status_t vehicle_state_lampcheck_start(
    uint8_t *result_buf, uint8_t result_buf_len, uint8_t *result_len);

/** RID 0xC101 stopRoutine — release the override, resume the state machine. */
uds_status_t vehicle_state_lampcheck_stop(
    uint8_t *result_buf, uint8_t result_buf_len, uint8_t *result_len);

#ifdef __cplusplus
}
#endif

#endif /* VEHICLE_STATE_H */
```
