/*
 * =============================================================================
 * GENERATED — do NOT edit manually.
 * Regenerate: python3 tools/testgen.py --capl \
 *                 --config <diagnostics_config.yaml> --out generated/
 *
 * ECU       : ARDEP_IOController
 * Version   : 1.0.0
 * Generated : 2026-05-19T13:51:10Z
 *
 * FILE: test_did_f197.can
 *
 * DID       : 0xF197  (SystemSupplierIdentifierDataIdentifier)
 * Access    : read
 * Session   : default (ordinal 1)
 * Read sec  : 0 (no auth required)
 * Write sec : 0 (no auth required)
 * Bytes     : 5
 *
 * PURPOSE: Exhaustive CAPL test cases for DID 0xF197:
 *   TC_F197_Read_HappyPath      — positive read, correct response
 *   TC_F197_Read_ResponseEcho   — DID echo bytes in response
 *   TC_F197_Read_ResponseLen    — data length = 5 bytes
 *   TC_F197_Read_MultipleTimes  — stability: 5 consecutive reads
 *
 * SPDX-License-Identifier: Apache-2.0
 * =============================================================================
 */

includes
{
  /* Include master suite for shared variables, helpers, and ISO-TP layer */
}

/* ── DID constants ───────────────────────────────────────────────────────── */
variables
{
  const word  kDid_F197            = 61847;
  const byte  kDid_F197_Hi        = 0xF1;
  const byte  kDid_F197_Lo        = 0x97;
  const dword kDid_F197_DataLen   = 5;
  const int   kDid_F197_RespLen   = 8;  /* 0x62 + DID_HI + DID_LO + data */
  const int   kDid_F197_MinSess   = 1;
  const int   kDid_F197_RSec      = 0;
  const int   kDid_F197_WSec      = 0;
}

/* ── Precondition helper for this DID ────────────────────────────────────── */

/*
 * SetupRead_F197 — enter required session and security level for a read.
 * Returns 1 on success, 0 if setup failed.
 */
int SetupRead_F197()
{
  if (!Uds_EnterSession(kSessDefault))     return 0;
  return 1;
}



/* ═══════════════════════════════════════════════════════════════════════════
 *  READ TEST CASES
 * ═══════════════════════════════════════════════════════════════════════════ */

/*
 * TC_F197_Read_HappyPath
 * Verify positive ReadDataByIdentifier response for DID 0xF197.
 */
testcase TC_F197_Read_HappyPath()
{
  int rc;
  TestCaseDescription(
    "DID 0xF197 (SystemSupplierIdentifierDataIdentifier) — ReadDataByIdentifier happy path");

  if (!SetupRead_F197()) {
    TestCaseFail("Precondition setup failed");
    return;
  }

  rc = Uds_ReadDid(kDid_F197_Hi,
                   kDid_F197_Lo);

  AssertPositiveResponse(rc, kSidRDBI, "RDBI_0xF197_PositiveResponse");
  Uds_EnterSession(kSessDefault);
}

/*
 * TC_F197_Read_ResponseEcho
 * Verify response echoes DID bytes 0xF1, 0x97.
 */
testcase TC_F197_Read_ResponseEcho()
{
  int rc;
  TestCaseDescription(
    "DID 0xF197 (SystemSupplierIdentifierDataIdentifier) — response echoes DID bytes at positions [1],[2]");

  if (!SetupRead_F197()) {
    TestCaseFail("Precondition setup failed");
    return;
  }

  rc = Uds_ReadDid(kDid_F197_Hi,
                   kDid_F197_Lo);

  if (rc < 3) {
    TestStepFail("RDBI_0xF197_Echo", "Response too short: %d bytes", rc);
    gTestFailCount++;
  } else if (gRxBuf[1] != kDid_F197_Hi ||
             gRxBuf[2] != kDid_F197_Lo) {
    TestStepFail("RDBI_0xF197_Echo",
      "DID echo mismatch: got 0x%02X%02X, expected 0xF197",
      gRxBuf[1], gRxBuf[2]);
    gTestFailCount++;
  } else {
    TestStepPass("RDBI_0xF197_Echo",
      "DID echo correct: 0x%02X%02X", gRxBuf[1], gRxBuf[2]);
    gTestPassCount++;
  }
  Uds_EnterSession(kSessDefault);
}

/*
 * TC_F197_Read_ResponseLen
 * Verify data payload = 5 bytes (total response = 8 bytes).
 */
testcase TC_F197_Read_ResponseLen()
{
  int rc;
  TestCaseDescription(
    "DID 0xF197 (SystemSupplierIdentifierDataIdentifier) — response data length = 5 bytes");

  if (!SetupRead_F197()) {
    TestCaseFail("Precondition setup failed");
    return;
  }

  rc = Uds_ReadDid(kDid_F197_Hi,
                   kDid_F197_Lo);

  if (rc > 0 && gRxBuf[0] == (byte)(kSidRDBI + kPosDelta)) {
    AssertResponseLength(gRxLen,
      kDid_F197_RespLen,
      "RDBI_0xF197_ResponseLength");
  } else {
    TestStepFail("RDBI_0xF197_ResponseLength",
      "Cannot check length — no positive response");
    gTestFailCount++;
  }
  Uds_EnterSession(kSessDefault);
}



/*
 * TC_F197_Read_MultipleTimes
 * Verify DID 0xF197 responds consistently across 5 consecutive reads.
 * Detects: race conditions, buffer reuse bugs, handler side-effects.
 */
testcase TC_F197_Read_MultipleTimes()
{
  int   rc;
  int   i;
  int   failCount;
  dword firstLen;
  TestCaseDescription(
    "DID 0xF197 (SystemSupplierIdentifierDataIdentifier) — 5 consecutive reads, consistent responses");

  if (!SetupRead_F197()) {
    TestCaseFail("Precondition setup failed");
    return;
  }

  failCount = 0;
  firstLen  = 0;

  for (i = 0; i < 5; i++) {
    rc = Uds_ReadDid(kDid_F197_Hi,
                     kDid_F197_Lo);
    if (rc < 0 || gRxBuf[0] != (byte)(kSidRDBI + kPosDelta)) {
      failCount++;
      TestStepFail("RDBI_0xF197_Multi",
        "Read %d of 5 failed: rc=%d NRC=0x%02X", i+1, rc,
        (rc >= 3) ? gRxBuf[2] : 0xFF);
    } else {
      if (i == 0) {
        firstLen = gRxLen;
      } else if (gRxLen != firstLen) {
        failCount++;
        TestStepFail("RDBI_0xF197_Multi",
          "Read %d length %d != first read length %d", i+1, gRxLen, firstLen);
      }
    }
    testWaitForDelay(5);   /* 5 ms gap between consecutive requests */
  }

  if (failCount == 0) {
    TestStepPass("RDBI_0xF197_Multi",
      "All 5 reads successful, consistent length %d bytes", firstLen);
    gTestPassCount++;
  } else {
    gTestFailCount++;
  }
  Uds_EnterSession(kSessDefault);
}
  /* access_read */


/* ═══════════════════════════════════════════════════════════════════════════
 *  WRITE TEST CASES
 * ═══════════════════════════════════════════════════════════════════════════ */

  /* access_write */


/* ═══════════════════════════════════════════════════════════════════════════
 *  DID TEST GROUP
 *  Call this from the master test suite's maintest.
 * ═══════════════════════════════════════════════════════════════════════════ */

testgroup TG_DID_F197()
{
  TestGroupDescription(
    "DID 0xF197 — SystemSupplierIdentifierDataIdentifier | R | 5 bytes | default session | R-sec=0 W-sec=0");

  TC_F197_Read_HappyPath();
  TC_F197_Read_ResponseEcho();
  TC_F197_Read_ResponseLen();
  TC_F197_Read_MultipleTimes();
}
