/*
 * =============================================================================
 * GENERATED — do NOT edit manually.
 * Regenerate: python3 tools/testgen.py --capl \
 *                 --config <diagnostics_config.yaml> --out generated/
 *
 * ECU       : ARDEP_IOController
 * Version   : 1.0.0
 * Generated : 2026-05-19T13:51:10Z
 *
 * FILE: test_did_2306.can
 *
 * DID       : 0x2306  (ECU_DiagnosticStackVersion)
 * Access    : read
 * Session   : default (ordinal 1)
 * Read sec  : 0 (no auth required)
 * Write sec : 0 (no auth required)
 * Bytes     : 3
 *
 * PURPOSE: Exhaustive CAPL test cases for DID 0x2306:
 *   TC_2306_Read_HappyPath      — positive read, correct response
 *   TC_2306_Read_ResponseEcho   — DID echo bytes in response
 *   TC_2306_Read_ResponseLen    — data length = 3 bytes
 *   TC_2306_Read_MultipleTimes  — stability: 5 consecutive reads
 *
 * SPDX-License-Identifier: Apache-2.0
 * =============================================================================
 */

includes
{
  /* Include master suite for shared variables, helpers, and ISO-TP layer */
}

/* ── DID constants ───────────────────────────────────────────────────────── */
variables
{
  const word  kDid_2306            = 8966;
  const byte  kDid_2306_Hi        = 0x23;
  const byte  kDid_2306_Lo        = 0x06;
  const dword kDid_2306_DataLen   = 3;
  const int   kDid_2306_RespLen   = 6;  /* 0x62 + DID_HI + DID_LO + data */
  const int   kDid_2306_MinSess   = 1;
  const int   kDid_2306_RSec      = 0;
  const int   kDid_2306_WSec      = 0;
}

/* ── Precondition helper for this DID ────────────────────────────────────── */

/*
 * SetupRead_2306 — enter required session and security level for a read.
 * Returns 1 on success, 0 if setup failed.
 */
int SetupRead_2306()
{
  if (!Uds_EnterSession(kSessDefault))     return 0;
  return 1;
}



/* ═══════════════════════════════════════════════════════════════════════════
 *  READ TEST CASES
 * ═══════════════════════════════════════════════════════════════════════════ */

/*
 * TC_2306_Read_HappyPath
 * Verify positive ReadDataByIdentifier response for DID 0x2306.
 */
testcase TC_2306_Read_HappyPath()
{
  int rc;
  TestCaseDescription(
    "DID 0x2306 (ECU_DiagnosticStackVersion) — ReadDataByIdentifier happy path");

  if (!SetupRead_2306()) {
    TestCaseFail("Precondition setup failed");
    return;
  }

  rc = Uds_ReadDid(kDid_2306_Hi,
                   kDid_2306_Lo);

  AssertPositiveResponse(rc, kSidRDBI, "RDBI_0x2306_PositiveResponse");
  Uds_EnterSession(kSessDefault);
}

/*
 * TC_2306_Read_ResponseEcho
 * Verify response echoes DID bytes 0x23, 0x06.
 */
testcase TC_2306_Read_ResponseEcho()
{
  int rc;
  TestCaseDescription(
    "DID 0x2306 (ECU_DiagnosticStackVersion) — response echoes DID bytes at positions [1],[2]");

  if (!SetupRead_2306()) {
    TestCaseFail("Precondition setup failed");
    return;
  }

  rc = Uds_ReadDid(kDid_2306_Hi,
                   kDid_2306_Lo);

  if (rc < 3) {
    TestStepFail("RDBI_0x2306_Echo", "Response too short: %d bytes", rc);
    gTestFailCount++;
  } else if (gRxBuf[1] != kDid_2306_Hi ||
             gRxBuf[2] != kDid_2306_Lo) {
    TestStepFail("RDBI_0x2306_Echo",
      "DID echo mismatch: got 0x%02X%02X, expected 0x2306",
      gRxBuf[1], gRxBuf[2]);
    gTestFailCount++;
  } else {
    TestStepPass("RDBI_0x2306_Echo",
      "DID echo correct: 0x%02X%02X", gRxBuf[1], gRxBuf[2]);
    gTestPassCount++;
  }
  Uds_EnterSession(kSessDefault);
}

/*
 * TC_2306_Read_ResponseLen
 * Verify data payload = 3 bytes (total response = 6 bytes).
 */
testcase TC_2306_Read_ResponseLen()
{
  int rc;
  TestCaseDescription(
    "DID 0x2306 (ECU_DiagnosticStackVersion) — response data length = 3 bytes");

  if (!SetupRead_2306()) {
    TestCaseFail("Precondition setup failed");
    return;
  }

  rc = Uds_ReadDid(kDid_2306_Hi,
                   kDid_2306_Lo);

  if (rc > 0 && gRxBuf[0] == (byte)(kSidRDBI + kPosDelta)) {
    AssertResponseLength(gRxLen,
      kDid_2306_RespLen,
      "RDBI_0x2306_ResponseLength");
  } else {
    TestStepFail("RDBI_0x2306_ResponseLength",
      "Cannot check length — no positive response");
    gTestFailCount++;
  }
  Uds_EnterSession(kSessDefault);
}



/*
 * TC_2306_Read_MultipleTimes
 * Verify DID 0x2306 responds consistently across 5 consecutive reads.
 * Detects: race conditions, buffer reuse bugs, handler side-effects.
 */
testcase TC_2306_Read_MultipleTimes()
{
  int   rc;
  int   i;
  int   failCount;
  dword firstLen;
  TestCaseDescription(
    "DID 0x2306 (ECU_DiagnosticStackVersion) — 5 consecutive reads, consistent responses");

  if (!SetupRead_2306()) {
    TestCaseFail("Precondition setup failed");
    return;
  }

  failCount = 0;
  firstLen  = 0;

  for (i = 0; i < 5; i++) {
    rc = Uds_ReadDid(kDid_2306_Hi,
                     kDid_2306_Lo);
    if (rc < 0 || gRxBuf[0] != (byte)(kSidRDBI + kPosDelta)) {
      failCount++;
      TestStepFail("RDBI_0x2306_Multi",
        "Read %d of 5 failed: rc=%d NRC=0x%02X", i+1, rc,
        (rc >= 3) ? gRxBuf[2] : 0xFF);
    } else {
      if (i == 0) {
        firstLen = gRxLen;
      } else if (gRxLen != firstLen) {
        failCount++;
        TestStepFail("RDBI_0x2306_Multi",
          "Read %d length %d != first read length %d", i+1, gRxLen, firstLen);
      }
    }
    testWaitForDelay(5);   /* 5 ms gap between consecutive requests */
  }

  if (failCount == 0) {
    TestStepPass("RDBI_0x2306_Multi",
      "All 5 reads successful, consistent length %d bytes", firstLen);
    gTestPassCount++;
  } else {
    gTestFailCount++;
  }
  Uds_EnterSession(kSessDefault);
}
  /* access_read */


/* ═══════════════════════════════════════════════════════════════════════════
 *  WRITE TEST CASES
 * ═══════════════════════════════════════════════════════════════════════════ */

  /* access_write */


/* ═══════════════════════════════════════════════════════════════════════════
 *  DID TEST GROUP
 *  Call this from the master test suite's maintest.
 * ═══════════════════════════════════════════════════════════════════════════ */

testgroup TG_DID_2306()
{
  TestGroupDescription(
    "DID 0x2306 — ECU_DiagnosticStackVersion | R | 3 bytes | default session | R-sec=0 W-sec=0");

  TC_2306_Read_HappyPath();
  TC_2306_Read_ResponseEcho();
  TC_2306_Read_ResponseLen();
  TC_2306_Read_MultipleTimes();
}
