/*
 * =============================================================================
 * GENERATED — do NOT edit manually.
 * Regenerate: python3 tools/testgen.py --capl \
 *                 --config <diagnostics_config.yaml> --out generated/
 *
 * ECU       : ARDEP_IOController
 * Version   : 1.0.0
 * Generated : 2026-05-19T13:51:10Z
 *
 * FILE: test_did_f18c.can
 *
 * DID       : 0xF18C  (ECUSerialNumber)
 * Access    : read
 * Session   : default (ordinal 1)
 * Read sec  : 0 (no auth required)
 * Write sec : 1 (SecurityAccess level 1 required)
 * Bytes     : 8
 *
 * PURPOSE: Exhaustive CAPL test cases for DID 0xF18C:
 *   TC_F18C_Read_HappyPath      — positive read, correct response
 *   TC_F18C_Read_ResponseEcho   — DID echo bytes in response
 *   TC_F18C_Read_ResponseLen    — data length = 8 bytes
 *   TC_F18C_Read_MultipleTimes  — stability: 5 consecutive reads
 *
 * SPDX-License-Identifier: Apache-2.0
 * =============================================================================
 */

includes
{
  /* Include master suite for shared variables, helpers, and ISO-TP layer */
}

/* ── DID constants ───────────────────────────────────────────────────────── */
variables
{
  const word  kDid_F18C            = 61836;
  const byte  kDid_F18C_Hi        = 0xF1;
  const byte  kDid_F18C_Lo        = 0x8C;
  const dword kDid_F18C_DataLen   = 8;
  const int   kDid_F18C_RespLen   = 11;  /* 0x62 + DID_HI + DID_LO + data */
  const int   kDid_F18C_MinSess   = 1;
  const int   kDid_F18C_RSec      = 0;
  const int   kDid_F18C_WSec      = 1;
}

/* ── Precondition helper for this DID ────────────────────────────────────── */

/*
 * SetupRead_F18C — enter required session and security level for a read.
 * Returns 1 on success, 0 if setup failed.
 */
int SetupRead_F18C()
{
  if (!Uds_EnterSession(kSessDefault))     return 0;
  return 1;
}



/* ═══════════════════════════════════════════════════════════════════════════
 *  READ TEST CASES
 * ═══════════════════════════════════════════════════════════════════════════ */

/*
 * TC_F18C_Read_HappyPath
 * Verify positive ReadDataByIdentifier response for DID 0xF18C.
 */
testcase TC_F18C_Read_HappyPath()
{
  int rc;
  TestCaseDescription(
    "DID 0xF18C (ECUSerialNumber) — ReadDataByIdentifier happy path");

  if (!SetupRead_F18C()) {
    TestCaseFail("Precondition setup failed");
    return;
  }

  rc = Uds_ReadDid(kDid_F18C_Hi,
                   kDid_F18C_Lo);

  AssertPositiveResponse(rc, kSidRDBI, "RDBI_0xF18C_PositiveResponse");
  Uds_EnterSession(kSessDefault);
}

/*
 * TC_F18C_Read_ResponseEcho
 * Verify response echoes DID bytes 0xF1, 0x8C.
 */
testcase TC_F18C_Read_ResponseEcho()
{
  int rc;
  TestCaseDescription(
    "DID 0xF18C (ECUSerialNumber) — response echoes DID bytes at positions [1],[2]");

  if (!SetupRead_F18C()) {
    TestCaseFail("Precondition setup failed");
    return;
  }

  rc = Uds_ReadDid(kDid_F18C_Hi,
                   kDid_F18C_Lo);

  if (rc < 3) {
    TestStepFail("RDBI_0xF18C_Echo", "Response too short: %d bytes", rc);
    gTestFailCount++;
  } else if (gRxBuf[1] != kDid_F18C_Hi ||
             gRxBuf[2] != kDid_F18C_Lo) {
    TestStepFail("RDBI_0xF18C_Echo",
      "DID echo mismatch: got 0x%02X%02X, expected 0xF18C",
      gRxBuf[1], gRxBuf[2]);
    gTestFailCount++;
  } else {
    TestStepPass("RDBI_0xF18C_Echo",
      "DID echo correct: 0x%02X%02X", gRxBuf[1], gRxBuf[2]);
    gTestPassCount++;
  }
  Uds_EnterSession(kSessDefault);
}

/*
 * TC_F18C_Read_ResponseLen
 * Verify data payload = 8 bytes (total response = 11 bytes).
 */
testcase TC_F18C_Read_ResponseLen()
{
  int rc;
  TestCaseDescription(
    "DID 0xF18C (ECUSerialNumber) — response data length = 8 bytes");

  if (!SetupRead_F18C()) {
    TestCaseFail("Precondition setup failed");
    return;
  }

  rc = Uds_ReadDid(kDid_F18C_Hi,
                   kDid_F18C_Lo);

  if (rc > 0 && gRxBuf[0] == (byte)(kSidRDBI + kPosDelta)) {
    AssertResponseLength(gRxLen,
      kDid_F18C_RespLen,
      "RDBI_0xF18C_ResponseLength");
  } else {
    TestStepFail("RDBI_0xF18C_ResponseLength",
      "Cannot check length — no positive response");
    gTestFailCount++;
  }
  Uds_EnterSession(kSessDefault);
}



/*
 * TC_F18C_Read_MultipleTimes
 * Verify DID 0xF18C responds consistently across 5 consecutive reads.
 * Detects: race conditions, buffer reuse bugs, handler side-effects.
 */
testcase TC_F18C_Read_MultipleTimes()
{
  int   rc;
  int   i;
  int   failCount;
  dword firstLen;
  TestCaseDescription(
    "DID 0xF18C (ECUSerialNumber) — 5 consecutive reads, consistent responses");

  if (!SetupRead_F18C()) {
    TestCaseFail("Precondition setup failed");
    return;
  }

  failCount = 0;
  firstLen  = 0;

  for (i = 0; i < 5; i++) {
    rc = Uds_ReadDid(kDid_F18C_Hi,
                     kDid_F18C_Lo);
    if (rc < 0 || gRxBuf[0] != (byte)(kSidRDBI + kPosDelta)) {
      failCount++;
      TestStepFail("RDBI_0xF18C_Multi",
        "Read %d of 5 failed: rc=%d NRC=0x%02X", i+1, rc,
        (rc >= 3) ? gRxBuf[2] : 0xFF);
    } else {
      if (i == 0) {
        firstLen = gRxLen;
      } else if (gRxLen != firstLen) {
        failCount++;
        TestStepFail("RDBI_0xF18C_Multi",
          "Read %d length %d != first read length %d", i+1, gRxLen, firstLen);
      }
    }
    testWaitForDelay(5);   /* 5 ms gap between consecutive requests */
  }

  if (failCount == 0) {
    TestStepPass("RDBI_0xF18C_Multi",
      "All 5 reads successful, consistent length %d bytes", firstLen);
    gTestPassCount++;
  } else {
    gTestFailCount++;
  }
  Uds_EnterSession(kSessDefault);
}
  /* access_read */


/* ═══════════════════════════════════════════════════════════════════════════
 *  WRITE TEST CASES
 * ═══════════════════════════════════════════════════════════════════════════ */

  /* access_write */


/* ═══════════════════════════════════════════════════════════════════════════
 *  DID TEST GROUP
 *  Call this from the master test suite's maintest.
 * ═══════════════════════════════════════════════════════════════════════════ */

testgroup TG_DID_F18C()
{
  TestGroupDescription(
    "DID 0xF18C — ECUSerialNumber | R | 8 bytes | default session | R-sec=0 W-sec=1");

  TC_F18C_Read_HappyPath();
  TC_F18C_Read_ResponseEcho();
  TC_F18C_Read_ResponseLen();
  TC_F18C_Read_MultipleTimes();
}
