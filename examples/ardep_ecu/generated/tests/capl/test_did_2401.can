/*
 * =============================================================================
 * GENERATED — do NOT edit manually.
 * Regenerate: python3 tools/testgen.py --capl \
 *                 --config <diagnostics_config.yaml> --out generated/
 *
 * ECU       : ARDEP_IOController
 * Version   : 1.0.0
 * Generated : 2026-05-19T13:51:10Z
 *
 * FILE: test_did_2401.can
 *
 * DID       : 0x2401  (CAN_BusBitrate_kbps)
 * Access    : read + write
 * Session   : extended (ordinal 3)
 * Read sec  : 0 (no auth required)
 * Write sec : 1 (SecurityAccess level 1 required)
 * Bytes     : 2
 *
 * PURPOSE: Exhaustive CAPL test cases for DID 0x2401:
 *   TC_2401_Read_HappyPath      — positive read, correct response
 *   TC_2401_Read_ResponseEcho   — DID echo bytes in response
 *   TC_2401_Read_ResponseLen    — data length = 2 bytes
 *   TC_2401_Read_WrongSession   — NRC 0x7F in default session
 *   TC_2401_Write_HappyPath     — positive write
 *   TC_2401_Write_WrongLength   — NRC 0x13 for wrong data length
 *   TC_2401_Write_WrongSession  — NRC 0x7F in default session
 *   TC_2401_Write_SecurityLocked — NRC 0x33 when locked
 *   TC_2401_Read_MultipleTimes  — stability: 5 consecutive reads
 *
 * SPDX-License-Identifier: Apache-2.0
 * =============================================================================
 */

includes
{
  /* Include master suite for shared variables, helpers, and ISO-TP layer */
}

/* ── DID constants ───────────────────────────────────────────────────────── */
variables
{
  const word  kDid_2401            = 9217;
  const byte  kDid_2401_Hi        = 0x24;
  const byte  kDid_2401_Lo        = 0x01;
  const dword kDid_2401_DataLen   = 2;
  const int   kDid_2401_RespLen   = 5;  /* 0x62 + DID_HI + DID_LO + data */
  const int   kDid_2401_MinSess   = 3;
  const int   kDid_2401_RSec      = 0;
  const int   kDid_2401_WSec      = 1;
}

/* ── Precondition helper for this DID ────────────────────────────────────── */

/*
 * SetupRead_2401 — enter required session and security level for a read.
 * Returns 1 on success, 0 if setup failed.
 */
int SetupRead_2401()
{
  if (!Uds_EnterSession(kSessExtended))    return 0;
  return 1;
}

/*
 * SetupWrite_2401 — enter required session and security level for a write.
 */
int SetupWrite_2401()
{
  if (!Uds_EnterSession(kSessExtended))    return 0;
  if (!Uds_UnlockLevel(1)) return 0;
  return 1;
}


/* ═══════════════════════════════════════════════════════════════════════════
 *  READ TEST CASES
 * ═══════════════════════════════════════════════════════════════════════════ */

/*
 * TC_2401_Read_HappyPath
 * Verify positive ReadDataByIdentifier response for DID 0x2401.
 */
testcase TC_2401_Read_HappyPath()
{
  int rc;
  TestCaseDescription(
    "DID 0x2401 (CAN_BusBitrate_kbps) — ReadDataByIdentifier happy path");

  if (!SetupRead_2401()) {
    TestCaseFail("Precondition setup failed");
    return;
  }

  rc = Uds_ReadDid(kDid_2401_Hi,
                   kDid_2401_Lo);

  AssertPositiveResponse(rc, kSidRDBI, "RDBI_0x2401_PositiveResponse");
  Uds_EnterSession(kSessDefault);
}

/*
 * TC_2401_Read_ResponseEcho
 * Verify response echoes DID bytes 0x24, 0x01.
 */
testcase TC_2401_Read_ResponseEcho()
{
  int rc;
  TestCaseDescription(
    "DID 0x2401 (CAN_BusBitrate_kbps) — response echoes DID bytes at positions [1],[2]");

  if (!SetupRead_2401()) {
    TestCaseFail("Precondition setup failed");
    return;
  }

  rc = Uds_ReadDid(kDid_2401_Hi,
                   kDid_2401_Lo);

  if (rc < 3) {
    TestStepFail("RDBI_0x2401_Echo", "Response too short: %d bytes", rc);
    gTestFailCount++;
  } else if (gRxBuf[1] != kDid_2401_Hi ||
             gRxBuf[2] != kDid_2401_Lo) {
    TestStepFail("RDBI_0x2401_Echo",
      "DID echo mismatch: got 0x%02X%02X, expected 0x2401",
      gRxBuf[1], gRxBuf[2]);
    gTestFailCount++;
  } else {
    TestStepPass("RDBI_0x2401_Echo",
      "DID echo correct: 0x%02X%02X", gRxBuf[1], gRxBuf[2]);
    gTestPassCount++;
  }
  Uds_EnterSession(kSessDefault);
}

/*
 * TC_2401_Read_ResponseLen
 * Verify data payload = 2 bytes (total response = 5 bytes).
 */
testcase TC_2401_Read_ResponseLen()
{
  int rc;
  TestCaseDescription(
    "DID 0x2401 (CAN_BusBitrate_kbps) — response data length = 2 bytes");

  if (!SetupRead_2401()) {
    TestCaseFail("Precondition setup failed");
    return;
  }

  rc = Uds_ReadDid(kDid_2401_Hi,
                   kDid_2401_Lo);

  if (rc > 0 && gRxBuf[0] == (byte)(kSidRDBI + kPosDelta)) {
    AssertResponseLength(gRxLen,
      kDid_2401_RespLen,
      "RDBI_0x2401_ResponseLength");
  } else {
    TestStepFail("RDBI_0x2401_ResponseLength",
      "Cannot check length — no positive response");
    gTestFailCount++;
  }
  Uds_EnterSession(kSessDefault);
}

/*
 * TC_2401_Read_WrongSession
 * Verify NRC 0x7F (serviceNotSupportedInActiveSession) when reading from default session.
 * DID 0x2401 requires extended session.
 */
testcase TC_2401_Read_WrongSession()
{
  int rc;
  TestCaseDescription(
    "DID 0x2401 (CAN_BusBitrate_kbps) — NRC 0x7F when accessed in default session");

  /* Deliberately stay in default session */
  Uds_EnterSession(kSessDefault);

  rc = Uds_ReadDid(kDid_2401_Hi,
                   kDid_2401_Lo);

  AssertNegativeResponse(rc, kNrcSvcNotSuppInSess,
    "RDBI_0x2401_WrongSession_NRC0x7F");
}


/*
 * TC_2401_Read_MultipleTimes
 * Verify DID 0x2401 responds consistently across 5 consecutive reads.
 * Detects: race conditions, buffer reuse bugs, handler side-effects.
 */
testcase TC_2401_Read_MultipleTimes()
{
  int   rc;
  int   i;
  int   failCount;
  dword firstLen;
  TestCaseDescription(
    "DID 0x2401 (CAN_BusBitrate_kbps) — 5 consecutive reads, consistent responses");

  if (!SetupRead_2401()) {
    TestCaseFail("Precondition setup failed");
    return;
  }

  failCount = 0;
  firstLen  = 0;

  for (i = 0; i < 5; i++) {
    rc = Uds_ReadDid(kDid_2401_Hi,
                     kDid_2401_Lo);
    if (rc < 0 || gRxBuf[0] != (byte)(kSidRDBI + kPosDelta)) {
      failCount++;
      TestStepFail("RDBI_0x2401_Multi",
        "Read %d of 5 failed: rc=%d NRC=0x%02X", i+1, rc,
        (rc >= 3) ? gRxBuf[2] : 0xFF);
    } else {
      if (i == 0) {
        firstLen = gRxLen;
      } else if (gRxLen != firstLen) {
        failCount++;
        TestStepFail("RDBI_0x2401_Multi",
          "Read %d length %d != first read length %d", i+1, gRxLen, firstLen);
      }
    }
    testWaitForDelay(5);   /* 5 ms gap between consecutive requests */
  }

  if (failCount == 0) {
    TestStepPass("RDBI_0x2401_Multi",
      "All 5 reads successful, consistent length %d bytes", firstLen);
    gTestPassCount++;
  } else {
    gTestFailCount++;
  }
  Uds_EnterSession(kSessDefault);
}
  /* access_read */


/* ═══════════════════════════════════════════════════════════════════════════
 *  WRITE TEST CASES
 * ═══════════════════════════════════════════════════════════════════════════ */

/*
 * TC_2401_Write_HappyPath
 * Verify positive WriteDataByIdentifier response for DID 0x2401.
 * Writes 2 bytes of 0xAA pattern.
 */
testcase TC_2401_Write_HappyPath()
{
  int   rc;
  byte  data[2];
  dword i;
  TestCaseDescription(
    "DID 0x2401 (CAN_BusBitrate_kbps) — WriteDataByIdentifier happy path (2 bytes)");

  if (!SetupWrite_2401()) {
    TestCaseFail("Write precondition setup failed");
    return;
  }

  /* Fill with 0xAA test pattern */
  for (i = 0; i < 2; i++) {
    data[i] = 0xAA;
  }

  rc = Uds_WriteDid(kDid_2401_Hi,
                    kDid_2401_Lo,
                    data, 2);

  AssertPositiveResponse(rc, kSidWDBI, "WDBI_0x2401_PositiveResponse");

  /* Readback verification: read the DID we just wrote */
  if (!SetupRead_2401()) return;
  rc = Uds_ReadDid(kDid_2401_Hi,
                   kDid_2401_Lo);
  if (rc > 0 && gRxBuf[0] == (byte)(kSidRDBI + kPosDelta)) {
    TestStepPass("WDBI_0x2401_Readback", "DID readable after write");
    gTestPassCount++;
  } else {
    TestStepFail("WDBI_0x2401_Readback", "DID not readable after write");
    gTestFailCount++;
  }
  Uds_EnterSession(kSessDefault);
}

/*
 * TC_2401_Write_WrongLength
 * Verify NRC 0x13 (incorrectMessageLengthOrInvalidFormat) when wrong data length.
 * Sends 1 bytes instead of 2.
 */
testcase TC_2401_Write_WrongLength()
{
  int  rc;
  byte shortData[1];
  dword i;
  TestCaseDescription(
    "DID 0x2401 (CAN_BusBitrate_kbps) — NRC 0x13 for wrong data length");

  if (!SetupWrite_2401()) {
    TestCaseFail("Write precondition setup failed");
    return;
  }

  /* Send 1 byte(s) instead of 2 */
  for (i = 0; i < 1; i++) {
    shortData[i] = 0x00;
  }
  rc = Uds_WriteDid(kDid_2401_Hi,
                    kDid_2401_Lo,
                    shortData, 1);

  AssertNegativeResponse(rc, kNrcIncorrectMsgLen,
    "WDBI_0x2401_WrongLength_NRC0x13");
  Uds_EnterSession(kSessDefault);
}

/*
 * TC_2401_Write_WrongSession
 * Verify NRC 0x7F (serviceNotSupportedInActiveSession) when writing from default session.
 */
testcase TC_2401_Write_WrongSession()
{
  int   rc;
  byte  data[2];
  dword i;
  TestCaseDescription(
    "DID 0x2401 (CAN_BusBitrate_kbps) — NRC 0x7F on write in default session");

  Uds_EnterSession(kSessDefault);

  for (i = 0; i < 2; i++) {
    data[i] = 0x00;
  }
  rc = Uds_WriteDid(kDid_2401_Hi,
                    kDid_2401_Lo,
                    data, 2);

  AssertNegativeResponse(rc, kNrcSvcNotSuppInSess,
    "WDBI_0x2401_WrongSession_NRC0x7F");
}

/*
 * TC_2401_Write_SecurityLocked
 * Verify NRC 0x33 (securityAccessDenied) when attempting write without security unlock.
 */
testcase TC_2401_Write_SecurityLocked()
{
  int   rc;
  byte  data[2];
  dword i;
  TestCaseDescription(
    "DID 0x2401 (CAN_BusBitrate_kbps) — NRC 0x33 on write when security locked");

  /* Enter session but do NOT unlock */
  Uds_EnterSession(kSessExtended);

  for (i = 0; i < 2; i++) {
    data[i] = 0x00;
  }
  rc = Uds_WriteDid(kDid_2401_Hi,
                    kDid_2401_Lo,
                    data, 2);

  AssertNegativeResponse(rc, kNrcSecAccessDenied,
    "WDBI_0x2401_SecurityLocked_NRC0x33");
  Uds_EnterSession(kSessDefault);
}
  /* access_write */


/* ═══════════════════════════════════════════════════════════════════════════
 *  DID TEST GROUP
 *  Call this from the master test suite's maintest.
 * ═══════════════════════════════════════════════════════════════════════════ */

testgroup TG_DID_2401()
{
  TestGroupDescription(
    "DID 0x2401 — CAN_BusBitrate_kbps | RW | 2 bytes | extended session | R-sec=0 W-sec=1");

  TC_2401_Read_HappyPath();
  TC_2401_Read_ResponseEcho();
  TC_2401_Read_ResponseLen();
  TC_2401_Read_WrongSession();
  TC_2401_Read_MultipleTimes();
  TC_2401_Write_HappyPath();
  TC_2401_Write_WrongLength();
  TC_2401_Write_WrongSession();
  TC_2401_Write_SecurityLocked();
}
