/*
 * =============================================================================
 * GENERATED — do NOT edit manually.
 * Regenerate: python3 tools/testgen.py --capl \
 *                 --config <diagnostics_config.yaml> --out generated/
 *
 * ECU       : ARDEP_IOController
 * Version   : 1.0.0
 * Generated : 2026-05-19T13:51:10Z
 *
 * FILE: test_did_2203.can
 *
 * DID       : 0x2203  (CAN_TxFrameCount)
 * Access    : read
 * Session   : default (ordinal 1)
 * Read sec  : 0 (no auth required)
 * Write sec : 0 (no auth required)
 * Bytes     : 4
 *
 * PURPOSE: Exhaustive CAPL test cases for DID 0x2203:
 *   TC_2203_Read_HappyPath      — positive read, correct response
 *   TC_2203_Read_ResponseEcho   — DID echo bytes in response
 *   TC_2203_Read_ResponseLen    — data length = 4 bytes
 *   TC_2203_Read_MultipleTimes  — stability: 5 consecutive reads
 *
 * SPDX-License-Identifier: Apache-2.0
 * =============================================================================
 */

includes
{
  /* Include master suite for shared variables, helpers, and ISO-TP layer */
}

/* ── DID constants ───────────────────────────────────────────────────────── */
variables
{
  const word  kDid_2203            = 8707;
  const byte  kDid_2203_Hi        = 0x22;
  const byte  kDid_2203_Lo        = 0x03;
  const dword kDid_2203_DataLen   = 4;
  const int   kDid_2203_RespLen   = 7;  /* 0x62 + DID_HI + DID_LO + data */
  const int   kDid_2203_MinSess   = 1;
  const int   kDid_2203_RSec      = 0;
  const int   kDid_2203_WSec      = 0;
}

/* ── Precondition helper for this DID ────────────────────────────────────── */

/*
 * SetupRead_2203 — enter required session and security level for a read.
 * Returns 1 on success, 0 if setup failed.
 */
int SetupRead_2203()
{
  if (!Uds_EnterSession(kSessDefault))     return 0;
  return 1;
}



/* ═══════════════════════════════════════════════════════════════════════════
 *  READ TEST CASES
 * ═══════════════════════════════════════════════════════════════════════════ */

/*
 * TC_2203_Read_HappyPath
 * Verify positive ReadDataByIdentifier response for DID 0x2203.
 */
testcase TC_2203_Read_HappyPath()
{
  int rc;
  TestCaseDescription(
    "DID 0x2203 (CAN_TxFrameCount) — ReadDataByIdentifier happy path");

  if (!SetupRead_2203()) {
    TestCaseFail("Precondition setup failed");
    return;
  }

  rc = Uds_ReadDid(kDid_2203_Hi,
                   kDid_2203_Lo);

  AssertPositiveResponse(rc, kSidRDBI, "RDBI_0x2203_PositiveResponse");
  Uds_EnterSession(kSessDefault);
}

/*
 * TC_2203_Read_ResponseEcho
 * Verify response echoes DID bytes 0x22, 0x03.
 */
testcase TC_2203_Read_ResponseEcho()
{
  int rc;
  TestCaseDescription(
    "DID 0x2203 (CAN_TxFrameCount) — response echoes DID bytes at positions [1],[2]");

  if (!SetupRead_2203()) {
    TestCaseFail("Precondition setup failed");
    return;
  }

  rc = Uds_ReadDid(kDid_2203_Hi,
                   kDid_2203_Lo);

  if (rc < 3) {
    TestStepFail("RDBI_0x2203_Echo", "Response too short: %d bytes", rc);
    gTestFailCount++;
  } else if (gRxBuf[1] != kDid_2203_Hi ||
             gRxBuf[2] != kDid_2203_Lo) {
    TestStepFail("RDBI_0x2203_Echo",
      "DID echo mismatch: got 0x%02X%02X, expected 0x2203",
      gRxBuf[1], gRxBuf[2]);
    gTestFailCount++;
  } else {
    TestStepPass("RDBI_0x2203_Echo",
      "DID echo correct: 0x%02X%02X", gRxBuf[1], gRxBuf[2]);
    gTestPassCount++;
  }
  Uds_EnterSession(kSessDefault);
}

/*
 * TC_2203_Read_ResponseLen
 * Verify data payload = 4 bytes (total response = 7 bytes).
 */
testcase TC_2203_Read_ResponseLen()
{
  int rc;
  TestCaseDescription(
    "DID 0x2203 (CAN_TxFrameCount) — response data length = 4 bytes");

  if (!SetupRead_2203()) {
    TestCaseFail("Precondition setup failed");
    return;
  }

  rc = Uds_ReadDid(kDid_2203_Hi,
                   kDid_2203_Lo);

  if (rc > 0 && gRxBuf[0] == (byte)(kSidRDBI + kPosDelta)) {
    AssertResponseLength(gRxLen,
      kDid_2203_RespLen,
      "RDBI_0x2203_ResponseLength");
  } else {
    TestStepFail("RDBI_0x2203_ResponseLength",
      "Cannot check length — no positive response");
    gTestFailCount++;
  }
  Uds_EnterSession(kSessDefault);
}



/*
 * TC_2203_Read_MultipleTimes
 * Verify DID 0x2203 responds consistently across 5 consecutive reads.
 * Detects: race conditions, buffer reuse bugs, handler side-effects.
 */
testcase TC_2203_Read_MultipleTimes()
{
  int   rc;
  int   i;
  int   failCount;
  dword firstLen;
  TestCaseDescription(
    "DID 0x2203 (CAN_TxFrameCount) — 5 consecutive reads, consistent responses");

  if (!SetupRead_2203()) {
    TestCaseFail("Precondition setup failed");
    return;
  }

  failCount = 0;
  firstLen  = 0;

  for (i = 0; i < 5; i++) {
    rc = Uds_ReadDid(kDid_2203_Hi,
                     kDid_2203_Lo);
    if (rc < 0 || gRxBuf[0] != (byte)(kSidRDBI + kPosDelta)) {
      failCount++;
      TestStepFail("RDBI_0x2203_Multi",
        "Read %d of 5 failed: rc=%d NRC=0x%02X", i+1, rc,
        (rc >= 3) ? gRxBuf[2] : 0xFF);
    } else {
      if (i == 0) {
        firstLen = gRxLen;
      } else if (gRxLen != firstLen) {
        failCount++;
        TestStepFail("RDBI_0x2203_Multi",
          "Read %d length %d != first read length %d", i+1, gRxLen, firstLen);
      }
    }
    testWaitForDelay(5);   /* 5 ms gap between consecutive requests */
  }

  if (failCount == 0) {
    TestStepPass("RDBI_0x2203_Multi",
      "All 5 reads successful, consistent length %d bytes", firstLen);
    gTestPassCount++;
  } else {
    gTestFailCount++;
  }
  Uds_EnterSession(kSessDefault);
}
  /* access_read */


/* ═══════════════════════════════════════════════════════════════════════════
 *  WRITE TEST CASES
 * ═══════════════════════════════════════════════════════════════════════════ */

  /* access_write */


/* ═══════════════════════════════════════════════════════════════════════════
 *  DID TEST GROUP
 *  Call this from the master test suite's maintest.
 * ═══════════════════════════════════════════════════════════════════════════ */

testgroup TG_DID_2203()
{
  TestGroupDescription(
    "DID 0x2203 — CAN_TxFrameCount | R | 4 bytes | default session | R-sec=0 W-sec=0");

  TC_2203_Read_HappyPath();
  TC_2203_Read_ResponseEcho();
  TC_2203_Read_ResponseLen();
  TC_2203_Read_MultipleTimes();
}
