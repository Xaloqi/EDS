/*
 * =============================================================================
 * GENERATED — do NOT edit manually.
 * Regenerate: python3 tools/testgen.py --capl \
 *                 --config <diagnostics_config.yaml> --out generated/
 *
 * ECU       : ARDEP_IOController
 * Version   : 1.0.0
 * Generated : 2026-05-19T13:51:10Z
 *
 * FILE: test_did_f190.can
 *
 * DID       : 0xF190  (VehicleIdentificationNumber)
 * Access    : read
 * Session   : default (ordinal 1)
 * Read sec  : 0 (no auth required)
 * Write sec : 1 (SecurityAccess level 1 required)
 * Bytes     : 17
 *
 * PURPOSE: Exhaustive CAPL test cases for DID 0xF190:
 *   TC_F190_Read_HappyPath      — positive read, correct response
 *   TC_F190_Read_ResponseEcho   — DID echo bytes in response
 *   TC_F190_Read_ResponseLen    — data length = 17 bytes
 *   TC_F190_Read_MultipleTimes  — stability: 5 consecutive reads
 *
 * SPDX-License-Identifier: Apache-2.0
 * =============================================================================
 */

includes
{
  /* Include master suite for shared variables, helpers, and ISO-TP layer */
}

/* ── DID constants ───────────────────────────────────────────────────────── */
variables
{
  const word  kDid_F190            = 61840;
  const byte  kDid_F190_Hi        = 0xF1;
  const byte  kDid_F190_Lo        = 0x90;
  const dword kDid_F190_DataLen   = 17;
  const int   kDid_F190_RespLen   = 20;  /* 0x62 + DID_HI + DID_LO + data */
  const int   kDid_F190_MinSess   = 1;
  const int   kDid_F190_RSec      = 0;
  const int   kDid_F190_WSec      = 1;
}

/* ── Precondition helper for this DID ────────────────────────────────────── */

/*
 * SetupRead_F190 — enter required session and security level for a read.
 * Returns 1 on success, 0 if setup failed.
 */
int SetupRead_F190()
{
  if (!Uds_EnterSession(kSessDefault))     return 0;
  return 1;
}



/* ═══════════════════════════════════════════════════════════════════════════
 *  READ TEST CASES
 * ═══════════════════════════════════════════════════════════════════════════ */

/*
 * TC_F190_Read_HappyPath
 * Verify positive ReadDataByIdentifier response for DID 0xF190.
 */
testcase TC_F190_Read_HappyPath()
{
  int rc;
  TestCaseDescription(
    "DID 0xF190 (VehicleIdentificationNumber) — ReadDataByIdentifier happy path");

  if (!SetupRead_F190()) {
    TestCaseFail("Precondition setup failed");
    return;
  }

  rc = Uds_ReadDid(kDid_F190_Hi,
                   kDid_F190_Lo);

  AssertPositiveResponse(rc, kSidRDBI, "RDBI_0xF190_PositiveResponse");
  Uds_EnterSession(kSessDefault);
}

/*
 * TC_F190_Read_ResponseEcho
 * Verify response echoes DID bytes 0xF1, 0x90.
 */
testcase TC_F190_Read_ResponseEcho()
{
  int rc;
  TestCaseDescription(
    "DID 0xF190 (VehicleIdentificationNumber) — response echoes DID bytes at positions [1],[2]");

  if (!SetupRead_F190()) {
    TestCaseFail("Precondition setup failed");
    return;
  }

  rc = Uds_ReadDid(kDid_F190_Hi,
                   kDid_F190_Lo);

  if (rc < 3) {
    TestStepFail("RDBI_0xF190_Echo", "Response too short: %d bytes", rc);
    gTestFailCount++;
  } else if (gRxBuf[1] != kDid_F190_Hi ||
             gRxBuf[2] != kDid_F190_Lo) {
    TestStepFail("RDBI_0xF190_Echo",
      "DID echo mismatch: got 0x%02X%02X, expected 0xF190",
      gRxBuf[1], gRxBuf[2]);
    gTestFailCount++;
  } else {
    TestStepPass("RDBI_0xF190_Echo",
      "DID echo correct: 0x%02X%02X", gRxBuf[1], gRxBuf[2]);
    gTestPassCount++;
  }
  Uds_EnterSession(kSessDefault);
}

/*
 * TC_F190_Read_ResponseLen
 * Verify data payload = 17 bytes (total response = 20 bytes).
 */
testcase TC_F190_Read_ResponseLen()
{
  int rc;
  TestCaseDescription(
    "DID 0xF190 (VehicleIdentificationNumber) — response data length = 17 bytes");

  if (!SetupRead_F190()) {
    TestCaseFail("Precondition setup failed");
    return;
  }

  rc = Uds_ReadDid(kDid_F190_Hi,
                   kDid_F190_Lo);

  if (rc > 0 && gRxBuf[0] == (byte)(kSidRDBI + kPosDelta)) {
    AssertResponseLength(gRxLen,
      kDid_F190_RespLen,
      "RDBI_0xF190_ResponseLength");
  } else {
    TestStepFail("RDBI_0xF190_ResponseLength",
      "Cannot check length — no positive response");
    gTestFailCount++;
  }
  Uds_EnterSession(kSessDefault);
}



/*
 * TC_F190_Read_MultipleTimes
 * Verify DID 0xF190 responds consistently across 5 consecutive reads.
 * Detects: race conditions, buffer reuse bugs, handler side-effects.
 */
testcase TC_F190_Read_MultipleTimes()
{
  int   rc;
  int   i;
  int   failCount;
  dword firstLen;
  TestCaseDescription(
    "DID 0xF190 (VehicleIdentificationNumber) — 5 consecutive reads, consistent responses");

  if (!SetupRead_F190()) {
    TestCaseFail("Precondition setup failed");
    return;
  }

  failCount = 0;
  firstLen  = 0;

  for (i = 0; i < 5; i++) {
    rc = Uds_ReadDid(kDid_F190_Hi,
                     kDid_F190_Lo);
    if (rc < 0 || gRxBuf[0] != (byte)(kSidRDBI + kPosDelta)) {
      failCount++;
      TestStepFail("RDBI_0xF190_Multi",
        "Read %d of 5 failed: rc=%d NRC=0x%02X", i+1, rc,
        (rc >= 3) ? gRxBuf[2] : 0xFF);
    } else {
      if (i == 0) {
        firstLen = gRxLen;
      } else if (gRxLen != firstLen) {
        failCount++;
        TestStepFail("RDBI_0xF190_Multi",
          "Read %d length %d != first read length %d", i+1, gRxLen, firstLen);
      }
    }
    testWaitForDelay(5);   /* 5 ms gap between consecutive requests */
  }

  if (failCount == 0) {
    TestStepPass("RDBI_0xF190_Multi",
      "All 5 reads successful, consistent length %d bytes", firstLen);
    gTestPassCount++;
  } else {
    gTestFailCount++;
  }
  Uds_EnterSession(kSessDefault);
}
  /* access_read */


/* ═══════════════════════════════════════════════════════════════════════════
 *  WRITE TEST CASES
 * ═══════════════════════════════════════════════════════════════════════════ */

  /* access_write */


/* ═══════════════════════════════════════════════════════════════════════════
 *  DID TEST GROUP
 *  Call this from the master test suite's maintest.
 * ═══════════════════════════════════════════════════════════════════════════ */

testgroup TG_DID_F190()
{
  TestGroupDescription(
    "DID 0xF190 — VehicleIdentificationNumber | R | 17 bytes | default session | R-sec=0 W-sec=1");

  TC_F190_Read_HappyPath();
  TC_F190_Read_ResponseEcho();
  TC_F190_Read_ResponseLen();
  TC_F190_Read_MultipleTimes();
}
