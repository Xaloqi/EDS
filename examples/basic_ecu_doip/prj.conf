## CMakeLists.txt
```
# =============================================================================
# Xaloqi EDS
# examples/basic_ecu_doip/CMakeLists.txt
#
# PURPOSE: Stand-alone Zephyr build for the DoIP example ECU (v1.6.0).
#
# Mirrors examples/basic_ecu/CMakeLists.txt exactly, with three additions:
#   1. Networking include path (-I transport/doip, -I platform/zephyr)
#   2. DoIP transport sources (zephyr_lwip.c, platform_doip.c, doip_server.c)
#   3. CAN sources OMITTED (DoIP-only transport: no isotp.c, no zephyr_can.c)
#
# BUILDING:
#   west build -b native_sim examples/basic_ecu_doip
#
# CI target (native_sim loopback, no hardware required):
#   west build -b native_sim examples/basic_ecu_doip -- \
#       -DEXTRA_CONF_FILE=boards/native_sim/native_sim_doip.conf
#
# SAFETY CONTEXT : Example application — not safety-assessed.
# SPDX-License-Identifier: Apache-2.0
# =============================================================================

cmake_minimum_required(VERSION 3.20.0)

# [#414] EDS Kconfig comes from this tree, not whichever EDS module the
# workspace has. Must precede find_package(Zephyr).
include(${CMAKE_CURRENT_SOURCE_DIR}/../../cmake/eds_zephyr_module.cmake)

# [EDS#423] Bench-only firmware-download build: RequestDownload writes to
# real flash (bank 2) through platform/zephyr/zephyr_flash_ops.c. Off by
# default; NUCLEO-H753ZI only. Nothing boots from the written image (that is
# EDS#425). Must precede find_package(Zephyr) to add the conf and overlay.
option(DIAG_DOIP_FLASH_BENCH "Bench only: DoIP firmware download into real flash (NUCLEO-H753ZI)" OFF)
if(DIAG_DOIP_FLASH_BENCH)
    if(NOT BOARD MATCHES "^nucleo_h753zi")
        message(FATAL_ERROR "[DIAG] DIAG_DOIP_FLASH_BENCH is defined for nucleo_h753zi only (got '${BOARD}').")
    endif()
    list(APPEND EXTRA_CONF_FILE
        "${CMAKE_CURRENT_SOURCE_DIR}/boards/nucleo_h753zi/nucleo_h753zi_flash_bench.conf")
    list(APPEND EXTRA_DTC_OVERLAY_FILE
        "${CMAKE_CURRENT_SOURCE_DIR}/boards/nucleo_h753zi/nucleo_h753zi_flash_bench.overlay")
endif()

find_package(Zephyr REQUIRED HINTS $ENV{ZEPHYR_BASE})

project(basic_ecu_doip
    VERSION     1.6.0
    LANGUAGES   C
    DESCRIPTION "BasicECU DoIP example — Xaloqi EDS v1.6.0"
)

set(CMAKE_C_STANDARD          11)
set(CMAKE_C_STANDARD_REQUIRED ON)
set(CMAKE_C_EXTENSIONS        OFF)

# [#515] -Wundef (MISRA 20.9) below applies to EDS code only: Zephyr, module and
# HAL headers are system includes for this target. See the cmake file.
include(${CMAKE_CURRENT_SOURCE_DIR}/../../cmake/eds_third_party_headers.cmake)
eds_third_party_headers_are_system(app)

target_compile_options(app PRIVATE
    -Wall -Wextra -Wshadow -Wdouble-promotion -Wundef
    -Wno-unused-parameter -Wno-sign-conversion
    -fstack-usage
)

# ---------------------------------------------------------------------------
# Paths
# ---------------------------------------------------------------------------
set(DIAG_ROOT         "${CMAKE_CURRENT_SOURCE_DIR}/../..")
set(DIAG_CONFIG_YAML  "${CMAKE_CURRENT_SOURCE_DIR}/diagnostics_config.yaml")
set(DIAG_CODEGEN_SCRIPT "${DIAG_ROOT}/tools/codegen.py")
set(DIAG_GENERATED_DIR  "${CMAKE_CURRENT_SOURCE_DIR}/generated")
set(CODEGEN_SENTINEL    "${DIAG_GENERATED_DIR}/safety_config.h")

option(DIAG_SKIP_CODEGEN "Skip auto-running codegen.py" OFF)

if(NOT DIAG_SKIP_CODEGEN)
    find_package(Python3 COMPONENTS Interpreter QUIET)
    if(NOT Python3_FOUND)
        message(FATAL_ERROR "[DIAG] Python3 not found — cannot run codegen.")
    endif()
    file(GLOB DIAG_TEMPLATES "${DIAG_ROOT}/tools/templates/*.j2")
    add_custom_command(
        OUTPUT   "${CODEGEN_SENTINEL}"
        COMMAND  "${Python3_EXECUTABLE}"
                 "${DIAG_CODEGEN_SCRIPT}"
                 --config "${DIAG_CONFIG_YAML}"
                 --out    "${DIAG_GENERATED_DIR}"
                 --safety-wrappers --asil-level B --no-manifest
        DEPENDS  "${DIAG_CONFIG_YAML}" "${DIAG_CODEGEN_SCRIPT}" ${DIAG_TEMPLATES}
        COMMENT  "[DIAG] Generating DoIP ECU sources from diagnostics_config.yaml..."
        VERBATIM
    )
    add_custom_target(run_codegen DEPENDS "${CODEGEN_SENTINEL}")
endif()

# ---------------------------------------------------------------------------
# Include directories
# ---------------------------------------------------------------------------
target_include_directories(app PRIVATE
    ${DIAG_ROOT}/core
    ${DIAG_ROOT}/core/uds_services
    ${DIAG_ROOT}/transport
    ${DIAG_ROOT}/transport/doip          # doip_server.h, zephyr_lwip.h
    ${DIAG_ROOT}/config
    ${DIAG_ROOT}/platform
    ${DIAG_ROOT}/platform/zephyr         # platform_doip.h, zephyr_port.h, etc.
    ${DIAG_GENERATED_DIR}
)

# ---------------------------------------------------------------------------
# Source files
# ---------------------------------------------------------------------------
# UDS service source list — set EDS_SERVICE_SRCS.
include(${DIAG_ROOT}/cmake/eds_service_sources.cmake)

target_sources(app PRIVATE

    # ── Application entry point ──────────────────────────────────────────
    ${CMAKE_CURRENT_SOURCE_DIR}/src/main.c

    # ── UDS core ─────────────────────────────────────────────────────────
    ${DIAG_ROOT}/core/uds_server.c
    ${DIAG_ROOT}/core/uds_session.c
    ${DIAG_ROOT}/core/uds_security.c
    ${DIAG_ROOT}/core/uds_safety.c
    ${DIAG_ROOT}/core/uds_security_algo.c
    ${DIAG_ROOT}/core/uds_access_table.c
    ${DIAG_ROOT}/core/uds_comm_control.c
    ${DIAG_ROOT}/core/uds_session_stats.c
    ${DIAG_ROOT}/core/uds_security_nvm.c
    ${DIAG_ROOT}/core/uds_aes_cmac.c

    # UDS service handlers (all 16 SIDs + dispatch table).
    ${EDS_SERVICE_SRCS}
    ${DIAG_ROOT}/core/uds_transfer_ctx.c
    ${DIAG_ROOT}/platform/uds_flash_ops.c
    ${DIAG_ROOT}/platform/uds_image_policy.c  # [#232] Image verification policy singleton

    # ── DoIP transport (Zephyr binding) ───────────────────────────────────
    ${DIAG_ROOT}/transport/doip/doip_server.c
    ${DIAG_ROOT}/transport/doip/zephyr_lwip.c
    ${DIAG_ROOT}/platform/zephyr/platform_doip.c

    # ── NOTE: No isotp.c / can_transport.c / zephyr_can.c ────────────────
    # This is a DoIP-only build (transport: doip in diagnostics_config.yaml).
    # For transport: both, add those sources alongside the DoIP sources.

    # ── Configuration databases ───────────────────────────────────────────
    ${DIAG_ROOT}/config/did_database.c
    ${DIAG_ROOT}/config/dtc_database.c
    ${DIAG_ROOT}/config/routine_database.c
    ${DIAG_ROOT}/config/dtc_mirror.c

    # ── Zephyr platform abstraction ───────────────────────────────────────
    # Minimal set for DoIP-only: no zephyr_can.c, no zephyr_timer.c
    # (CAN-path dependencies).
    ${DIAG_ROOT}/platform/zephyr/zephyr_platform_api.c
    ${DIAG_ROOT}/platform/zephyr/zephyr_mutex.c  # [EDS#353] s_session_lock/s_security_lock
    ${DIAG_ROOT}/platform/zephyr/zephyr_wdt.c    # [EDS#399] no-op on native_sim (CONFIG_WATCHDOG=n)

    # ── Generated sources ─────────────────────────────────────────────────
    ${DIAG_GENERATED_DIR}/did_handlers.c
    ${DIAG_GENERATED_DIR}/uds_init.c
    ${DIAG_GENERATED_DIR}/did_safety_wrappers.c
    ${DIAG_GENERATED_DIR}/routine_handlers.c
)

# NVM mock for native_sim (no NVS flash on simulator).
#
# [#31] DIAG_USE_MOCK_NVM: explicit opt-in escape hatch for a real board that
# doesn't (yet) define the eds_nvs_slot partition nvm_store.c needs — e.g. a
# one-off WCET measurement bring-up where persistent NVM is irrelevant to
# what's being measured and not worth a real flash-partition overlay for.
# Defaults OFF: every existing real-hardware board keeps linking the real
# nvm_store.c exactly as before unless a build explicitly passes this.
option(DIAG_USE_MOCK_NVM "Link the RAM-backed NVM mock instead of real NVS, even on real hardware" OFF)

if(CONFIG_BOARD_NATIVE_SIM OR DIAG_USE_MOCK_NVM)
    target_sources(app PRIVATE ${DIAG_ROOT}/platform/zephyr/nvm_store_mock.c)
else()
    target_sources(app PRIVATE ${DIAG_ROOT}/platform/zephyr/nvm_store.c)
endif()

# [EDS#423] Bench flash-download build: see DIAG_DOIP_FLASH_BENCH above.
if(DIAG_DOIP_FLASH_BENCH)
    target_sources(app PRIVATE ${DIAG_ROOT}/platform/zephyr/zephyr_flash_ops.c)
    target_sources(app PRIVATE ${DIAG_ROOT}/platform/uds_mcuboot_image.c)  # [#436]
    target_compile_definitions(app PRIVATE DIAG_DOIP_FLASH_BENCH=1)
endif()

if(NOT DIAG_SKIP_CODEGEN AND TARGET run_codegen)
    add_dependencies(app run_codegen)
endif()

target_compile_definitions(app PRIVATE
    EDS_MSG_BUF_MAX_STACK_BYTES=8192
    EDS_DOIP_ONLY_BUILD=1
)

# [EDS#282] Bench only: a RoutineControl (RID 0xF0F0) that answers NRC 0x78
# and busy-waits in bounded steps, to measure the response-pending path.
option(DIAG_BENCH_SLOW_ROUTINE "Bench only: slow 0x31 routine for the response-pending path" OFF)
if(DIAG_BENCH_SLOW_ROUTINE)
    target_sources(app PRIVATE ${DIAG_ROOT}/platform/zephyr/bench_slow_routine.c)
    target_compile_definitions(app PRIVATE DIAG_BENCH_SLOW_ROUTINE=1)
endif()
```

## prj.conf
```kconfig
# =============================================================================
# Xaloqi EDS
# examples/basic_ecu_doip/prj.conf
#
# Base project configuration for the DoIP example ECU.
# Board-specific overrides in boards/native_sim/native_sim_doip.conf.
#
# FIXES applied vs original:
#   - DOIP_STACK_SIZE / DOIP_THREAD_PRIORITY removed: these are #define
#     constants in zephyr_lwip.c, not Kconfig symbols. Assigning them here
#     produces "attempt to assign the value to the undefined symbol" fatal
#     Kconfig errors on Zephyr 3.7.
#   - CONFIG_NET_SOCKETS_POSIX_NAMES removed: this symbol depends on
#     (!POSIX_API). native_sim_doip.conf sets POSIX_API=y, which makes
#     POSIX_NAMES=y an unsatisfied dependency. With POSIX_API, zsock_*
#     functions are available as plain socket/poll/send/recv — no POSIX_NAMES
#     wrapper needed.
# =============================================================================

# --- Kernel / threading ---
CONFIG_MULTITHREADING=y
CONFIG_THREAD_STACK_INFO=y
CONFIG_THREAD_NAME=y
CONFIG_THREAD_MONITOR=y

# --- Tick rate ---
CONFIG_SYS_CLOCK_TICKS_PER_SEC=1000
CONFIG_TICKLESS_KERNEL=n

# --- Logging ---
CONFIG_LOG=y
CONFIG_LOG_DEFAULT_LEVEL=3

# --- Safety hardening ---
CONFIG_ASSERT=y
CONFIG_STACK_CANARIES=y
# Fail the build if the canaries are not real (see Kconfig EDS_REQUIRE_STACK_CANARIES).
CONFIG_EDS_REQUIRE_STACK_CANARIES=y

# --- No heap (MISRA-21.3) ---
CONFIG_HEAP_MEM_POOL_SIZE=0

# --- Networking ---
# NET_SOCKETS_POSIX_NAMES intentionally omitted: conflicts with POSIX_API=y.
CONFIG_NETWORKING=y
CONFIG_NET_IPV4=y
CONFIG_NET_TCP=y
CONFIG_NET_SOCKETS=y
CONFIG_NET_IF_MAX_IPV4_COUNT=1
CONFIG_NET_MAX_CONN=8
CONFIG_NET_TCP_MAX_SEND_WINDOW_SIZE=4096
# [#498] POSIX_MAX_FDS was deprecated in Zephyr 3.7 and is gone by 4.4.
CONFIG_ZVFS_OPEN_MAX=16

# --- Build output ---
CONFIG_BUILD_OUTPUT_BIN=y
```

## boards/nucleo_h753zi/nucleo_h753zi_doip.overlay
```dts
/* SPDX-License-Identifier: Apache-2.0 */
/* Copyright (c) 2026 Xaloqi */
/*
 * examples/basic_ecu_doip/boards/nucleo_h753zi/nucleo_h753zi_doip.overlay
 *
 * [EDS#399] Exposes the STM32 independent watchdog (IWDG) as the system
 * watchdog. Zephyr's nucleo_h753zi board leaves &iwdg disabled and defines
 * no watchdog0 alias; platform/zephyr/zephyr_wdt.c resolves the watchdog
 * through that alias and refuses to build with CONFIG_WATCHDOG=y without it
 * (EDS#306). Same two settings as examples/safeboot_ecu's overlay for this
 * board. Pass with -DEXTRA_DTC_OVERLAY_FILE (see nucleo_h753zi_doip.conf).
 */

/ {
	aliases {
		watchdog0 = &iwdg;
	};
};

&iwdg {
	status = "okay";
};
```

## boards/nucleo_h753zi/nucleo_h753zi_flash_bench.overlay
```dts
/*
 * Xaloqi EDS — examples/basic_ecu_doip, NUCLEO-H753ZI flash-download bench [EDS#423]
 *
 * Applied only with -DDIAG_DOIP_FLASH_BENCH=ON (CMakeLists.txt). Adds the
 * partition platform/zephyr/zephyr_flash_ops.c writes RequestDownload data
 * to: FIXED_PARTITION_ID(image_1) resolves by devicetree NODE label.
 *
 * Placed in flash bank 2 (offset 0x100000, 1 MB), which the board's default
 * partitions (up to 0xE0000) and this example's image (linked at 0x08000000,
 * ~160 KB) never touch. Addresses in RequestDownload are partition-relative
 * flash offsets: this region is 0x00100000..0x001FFFFF.
 *
 * Bench only: nothing boots from here. Booting a downloaded image is phase 2
 * (EDS#425).
 */
&flash0 {
	partitions {
		eds_dl_bench: image_1: partition@100000 {
			label = "eds-dl-bench";
			reg = <0x00100000 DT_SIZE_M(1)>;
		};
	};
};
```

## src/main.c
```c
// SPDX-License-Identifier: Apache-2.0
// Copyright (c) 2026 Xaloqi
/*
 * =============================================================================
 * Xaloqi EDS
 * FILE: examples/basic_ecu_doip/src/main.c
 *
 * PURPOSE: BasicECU_DoIP — identical DID/DTC set as basic_ecu, served over
 *          DoIP (ISO 13400-2) instead of ISO-TP CAN.
 *
 *          Demonstrates the minimum integration to add DoIP to an EDS ECU:
 *            1. Include zephyr_lwip.h / platform_doip.h
 *            2. Call eds_doip_platform_start() after uds_generated_init()
 *            3. Add Networking Kconfig and the doip: block to diagnostics_config.yaml
 *
 *          The CAN diagnostic task (diag_task) is NOT started here — this
 *          example is DoIP-only. For a production "both" transport ECU,
 *          add the CAN thread from basic_ecu alongside the DoIP init.
 *
 * THREAD MODEL:
 *   main()        — init → uds_generated_init → start tick + DoIP → return
 *   uds_tick_task — 1 ms poll loop: uds_server_tick_1ms() + uds_periodic_tick_1ms(),
 *                   once per millisecond actually elapsed [EDS#401, EDS#411].
 *                   [EDS#191] A DoIP-only build has no CAN diag_task, so
 *                   without this thread the S3 session timeout and the
 *                   SecurityAccess lockout countdown never progress — a
 *                   session/unlock, once entered, never expires on its own.
 *   doip_thread   — started via a semaphore (zephyr_lwip.c), not a fixed
 *                   delay [EDS#192]; runs eds_doip_server_run()
 *
 * WATCHDOG SUPERVISION [EDS#399] (real hardware, CONFIG_WATCHDOG=y; a
 * no-op on native_sim):
 *   The IWDG is armed in main() just before uds_tick_task starts, and fed
 *   only from uds_tick_task. That thread feeds only while doip_thread has
 *   checked in, through eds_doip_set_checkin_callback(), within
 *   DOIP_SUPERVISION_WINDOW_MS. A hung tick loop, a dispatch hung holding
 *   the UDS locks, or doip_thread wedged on its socket or exited all reset
 *   the ECU. An idle server with no client checks in every accept poll
 *   (5 s), so it is never reset for being idle.
 *   NOT supervised: boot before the arming point (pre-main network wait
 *   and the init in main()), and a dead Ethernet link (accept still times
 *   out and checks in).
 *
 * TARGET: native_sim (CI — loopback networking) and any Ethernet-capable
 *         Zephyr board (e.g. FRDM-K64F, STM32H7 with ETH).
 *
 * BUILDING:
 *   west build -b native_sim examples/basic_ecu_doip
 *
 * TESTING (once built):
 *   # In one terminal:
 *   ./build/zephyr/zephyr.exe
 *   # In another:
 *   python3 -c "
 *   import asyncio
 *   from xaloqi.tester import UdsTester, DoipBus, Session
 *   async def main():
 *       async with UdsTester(DoipBus('127.0.0.1'), rx_id=0xE400, tx_id=0x0E00) as ecu:
 *           vin = await ecu.read_did(0xF190)
 *           print('VIN:', vin)
 *   asyncio.run(main())
 *   "
 *
 * SAFETY   : ASIL-B candidate.
 * STANDARD : MISRA C:2012 alignment intended.
 * LICENSE  : Apache-2.0
 * =============================================================================
 */

/* --------------------------------------------------------------------------
 * EDS stack headers
 * -------------------------------------------------------------------------- */
#include "uds_types.h"
#include "uds_server.h"
#include "uds_security_algo.h"
#include "uds_periodic.h"
#include "uds_session.h"
#include "eds_elapsed.h"     /* [EDS#411] elapsed-time ticking */

/* --------------------------------------------------------------------------
 * DoIP platform headers
 * -------------------------------------------------------------------------- */
#include "platform_api.h"    /* eds_platform_uptime_ms() */
#include "platform_doip.h"   /* eds_doip_platform_start() */
#include "doip_server.h"     /* DOIP_PORT */
#include "zephyr_mutex.h"
#include "zephyr_wdt.h"
#if defined(DIAG_DOIP_FLASH_BENCH)
#include "zephyr_flash_ops.h" /* [EDS#423] bench flash download */
#include "services.h"
#endif
#if defined(DIAG_BENCH_SLOW_ROUTINE)
#include "bench_slow_routine.h"   /* [EDS#282] bench slow routine */
#endif
#include "nvm_store.h"
#if defined(DIAG_WCET_MEASURE)
#include "zephyr_wcet.h"     /* [#31] see header comment */
#endif

/* --------------------------------------------------------------------------
 * Generated headers (from diagnostics_config.yaml via codegen.py)
 * -------------------------------------------------------------------------- */
#include "uds_init.h"
#include "generated_config.h"
#include "did_handlers.h"

/* --------------------------------------------------------------------------
 * Zephyr headers
 * -------------------------------------------------------------------------- */
#include <zephyr/kernel.h>
#include <zephyr/sys/atomic.h>
#include <zephyr/logging/log.h>

LOG_MODULE_REGISTER(basic_ecu_doip, LOG_LEVEL_INF);

/* =============================================================================
 * DoIP ECU configuration
 *
 * logical_address: 0xE400 — standard xaloqi-tester default ECU address.
 * source_address:  0x0E00 — standard tester address (accepted during
 *                            routing activation in doip_server.c).
 *
 * These values must match the DoipBus constructor arguments in the
 * xaloqi-tester integration tests (conftest.py).
 * ============================================================================= */

#define DOIP_ECU_LOGICAL_ADDR   (0xE400U)

/* =============================================================================
 * UDS tick task configuration [EDS#191]
 *
 * Drives uds_server_tick_1ms() and uds_periodic_tick_1ms() every 1 ms —
 * the only thing progressing the S3 session timeout and SecurityAccess
 * lockout countdown in a DoIP-only build (no isotp_tick_1ms(): there is
 * no ISO-TP/CAN transport here). Priority matches basic_ecu's diag_task
 * (5) — higher priority than doip_thread's default (7,
 * zephyr_lwip.c) so UDS timer progression is never starved by DoIP
 * request handling, same rationale as the CAN example's own priority split.
 * ============================================================================= */

/* [EDS#411] Most 1 ms ticks one loop iteration runs, which bounds the work
 * done while the session/security locks are held. Time beyond it is not
 * lost: eds_elapsed_consume() carries it into the next iterations (up to
 * EDS_ELAPSED_MAX_CARRY_MS). */
#define DIAG_TICK_MAX_PER_LOOP_MS         (100U)

#ifndef CONFIG_DIAG_TICK_TASK_STACK_SIZE
#define CONFIG_DIAG_TICK_TASK_STACK_SIZE   (1024U)
#endif
#ifndef CONFIG_DIAG_TICK_TASK_PRIORITY
#define CONFIG_DIAG_TICK_TASK_PRIORITY     (5)
#endif

K_THREAD_STACK_DEFINE(s_tick_stack, CONFIG_DIAG_TICK_TASK_STACK_SIZE);
static struct k_thread s_tick_thread;

/* [EDS#353] uds_tick_task and doip_thread both touch uds_server_ctx_t
 * (session/security state) with no prior synchronization — the same
 * s_session_lock/s_security_lock pair the CAN examples already wrap
 * both their tick and dispatch call sites with, extended here to DoIP.
 * See docs/threading_guide.md's "Dual-Transport Concurrency" section:
 * the design intent was always "the same lock at every call site that
 * touches uds_server_ctx_t," never actually applied to this example. */
static diag_mutex_t s_session_lock;
static diag_mutex_t s_security_lock;

/* [EDS#399] Fed only by uds_tick_task, and only while doip_thread has
 * checked in recently. The window is the longest wait the server bounds
 * between check-ins (the accept poll with no client), plus margin for one
 * dispatch and its response send. See "WATCHDOG SUPERVISION" above. */
#define DOIP_SUPERVISION_WINDOW_MS  (DOIP_CHECKIN_MAX_WAIT_MS + 2000U)
static diag_wdt_t   s_wdt;
static atomic_t     s_doip_checkins;

static void doip_checkin_cb(void)
{
    (void)atomic_inc(&s_doip_checkins);
}

static void doip_lock_cb(void)
{
    (void)diag_mutex_lock(&s_session_lock);
    (void)diag_mutex_lock(&s_security_lock);
}

static void doip_unlock_cb(void)
{
    (void)diag_mutex_unlock(&s_security_lock);
    (void)diag_mutex_unlock(&s_session_lock);
}

static void s_on_session_change(uds_session_type_t old_sess,
                                uds_session_type_t new_sess)
{
    (void)old_sess;
    if (new_sess == UDS_SESSION_DEFAULT) {
        (void)uds_periodic_cancel_all();
    }
}

/* =============================================================================
 * UDS tick task [EDS#191]
 * ============================================================================= */

static void uds_tick_task_entry(void *p1, void *p2, void *p3)
{
    uds_server_ctx_t *srv = (uds_server_ctx_t *)p1;
    (void)p2;
    (void)p3;

    LOG_INF("UDS tick task started");

    /* [EDS#399] Time of the last DoIP check-in seen. Starts now, so a DoIP
     * thread that never starts is caught one window after arming. */
    atomic_val_t doip_seen       = atomic_get(&s_doip_checkins);
    int64_t      doip_checkin_ms = k_uptime_get();

    /* [EDS#401] One loop iteration is NOT 1 ms: k_msleep(1) rounds up and
     * adds a tick (~2 ms at 1 kHz), and a dispatch holding the locks below
     * delays it further. Counting iterations ran every UDS timer (S3,
     * SecurityAccess lockout, periodic) at about half speed. Run one tick
     * per millisecond actually elapsed instead, via the shared helper
     * [EDS#411]. */
    eds_elapsed_t tick_clock;
    eds_elapsed_init(&tick_clock, eds_platform_uptime_ms());

    while (true) {
        k_msleep(1);
        int64_t  now_ms  = k_uptime_get();
        uint32_t elapsed = eds_elapsed_consume(&tick_clock, eds_platform_uptime_ms(),
                                               DIAG_TICK_MAX_PER_LOOP_MS);

        /* [EDS#353] Same lock doip_lock_cb()/doip_unlock_cb() wrap
         * uds_server_process_request() with below. */
        (void)diag_mutex_lock(&s_session_lock);
        (void)diag_mutex_lock(&s_security_lock);
        for (uint32_t i = 0U; i < elapsed; i++) {
            (void)uds_server_tick_1ms(srv);
            (void)uds_periodic_tick_1ms();
        }
        (void)diag_mutex_unlock(&s_security_lock);
        (void)diag_mutex_unlock(&s_session_lock);

        /* [EDS#399] Feed only while the DoIP server loop is alive. Placed
         * after the lock pair, so a dispatch hung holding the locks stops
         * the feed too. */
        atomic_val_t doip_now = atomic_get(&s_doip_checkins);
        if (doip_now != doip_seen) {
            doip_seen       = doip_now;
            doip_checkin_ms = now_ms;
        }
        if ((now_ms - doip_checkin_ms) < (int64_t)DOIP_SUPERVISION_WINDOW_MS) {
            (void)diag_wdt_feed(&s_wdt);
        }
    }
}

/* =============================================================================
 * main()
 * ============================================================================= */

int main(void)
{
    uds_status_t      status;
    uds_server_ctx_t *srv = NULL;

#if defined(DIAG_WCET_MEASURE)
    /* [#31] Must run before any timing_counter_get() call site — see
     * transport/doip/doip_server.c's instrumented dispatch call. */
    timing_init();
    timing_start();
#endif

    LOG_INF("Xaloqi EDS BasicECU_DoIP starting (v1.6.0)");
    LOG_INF("DoIP logical address: 0x%04X  port: %u",
            (unsigned)DOIP_ECU_LOGICAL_ADDR, (unsigned)DOIP_PORT);

    /*
     * Security algorithm init.
     * For production: inject TRNG callback and OEM level keys.
     * See docs/SECURITY_NOTICE.md.
     */
    LOG_WRN("[SEC] Using placeholder AES keys — inject OEM keys before production.");
    (void)uds_security_algo_set_rng_cb(NULL);

    /*
     * [EDS#200] Must run before uds_generated_init() (dtc_mirror_init() at
     * Step 3.5 sits on top of nvm_store and silently no-ops until this
     * succeeds). This example only targets native_sim, where
     * platform/zephyr/nvm_store_mock.c (RAM-backed) is linked instead of
     * the real NVS backend — its nvm_store_init() ignores cfg entirely, so
     * NULL is correct here (see nvm_store.h: "may be NULL on host").
     */
    status = nvm_store_init(NULL);
    if (status != UDS_STATUS_OK) {
        LOG_ERR("NVM store init failed: 0x%02X — DTC mirror will not "
                "survive reset this run.", (unsigned)status);
    }

    /*
     * UDS stack init — DoIP build passes NULL for the CAN transport
     * because the stack will be driven by the DoIP server thread, not
     * a CAN poll loop. uds_generated_init() in a DoIP-only build does
     * not call isotp_init(); the generated code checks the transport
     * field from diagnostics_config.yaml.
     *
     * For a "transport: both" build, pass the real CAN transport here.
     */
#if defined(DIAG_DOIP_FLASH_BENCH)
    /* [EDS#423] Bench only: RequestDownload writes to real flash (bank 2,
     * partition image_1, see nucleo_h753zi_flash_bench.overlay). The erase
     * runs in steps after a 0x78; the DoIP server drives those steps with
     * uds_server_poll() and sends the final response [EDS#282]. Registered
     * before uds_generated_init(), as zephyr_flash_ops.h requires. */
    LOG_WRN("[BENCH] Flash-download build: 0x34/0x36/0x37 write flash bank 2.");
    if (zephyr_flash_ops_init() != UDS_STATUS_OK) {
        LOG_ERR("Flash ops init failed.");
        return -1;
    }
#endif

    status = uds_generated_init(NULL, 0U, 0U);
    if (status != UDS_STATUS_OK) {
        LOG_ERR("UDS stack init failed: 0x%02X", (unsigned)status);
        return -1;
    }

#if defined(DIAG_BENCH_SLOW_ROUTINE)
    /* [EDS#282] Bench only: RID 0xF0F0 answers 0x78 (bench_slow_routine.h);
     * the DoIP server drives it with uds_server_poll(). */
    LOG_WRN("[BENCH] Slow routine 0xF0F0 registered (response-pending bench).");
    if (bench_slow_routine_register() != UDS_STATUS_OK) {
        LOG_ERR("Bench slow routine registration failed.");
        return -1;
    }
#endif

    srv = uds_generated_get_server();
    if (srv == NULL) {
        LOG_ERR("UDS server context NULL after init.");
        return -1;
    }

    (void)uds_periodic_init();
    (void)uds_session_register_change_cb(srv->cfg.session_ctx,
                                          s_on_session_change);

    LOG_INF("UDS stack ready: %u DIDs  %u DTCs",
            (unsigned)GEN_DID_COUNT, (unsigned)GEN_DTC_COUNT);

    /* [EDS#353] Must be initialised and registered before the tick task
     * and DoIP server start below — both race on uds_server_ctx_t from
     * the moment either thread runs. */
    if ((diag_mutex_init(&s_session_lock)  != UDS_STATUS_OK) ||
        (diag_mutex_init(&s_security_lock) != UDS_STATUS_OK)) {
        LOG_ERR("Mutex init failed.");
        return -1;
    }
    eds_doip_set_lock_callbacks(doip_lock_cb, doip_unlock_cb);
    eds_doip_set_checkin_callback(doip_checkin_cb);   /* [EDS#399] */


    /*
     * [EDS#399] Arm the watchdog here, immediately before its only feeder
     * starts. Not earlier: on this example's NVS backend, nvm_store_init()
     * above may erase a flash sector, which can block far past the 100 ms
     * window, and there is no feeder yet. Fail closed: Zephyr's boot-time
     * arming is off (boards/nucleo_h753zi/nucleo_h753zi_doip.conf), so
     * ignoring a failure here would run unsupervised while appearing
     * supervised (EDS#306's class). On native_sim (CONFIG_WATCHDOG=n) this
     * returns OK in degraded mode. From here on, a `return -1` leaves no
     * DoIP check-ins and ends in a watchdog reset on hardware.
     */
    if (diag_wdt_init(&s_wdt) != UDS_STATUS_OK) {
        LOG_ERR("Watchdog arming failed — refusing to run unsupervised.");
        return -1;
    }
#if defined(DIAG_DOIP_FLASH_BENCH)
    /* [EDS#423] Feed across each bounded erase step (#312). */
    zephyr_flash_ops_set_wdt(&s_wdt);
#endif

    /*
     * [EDS#191] Start the 1 ms UDS tick task before the DoIP server so
     * S3/lockout timing is live from the moment a connection can arrive.
     */
    (void)k_thread_create(
        &s_tick_thread, s_tick_stack,
        K_THREAD_STACK_SIZEOF(s_tick_stack),
        uds_tick_task_entry,
        (void *)srv, NULL, NULL,
        CONFIG_DIAG_TICK_TASK_PRIORITY, 0U, K_NO_WAIT
    );
    k_thread_name_set(&s_tick_thread, "uds_tick_task");

    /*
     * [EDS#392] Vehicle discovery: on by default (CONFIG_EDS_DOIP_DISCOVERY),
     * configured from ecu.doip.discovery in diagnostics_config.yaml. The
     * generated config reads the VIN through the 0xF190 safety wrapper, on
     * the DoIP thread under the same lock as UDS dispatch; if 0xF190 is
     * restricted the response says "VIN not available".
     */
    eds_doip_set_discovery(uds_generated_doip_discovery());

    /*
     * Start DoIP server.
     * This registers the Zephyr BSD-socket platform ops with doip_server.c
     * and signals doip_thread (zephyr_lwip.c) to start — a semaphore, not
     * a fixed delay [EDS#192]. The thread then accepts TCP connections on
     * DOIP_ECU_LOGICAL_ADDR / DOIP_PORT.
     */
    status = eds_doip_platform_start(DOIP_ECU_LOGICAL_ADDR, DOIP_PORT, srv);
    if (status != UDS_STATUS_OK) {
        LOG_ERR("DoIP platform start failed: 0x%02X", (unsigned)status);
        return -1;
    }

    LOG_INF("DoIP server activated — awaiting TCP connections on port %u",
            (unsigned)DOIP_PORT);

    /*
     * main() returns here. The Zephyr kernel continues scheduling the
     * doip_thread. In native_sim the process stays alive until killed.
     */
    return 0;
}
```
