## CMakeLists.txt
```
# =============================================================================
# Xaloqi EDS
# examples/dual_transport_ecu/CMakeLists.txt
#
# PURPOSE: [EDS#197] CAN (ISO-TP, classic or FD) and DoIP on one ECU, both
#          producers of the diagnostic executor. The sources of basic_ecu
#          (CAN) and basic_ecu_doip (DoIP) together, without
#          EDS_DOIP_ONLY_BUILD.
#
# BUILDING (see README.md for the board files):
#   west build -b native_sim examples/dual_transport_ecu -- -DDIAG_SKIP_CODEGEN=ON \
#       -DEXTRA_CONF_FILE=boards/native_sim/native_sim.conf \
#       -DDTC_OVERLAY_FILE=boards/native_sim/native_sim.overlay
#   CAN FD: add fd.conf to EXTRA_CONF_FILE (CONFIG_CAN_FD_MODE=y).
#
# SAFETY CONTEXT : Example application — not safety-assessed.
# SPDX-License-Identifier: Apache-2.0
# =============================================================================

cmake_minimum_required(VERSION 3.20.0)

# [#414] EDS Kconfig comes from this tree. Must precede find_package(Zephyr).
include(${CMAKE_CURRENT_SOURCE_DIR}/../../cmake/eds_zephyr_module.cmake)

find_package(Zephyr REQUIRED HINTS $ENV{ZEPHYR_BASE})

project(dual_transport_ecu
    VERSION     1.0.0
    LANGUAGES   C
    DESCRIPTION "CAN + DoIP on the diagnostic executor — Xaloqi EDS (EDS#197)"
)

set(CMAKE_C_STANDARD          11)
set(CMAKE_C_STANDARD_REQUIRED ON)
set(CMAKE_C_EXTENSIONS        OFF)

# [#515] -Wundef (MISRA 20.9) applies to EDS code only.
include(${CMAKE_CURRENT_SOURCE_DIR}/../../cmake/eds_third_party_headers.cmake)
eds_third_party_headers_are_system(app)

target_compile_options(app PRIVATE
    -Wall -Wextra -Wshadow -Wdouble-promotion -Wundef
    -Wno-unused-parameter -Wno-sign-conversion
    -fstack-usage
)

# ---------------------------------------------------------------------------
# Paths and codegen
# ---------------------------------------------------------------------------
set(DIAG_ROOT           "${CMAKE_CURRENT_SOURCE_DIR}/../..")
set(DIAG_CONFIG_YAML    "${CMAKE_CURRENT_SOURCE_DIR}/diagnostics_config.yaml")
set(DIAG_CODEGEN_SCRIPT "${DIAG_ROOT}/tools/codegen.py")
set(DIAG_GENERATED_DIR  "${CMAKE_CURRENT_SOURCE_DIR}/generated")
set(CODEGEN_SENTINEL    "${DIAG_GENERATED_DIR}/safety_config.h")

option(DIAG_SKIP_CODEGEN "Skip auto-running codegen.py" OFF)

if(NOT DIAG_SKIP_CODEGEN)
    find_package(Python3 COMPONENTS Interpreter QUIET)
    if(NOT Python3_FOUND)
        message(FATAL_ERROR "[DIAG] Python3 not found — cannot run codegen.")
    endif()
    file(GLOB DIAG_TEMPLATES "${DIAG_ROOT}/tools/templates/*.j2")
    add_custom_command(
        OUTPUT   "${CODEGEN_SENTINEL}"
        COMMAND  "${Python3_EXECUTABLE}"
                 "${DIAG_CODEGEN_SCRIPT}"
                 --config "${DIAG_CONFIG_YAML}"
                 --out    "${DIAG_GENERATED_DIR}"
                 --safety-wrappers --asil-level B --no-manifest
        DEPENDS  "${DIAG_CONFIG_YAML}" "${DIAG_CODEGEN_SCRIPT}" ${DIAG_TEMPLATES}
        COMMENT  "[DIAG] Generating dual-transport ECU sources from diagnostics_config.yaml..."
        VERBATIM
    )
    add_custom_target(run_codegen DEPENDS "${CODEGEN_SENTINEL}")
    add_dependencies(app run_codegen)
endif()

target_include_directories(app PRIVATE
    ${DIAG_ROOT}/core
    ${DIAG_ROOT}/core/uds_services
    ${DIAG_ROOT}/transport
    ${DIAG_ROOT}/transport/doip
    ${DIAG_ROOT}/config
    ${DIAG_ROOT}/platform
    ${DIAG_ROOT}/platform/zephyr
    ${DIAG_GENERATED_DIR}
    ${CMAKE_CURRENT_SOURCE_DIR}/src
)

# ---------------------------------------------------------------------------
# Sources
# ---------------------------------------------------------------------------
include(${DIAG_ROOT}/cmake/eds_service_sources.cmake)   # EDS_SERVICE_SRCS (uds_exec.c too)

target_sources(app PRIVATE
    # Application: main() and the CAN producer
    ${CMAKE_CURRENT_SOURCE_DIR}/src/main.c
    ${CMAKE_CURRENT_SOURCE_DIR}/src/can_producer.c

    # UDS core and services
    ${DIAG_ROOT}/core/uds_server.c
    ${DIAG_ROOT}/core/uds_session.c
    ${DIAG_ROOT}/core/uds_security.c
    ${DIAG_ROOT}/core/uds_safety.c
    ${DIAG_ROOT}/core/uds_security_algo.c
    ${DIAG_ROOT}/core/uds_access_table.c
    ${DIAG_ROOT}/core/uds_comm_control.c
    ${DIAG_ROOT}/core/uds_session_stats.c
    ${DIAG_ROOT}/core/uds_security_nvm.c
    ${DIAG_ROOT}/core/uds_aes_cmac.c
    ${EDS_SERVICE_SRCS}
    ${DIAG_ROOT}/core/uds_transfer_ctx.c
    ${DIAG_ROOT}/platform/uds_flash_ops.c
    ${DIAG_ROOT}/platform/uds_image_policy.c

    # CAN: ISO-TP and the Zephyr CAN binding
    ${DIAG_ROOT}/transport/isotp.c
    ${DIAG_ROOT}/transport/can_transport.c
    ${DIAG_ROOT}/platform/zephyr/zephyr_can.c

    # DoIP: the server and its Zephyr binding
    ${DIAG_ROOT}/transport/doip/doip_server.c
    ${DIAG_ROOT}/transport/doip/zephyr_lwip.c
    ${DIAG_ROOT}/platform/zephyr/platform_doip.c

    # Configuration databases
    ${DIAG_ROOT}/config/did_database.c
    ${DIAG_ROOT}/config/dtc_database.c
    ${DIAG_ROOT}/config/routine_database.c
    ${DIAG_ROOT}/config/dtc_mirror.c

    # Zephyr platform: CAN port, the executor, the watchdog
    ${DIAG_ROOT}/platform/zephyr/zephyr_port.c
    ${DIAG_ROOT}/platform/zephyr/zephyr_mutex.c
    ${DIAG_ROOT}/platform/zephyr/zephyr_timer.c
    ${DIAG_ROOT}/platform/zephyr/zephyr_platform_api.c
    ${DIAG_ROOT}/platform/zephyr/zephyr_exec.c
    ${DIAG_ROOT}/platform/zephyr/zephyr_wdt.c

    # Generated
    ${DIAG_GENERATED_DIR}/did_handlers.c
    ${DIAG_GENERATED_DIR}/uds_init.c
    ${DIAG_GENERATED_DIR}/did_safety_wrappers.c
    ${DIAG_GENERATED_DIR}/routine_handlers.c
)

# NVM store (EDS#408): the RAM mock on native_sim; on hardware the board's
# diag_nvs partition (pass boards/<board>/<board>.overlay as DTC_OVERLAY_FILE).
include(${DIAG_ROOT}/cmake/eds_nvm_backend.cmake)
eds_select_nvm_backend(app ${DIAG_ROOT})

target_compile_definitions(app PRIVATE
    EDS_MSG_BUF_MAX_STACK_BYTES=8192
)

# CAN FD (fd.conf): the FD code paths of ISO-TP, in every file that sees
# isotp_cfg_t, and an FD channel in src/main.c.
if(CONFIG_CAN_FD_MODE)
    target_compile_definitions(app PRIVATE ISOTP_ENABLE_CAN_FD=1)
endif()
```

## prj.conf
```kconfig
# examples/dual_transport_ecu/prj.conf — [EDS#197] CAN + DoIP on the executor.
# basic_ecu's CAN settings and basic_ecu_doip's networking, together.

# --- CAN ---
CONFIG_CAN=y
CONFIG_CAN_INIT_PRIORITY=80

# --- Kernel ---
CONFIG_MULTITHREADING=y
CONFIG_THREAD_STACK_INFO=y
CONFIG_THREAD_NAME=y
CONFIG_THREAD_MONITOR=y
CONFIG_SYS_CLOCK_TICKS_PER_SEC=1000
CONFIG_TICKLESS_KERNEL=n
CONFIG_HEAP_MEM_POOL_SIZE=0

# --- Logging and checks ---
CONFIG_LOG=y
CONFIG_LOG_DEFAULT_LEVEL=3
CONFIG_ASSERT=y
CONFIG_STACK_CANARIES=y
CONFIG_EDS_REQUIRE_STACK_CANARIES=y

# --- Networking (DoIP over TCP, discovery over UDP) ---
CONFIG_NETWORKING=y
CONFIG_NET_IPV4=y
CONFIG_NET_TCP=y
CONFIG_NET_UDP=y
CONFIG_NET_SOCKETS=y
CONFIG_NET_IF_MAX_IPV4_COUNT=1
CONFIG_NET_MAX_CONN=8
CONFIG_NET_TCP_MAX_SEND_WINDOW_SIZE=4096
CONFIG_ZVFS_OPEN_MAX=16

CONFIG_BUILD_OUTPUT_BIN=y
```

## fd.conf
```kconfig
# examples/dual_transport_ecu/fd.conf — CAN FD instead of classic CAN.
# Add after the board's conf in EXTRA_CONF_FILE. The controller runs in FD
# mode, ISO-TP builds its FD paths and src/main.c opens an FD channel
# (TX_DL 64, bit rate switch on). The board needs an FD controller.
CONFIG_CAN_FD_MODE=y
```

## boards/native_sim/native_sim.overlay
```dts
/*
 * Xaloqi EDS — dual_transport_ecu
 * boards/native_sim/native_sim.overlay (pass it as DTC_OVERLAY_FILE)
 *
 * CAN on the host's SocketCAN interface zcan0 (Zephyr's native Linux CAN
 * driver; a vcan named zcan0 will do). DoIP on the TAP interface zeth
 * (boards/native_sim/native_sim.conf). See README.md for the host side.
 */
/ {
    aliases {
        can0 = &can0;
    };
};

&can0 {
    status = "okay";
};
```

## boards/nucleo_h753zi/nucleo_h753zi.overlay
```dts
/* SPDX-License-Identifier: Apache-2.0 */
/* Copyright (c) 2026 Xaloqi */
/*
 * examples/dual_transport_ecu/boards/nucleo_h753zi/nucleo_h753zi.overlay
 *
 * [EDS#399] Exposes the STM32 independent watchdog (IWDG) as the system
 * watchdog. Zephyr's nucleo_h753zi board leaves &iwdg disabled and defines
 * no watchdog0 alias; platform/zephyr/zephyr_wdt.c resolves the watchdog
 * through that alias and refuses to build with CONFIG_WATCHDOG=y without it
 * (EDS#306). Same two settings as examples/safeboot_ecu's overlay for this
 * board. Pass with -DEXTRA_DTC_OVERLAY_FILE (see nucleo_h753zi.conf).
 */

/ {
	aliases {
		watchdog0 = &iwdg;
	};
};

&iwdg {
	status = "okay";
};
```

## src/main.c
```c
/*
 * =============================================================================
 * Xaloqi EDS
 * FILE: examples/dual_transport_ecu/src/main.c
 *
 * PURPOSE: [EDS#197] CAN and DoIP on one ECU. Both transports are producers
 *          of the diagnostic executor, the one thread that owns the UDS
 *          server (platform/zephyr/zephyr_exec.c, core/uds_exec.h).
 *
 * THREAD MODEL:
 *   main()      — init, then starts the threads below and returns.
 *   can_task    — priority 4, every 1 ms: can_producer_step() (src/
 *                 can_producer.c). Drains every queued CAN frame (EDS#558),
 *                 ticks ISO-TP, posts a reassembled request without waiting
 *                 for it, sends finished responses and routed frames. Above
 *                 the executor, so RX keeps draining while a dispatch runs.
 *   eds_exec    — priority 5: 1 ms ticks (S3, lockout, periodic), every
 *                 dispatch, round-robin over the two producers, the pending
 *                 job, the ECUReset. Feeds the watchdog after each pass.
 *   doip_thread — priority 7 (zephyr_lwip.c): eds_doip_server_run() with
 *                 eds_doip_set_executor(): posts each request and waits.
 *
 *   A session belongs to the transport that opened it (decision ⬥A): while
 *   CAN holds an extended session, DoIP's physical requests are answered
 *   7F sid 21, and the other way round.
 *
 * CAN classic or CAN FD: the example sets up its own ISO-TP channel from the
 *   generated CAN IDs (uds_generated_init() gets no CAN transport), as a CAN
 *   FD channel when CONFIG_CAN_FD_MODE=y (fd.conf), classic otherwise.
 *
 * WATCHDOG (hardware, CONFIG_WATCHDOG=y): fed by the executor after each
 *   pass, only while can_task has run within CAN_SUPERVISION_WINDOW_MS and
 *   the DoIP server has checked in within DOIP_SUPERVISION_WINDOW_MS. A
 *   stalled executor, CAN loop or DoIP thread resets the ECU.
 *
 * SPDX-License-Identifier: Apache-2.0
 * =============================================================================
 */

#include "uds_types.h"
#include "uds_server.h"
#include "uds_session.h"
#include "uds_periodic.h"
#include "uds_security_algo.h"
#include "isotp.h"
#include "can_transport.h"
#include "zephyr_port.h"
#include "platform_api.h"
#include "platform_doip.h"
#include "doip_server.h"
#include "zephyr_exec.h"
#include "zephyr_wdt.h"
#include "eds_nvm_diag_nvs.h"
#include "uds_init.h"
#include "generated_config.h"
#include "can_producer.h"

#include <string.h>

#include <zephyr/kernel.h>
#include <zephyr/device.h>
#include <zephyr/sys/atomic.h>
#include <zephyr/logging/log.h>
#include <zephyr/logging/log_ctrl.h>
#if (CONFIG_EDS_DOIP_EXAMPLE_NET_IF_MTU > 0)
#include <zephyr/net/net_if.h>
#endif

LOG_MODULE_REGISTER(dual_transport_ecu, LOG_LEVEL_INF);

/* ---------------------------------------------------------------------------
 * Configuration
 * ---------------------------------------------------------------------------*/

#define DIAG_CAN_DEV           DEVICE_DT_GET(DT_ALIAS(can0))
#define DOIP_ECU_LOGICAL_ADDR  (0xE400U)   /* diagnostics_config.yaml ecu.doip */
#define SRC_CAN                (0U)        /* EDS_DOIP_UDS_SRC is 1 */

#define CAN_TASK_STACK_SIZE    (2048U)
#define CAN_TASK_PRIORITY      (4)

/* The DoIP server's longest bounded wait between check-ins, plus margin for
 * one dispatch and its send (as basic_ecu_doip). The CAN loop runs every
 * 1 ms; 100 ms of silence means it has stopped. */
#define DOIP_SUPERVISION_WINDOW_MS  (DOIP_CHECKIN_MAX_WAIT_MS + 2000U)
#define CAN_SUPERVISION_WINDOW_MS   (100U)

#if defined(CONFIG_CAN_FD_MODE)
#define DUAL_CAN_FD_TX_DL      (64U)
#endif

/* ---------------------------------------------------------------------------
 * State
 * ---------------------------------------------------------------------------*/

K_THREAD_STACK_DEFINE(s_can_stack, CAN_TASK_STACK_SIZE);
static struct k_thread s_can_thread;
static struct k_timer  s_can_tick;

static isotp_ctx_t    s_tp;
static can_producer_t s_can_prod;
static diag_wdt_t     s_wdt;

static atomic_t     s_doip_checkins;
static atomic_t     s_can_steps;
static atomic_val_t s_doip_seen;       /* executor thread only */
static atomic_val_t s_can_seen;        /* executor thread only */
static int64_t      s_doip_seen_ms;    /* executor thread only */
static int64_t      s_can_seen_ms;     /* executor thread only */

/* CAN: periodic messages go out as UUDT frames (decision ⬥E). DoIP has no
 * periodic TX yet, so 0x2A over DoIP answers NRC 0x22 (EDS#546). */
static const uds_exec_producer_cfg_t s_producers[] = {
    { .src = SRC_CAN,                   .periodic_tx = true  },
    { .src = (uint8_t)EDS_DOIP_UDS_SRC, .periodic_tx = false },
};

/* ---------------------------------------------------------------------------
 * Executor bindings
 * ---------------------------------------------------------------------------*/

/* An ECUReset, once the producer that asked for it has handed the response
 * to its transport and released its slot: persist, let the response leave
 * (ISO-TP's As or the TCP stack: the same 50 ms), reset. */
static void exec_ecu_reset(uint8_t reset_type)
{
    const uds_server_ctx_t *srv = uds_generated_get_server();

    /* [EDS#197] Runs on the executor, the server's one owner, so the read
     * is race-free. scripts/smoke_dual_transport_ecu.py compares it with
     * the requests its two testers sent. */
    if (srv != NULL) {
        LOG_INF("Reset requested: request_count=%u negative_response_count=%u",
                (unsigned)srv->request_count, (unsigned)srv->negative_response_count);
    }
    log_panic();   /* deferred logging: flush before the reset takes the process down */
    (void)eds_platform_nvm_flush();
    (void)k_msleep((int32_t)DOIP_RESET_TX_GRACE_MS);
    (void)eds_platform_ecu_reset(reset_type);
}

/* After every executor pass: feed only while both producers are alive. */
static void exec_after_pass(void)
{
    int64_t      now  = k_uptime_get();
    atomic_val_t doip = atomic_get(&s_doip_checkins);
    atomic_val_t can  = atomic_get(&s_can_steps);

    if (doip != s_doip_seen) {
        s_doip_seen    = doip;
        s_doip_seen_ms = now;
    }
    if (can != s_can_seen) {
        s_can_seen    = can;
        s_can_seen_ms = now;
    }
    if (((now - s_doip_seen_ms) < (int64_t)DOIP_SUPERVISION_WINDOW_MS) &&
        ((now - s_can_seen_ms) < (int64_t)CAN_SUPERVISION_WINDOW_MS)) {
        (void)diag_wdt_feed(&s_wdt);
    }
}

static void doip_checkin_cb(void)
{
    (void)atomic_inc(&s_doip_checkins);
}

static void s_on_session_change(uds_session_type_t old_sess, uds_session_type_t new_sess)
{
    (void)old_sess;
    if (new_sess == UDS_SESSION_DEFAULT) {
        (void)uds_periodic_cancel_all();
    }
}

/* ---------------------------------------------------------------------------
 * CAN thread: the producer, never blocked by the executor
 * ---------------------------------------------------------------------------*/

static void can_task_entry(void *p1, void *p2, void *p3)
{
    ARG_UNUSED(p1);
    ARG_UNUSED(p2);
    ARG_UNUSED(p3);

    k_timer_init(&s_can_tick, NULL, NULL);
    k_timer_start(&s_can_tick, K_MSEC(1), K_MSEC(1));
    for (;;) {
        (void)k_timer_status_sync(&s_can_tick);
        can_producer_step(&s_can_prod);
        (void)atomic_inc(&s_can_steps);
    }
}

/* The CAN channel, classic or FD (see the file header). */
static uds_status_t can_channel_init(can_transport_t *can)
{
    isotp_cfg_t cfg;

    (void)memset(&cfg, 0, sizeof(cfg));
    cfg.rx_can_id            = (uint32_t)GEN_CAN_RX_ID;
    cfg.tx_can_id            = (uint32_t)GEN_CAN_TX_ID;
    cfg.functional_rx_can_id = (uint32_t)GEN_CAN_FUNCTIONAL_RX_ID;
    cfg.periodic_tx_can_id   = (uint32_t)GEN_CAN_PERIODIC_TX_ID;
    cfg.block_size           = (uint8_t)ISOTP_DEFAULT_BLOCK_SIZE;
    cfg.stmin_ms             = (uint8_t)ISOTP_DEFAULT_STMIN_MS;
#if defined(CONFIG_CAN_FD_MODE)
    cfg.use_fd               = true;
    cfg.tx_dl                = (uint8_t)DUAL_CAN_FD_TX_DL;
    cfg.brs                  = true;
#endif
    cfg.can                  = can;
    return isotp_init(&s_tp, &cfg);
}

/* ---------------------------------------------------------------------------
 * main()
 * ---------------------------------------------------------------------------*/

int main(void)
{
    uds_status_t      status;
    can_transport_t  *can = NULL;
    uds_server_ctx_t *srv = NULL;

    LOG_INF("Xaloqi EDS " GEN_ECU_NAME " v" GEN_ECU_VERSION ": CAN %s + DoIP 0x%04X:%u",
            IS_ENABLED(CONFIG_CAN_FD_MODE) ? "FD" : "classic",
            (unsigned)DOIP_ECU_LOGICAL_ADDR, (unsigned)DOIP_PORT);
    LOG_WRN("[SEC] Placeholder AES keys: inject OEM keys before production.");
    (void)uds_security_algo_set_rng_cb(NULL);

    /* [EDS#408] Armed before the NVM store opens (an append-backend erase
     * feeds it); fail closed. A no-op on native_sim (CONFIG_WATCHDOG=n). */
    if (diag_wdt_init(&s_wdt) != UDS_STATUS_OK) {
        LOG_ERR("Watchdog arming failed: refusing to run unsupervised.");
        return -1;
    }

    {
        const zephyr_port_cfg_t port_cfg = {
            .can_dev        = DIAG_CAN_DEV,
            .physical_rx_id = (uint32_t)GEN_CAN_RX_ID,
        };
        status = zephyr_port_init(&port_cfg, &can);
        if (status != UDS_STATUS_OK) {
            LOG_ERR("CAN platform init failed: 0x%02X", (unsigned)status);
            return -1;
        }
    }

    /* [EDS#200] Before uds_generated_init(): the DTC mirror sits on it. */
    status = eds_nvm_init_diag_nvs(&s_wdt);
    if (status != UDS_STATUS_OK) {
        LOG_ERR("NVM store init failed: 0x%02X; the DTC mirror will not survive a reset.",
                (unsigned)status);
    }
    (void)diag_wdt_feed(&s_wdt);

    /* No CAN transport here: the example owns the ISO-TP channel (above). */
    status = uds_generated_init(NULL, 0U, 0U);
    srv = uds_generated_get_server();
    if ((status != UDS_STATUS_OK) || (srv == NULL)) {
        LOG_ERR("UDS stack init failed: 0x%02X", (unsigned)status);
        return -1;
    }
    status = can_channel_init(can);
    if (status != UDS_STATUS_OK) {
        LOG_ERR("ISO-TP init failed: 0x%02X", (unsigned)status);
        return -1;
    }
    (void)uds_periodic_init();
    (void)uds_session_register_change_cb(srv->cfg.session_ctx, s_on_session_change);
    (void)diag_wdt_feed(&s_wdt);

    /* The executor first: S3, lockout and the watchdog feed are live before
     * either transport can deliver a request. Both supervision clocks start
     * now, so a producer that never starts is caught one window later. */
    s_doip_seen_ms = k_uptime_get();
    s_can_seen_ms  = s_doip_seen_ms;
    {
        const zephyr_exec_cfg_t ec = {
            .srv            = srv,
            .producers      = s_producers,
            .producer_count = (uint8_t)ARRAY_SIZE(s_producers),
            .reset          = exec_ecu_reset,
            .after_pass     = exec_after_pass,
        };

        status = zephyr_exec_start(&ec);
        if (status != UDS_STATUS_OK) {
            LOG_ERR("Executor start failed: 0x%02X", (unsigned)status);
            return -1;
        }
    }

    /* CAN producer and its thread. */
    can_producer_init(&s_can_prod, zephyr_exec_get(), SRC_CAN, &s_tp, can);
    (void)k_thread_create(&s_can_thread, s_can_stack, K_THREAD_STACK_SIZEOF(s_can_stack),
                          can_task_entry, NULL, NULL, NULL,
                          CAN_TASK_PRIORITY, 0U, K_NO_WAIT);
    (void)k_thread_name_set(&s_can_thread, "can_task");

    /* DoIP producer. Discovery as generated (transport: both). */
    (void)eds_doip_set_executor(zephyr_exec_get(), zephyr_exec_wait_event);
    eds_doip_set_checkin_callback(doip_checkin_cb);   /* [EDS#399] */
    eds_doip_set_discovery(uds_generated_doip_discovery());

#if (CONFIG_EDS_DOIP_EXAMPLE_NET_IF_MTU > 0)
    /* [EDS#648] Cap the MSS this board advertises, before the first
     * connection (see the Kconfig help and the FRDM board conf). */
    {
        struct net_if *iface = net_if_get_default();

        if (iface == NULL) {
            LOG_ERR("No default network interface for the MTU of EDS#648");
            return -1;
        }
        net_if_set_mtu(iface, (uint16_t)CONFIG_EDS_DOIP_EXAMPLE_NET_IF_MTU);
        LOG_INF("Network interface MTU set to %u", (unsigned)net_if_get_mtu(iface));
    }
#endif

    status = eds_doip_platform_start(DOIP_ECU_LOGICAL_ADDR, DOIP_PORT, srv);
    if (status != UDS_STATUS_OK) {
        LOG_ERR("DoIP platform start failed: 0x%02X", (unsigned)status);
        return -1;
    }
    LOG_INF("Ready: CAN 0x%03X/0x%03X (functional 0x%03X), DoIP port %u",
            (unsigned)GEN_CAN_RX_ID, (unsigned)GEN_CAN_TX_ID,
            (unsigned)GEN_CAN_FUNCTIONAL_RX_ID, (unsigned)DOIP_PORT);
    return 0;
}
```

## src/can_producer.c
```c
/*
 * =============================================================================
 * Xaloqi EDS
 * FILE: examples/dual_transport_ecu/src/can_producer.c
 *
 * PURPOSE: [EDS#197] ISO-TP as a producer of the diagnostic executor. See
 *          can_producer.h.
 *
 * SPDX-License-Identifier: Apache-2.0
 * =============================================================================
 */

#include "can_producer.h"

#include <stddef.h>
#include <string.h>

void can_producer_init(can_producer_t *p, uds_exec_t *ex, uint8_t src,
                       isotp_ctx_t *tp, can_transport_t *can)
{
    (void)memset(p, 0, sizeof(*p));
    p->ex  = ex;
    p->src = src;
    p->tp  = tp;
    p->can = can;
}

/* The producer's own 0x21 answers, oldest first, while ISO-TP takes them. */
static void send_owed_nrc(can_producer_t *p)
{
    while ((p->nrc_count > 0U) &&
           (isotp_transmit(p->tp, p->nrc[p->nrc_head], 3U) != UDS_STATUS_ERR_BUSY)) {
        p->nrc_head = (uint8_t)((p->nrc_head + 1U) % CAN_PRODUCER_NRC_QUEUE);
        p->nrc_count--;
        p->stats.answered++;
    }
}

/* 7F sid 21 for a request the producer answers itself: sent now, or held
 * until ISO-TP has finished the response it is sending. */
static void answer_busy(can_producer_t *p, uint8_t sid)
{
    uint8_t *n;

    if (p->nrc_count < CAN_PRODUCER_NRC_QUEUE) {
        n = p->nrc[(p->nrc_head + p->nrc_count) % CAN_PRODUCER_NRC_QUEUE];
        n[0] = (uint8_t)UDS_SID_NEGATIVE_RESPONSE;
        n[1] = sid;
        n[2] = (uint8_t)UDS_NRC_BUSY_REPEAT_REQUEST;
        p->nrc_count++;
        p->stats.local_busy++;
        send_owed_nrc(p);
    } else {
        p->stats.dropped++;   /* a tester four requests ahead of its answers */
    }
}

/* ISO-TP has reassembled a request (CAN thread). Post it, or answer it. */
static void on_rx_complete(const uint8_t *data, uint32_t length, void *arg)
{
    can_producer_t          *p = (can_producer_t *)arg;
    uds_addressing_t         addressing = UDS_ADDRESSING_PHYSICAL;
    uds_exec_submit_result_t r = UDS_EXEC_REJECT_BUSY;

    if ((length == 0U) || (length > (uint32_t)UDS_MAX_PAYLOAD_LEN)) {
        return;
    }
    (void)isotp_get_rx_addressing(p->tp, &addressing);

    if (!p->in_flight) {
        /* Our slot is free: the pair is ours to fill (contract 2). */
        (void)memcpy(p->req.data, data, (size_t)length);
        p->req.length  = (uint16_t)length;
        p->resp.length = 0U;
        r = uds_exec_submit(p->ex, p->src, &p->req, &p->resp, addressing);
        if (r == UDS_EXEC_POSTED) {
            p->in_flight = true;
            p->stats.posted++;
        }
    } else if (addressing == UDS_ADDRESSING_FUNCTIONAL) {
        r = UDS_EXEC_DROPPED;   /* 3E 80 among them: S3 is served by the request in flight */
    } else {
        /* A second request while ours is posted: 0x21 below, the posted
         * pair untouched. */
    }

    if (r == UDS_EXEC_REJECT_BUSY) {
        answer_busy(p, data[0]);   /* ours is in flight, or another producer's job step runs */
    } else if (r == UDS_EXEC_DROPPED) {
        p->stats.dropped++;
    } else {
        /* POSTED; INVALID (no slot for this source) is answered by nobody. */
    }
}

/* [EDS#558] Every queued frame, at most the queue depth: the Flow Control
 * BlockSize keeps a burst within the RX queue only if each step empties it. */
static void drain_rx(can_producer_t *p)
{
    uds_can_frame_t frame;
    bool            ready = true;
    uint32_t        n;
    uds_status_t    rc;

    for (n = 0U; ready && (n < (uint32_t)EDS_CAN_RX_QUEUE_DEPTH); n++) {
        ready = false;
        rc = can_transport_receive(p->can, &frame, &ready);
        if (rc == UDS_STATUS_ERR_CAN_BUS_OFF) {
            p->stats.bus_off++;
        } else if ((rc == UDS_STATUS_OK) && ready) {
            (void)isotp_process_rx_frame(p->tp, &frame, on_rx_complete, p);
        } else {
            /* nothing queued */
        }
    }
}

/* Our request ran: hand its response to ISO-TP, then release the slot
 * (contract 1). A busy channel keeps the slot for the next step; any other
 * result, a send error among them, releases it. An ECUReset the request
 * owes is performed by the executor after the release. */
static void send_response(can_producer_t *p)
{
    uds_status_t rc = UDS_STATUS_OK;

    if (p->in_flight && uds_exec_done(p->ex, p->src)) {
        if (p->resp.length > 0U) {
            rc = isotp_transmit(p->tp, p->resp.data, (uint32_t)p->resp.length);
        }
        if (rc != UDS_STATUS_ERR_BUSY) {
            if (p->resp.length > 0U) {
                p->stats.answered++;
            }
            uds_exec_release(p->ex, p->src);
            p->in_flight = false;
        }
    }
}

/* A frame the executor routed here: a job's 7F sid 78 or final response on
 * the ISO-TP channel, or a periodic message as a UUDT frame (EDS#546). Not
 * sent: offered again (a job frame) or skipped until its next period. */
static void send_pushed(can_producer_t *p)
{
    const uds_msg_buf_t *f;
    bool                 periodic = false;
    uds_status_t         rc;

    f = uds_exec_push_frame(p->ex, p->src, &periodic);
    if (f != NULL) {
        rc = periodic ? isotp_transmit_uudt(p->tp, f->data, (uint32_t)f->length)
                      : isotp_transmit(p->tp, f->data, (uint32_t)f->length);
        if (rc == UDS_STATUS_OK) {
            p->stats.pushed++;
        }
        uds_exec_push_done(p->ex, p->src, rc == UDS_STATUS_OK);
    }
}

void can_producer_step(can_producer_t *p)
{
    drain_rx(p);
    (void)isotp_tick_1ms(p->tp);
    send_owed_nrc(p);
    send_response(p);
    /* A job's frames follow its first answer (7F sid 78) on the channel. */
    if (!p->in_flight) {
        send_pushed(p);
    }
}
```

## src/can_producer.h
```c
/*
 * =============================================================================
 * Xaloqi EDS
 * FILE: examples/dual_transport_ecu/src/can_producer.h
 *
 * PURPOSE: [EDS#197] The CAN side of dual_transport_ecu: ISO-TP as a producer
 *          of the diagnostic executor (core/uds_exec.h). RTOS-free: the
 *          example's CAN thread calls can_producer_step() every 1 ms, and
 *          tests/concurrency/tsan_c2_dual_transport.c runs the same code on
 *          the host.
 *
 *          The producer never blocks. Each step drains every queued CAN
 *          frame (EDS#558), ticks ISO-TP, sends a finished response and
 *          releases its slot, then sends a frame the executor routed to it.
 *          A request is posted as soon as ISO-TP has reassembled it.
 *
 *  Producer contracts (uds_exec.h):
 *    1. uds_exec_release() on every exit path: the response handed to
 *       ISO-TP, nothing to send, or a send error.
 *    2. While its request is posted, the producer does not write that
 *       request's buffers. It keeps receiving: ISO-TP reassembles the next
 *       request into its own buffer, and a second complete physical request
 *       is answered 7F sid 21 from a three-byte buffer of the producer's
 *       own (a functional one is dropped), without touching the posted pair.
 *
 * SPDX-License-Identifier: Apache-2.0
 * =============================================================================
 */

#ifndef CAN_PRODUCER_H
#define CAN_PRODUCER_H

#include "uds_exec.h"
#include "isotp.h"
#include "can_transport.h"

#include <stdbool.h>
#include <stdint.h>

/** Counters, for the example's log and the concurrency test. */
typedef struct can_producer_stats {
    uint32_t posted;        /**< Requests posted to the executor.                       */
    uint32_t answered;      /**< Responses (or 0x21 answers) handed to ISO-TP.          */
    uint32_t local_busy;    /**< 7F sid 21 answered by the producer itself.             */
    uint32_t dropped;       /**< Functional requests dropped while busy, and 0x21
                                 answers beyond CAN_PRODUCER_NRC_QUEUE.                 */
    uint32_t pushed;        /**< Routed frames sent: job frames and periodic messages.  */
    uint32_t bus_off;       /**< can_transport_receive() reported bus-off.              */
} can_producer_stats_t;

/** 7F sid 21 answers held while ISO-TP is busy sending; more are dropped (counted). */
#define CAN_PRODUCER_NRC_QUEUE  (4U)

typedef struct can_producer {
    uds_exec_t           *ex;
    uint8_t               src;
    isotp_ctx_t          *tp;
    can_transport_t      *can;
    uds_msg_buf_t         req;        /* the posted request: the executor's until done */
    uds_msg_buf_t         resp;       /* its response                                  */
    bool                  in_flight;  /* posted, not yet answered and released          */
    uint8_t               nrc[CAN_PRODUCER_NRC_QUEUE][3]; /* 7F sid 21 not yet sent   */
    uint8_t               nrc_head;
    uint8_t               nrc_count;
    can_producer_stats_t  stats;
} can_producer_t;

/** @brief Bind the producer to the executor, its source and the ISO-TP channel. */
void can_producer_init(can_producer_t *p, uds_exec_t *ex, uint8_t src,
                       isotp_ctx_t *tp, can_transport_t *can);

/** @brief One 1 ms step on the CAN thread (see the file header). Never blocks. */
void can_producer_step(can_producer_t *p);

#endif /* CAN_PRODUCER_H */
```
