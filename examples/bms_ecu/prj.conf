## CMakeLists.txt
```
# =============================================================================
# Xaloqi EDS
# examples/bms_ecu/CMakeLists.txt
#
# PURPOSE: Stand-alone Zephyr build for the BMS (Battery Management System)
#          example ECU.
#
# TARGET BOARD: native_sim (simulation / CI, no hardware required)
#               nucleo_h743zi (representative STM32H7 target)
#               Any Zephyr-supported board with CAN peripheral
#
# BUILDING:
#   # Simulation build (CI / host testing, no hardware required):
#   # [O-132] -DEXTRA_CONF_FILE was missing here — this example's own
#   # boards/native_sim/native_sim.conf (nested) is never auto-discovered
#   # by Zephyr (only a flat boards/<board>.conf is), so the documented
#   # command below silently built without it and failed on
#   # CONFIG_WATCHDOG. Pass it explicitly:
#   west build -b native_sim examples/bms_ecu \
#     -- -DDIAG_SKIP_CODEGEN=ON \
#     -DEXTRA_CONF_FILE=<eds>/examples/bms_ecu/boards/native_sim/native_sim.conf \
#     -DDTC_OVERLAY_FILE=<eds>/examples/bms_ecu/boards/native_sim/native_sim.overlay
#
#   # STM32H7 cross-compile:
#   west build -b nucleo_h743zi examples/bms_ecu \
#     -- -DDIAG_SKIP_CODEGEN=ON \
#     -DEXTRA_CONF_FILE=<eds>/boards/nucleo_h743zi/nucleo_h743zi.conf \
#     -DDTC_OVERLAY_FILE=<eds>/boards/nucleo_h743zi/nucleo_h743zi.overlay
#
# CODE GENERATION:
#   Generated files are placed in examples/bms_ecu/generated/ to keep them
#   separate from other examples' generated/ directories.
#   Run manually:
#     python3 tools/codegen.py \
#       --config  examples/bms_ecu/diagnostics_config.yaml \
#       --out     examples/bms_ecu/generated/ \
#       --safety-wrappers --asil-level B --test-gen
#
# DID SUMMARY (from diagnostics_config.yaml):
#   24 DIDs across 6 groups:
#     A. ECU Identity       (0xF1xx) —  4 DIDs
#     B. Pack measurements  (0xDB0x) —  5 DIDs
#     C. Cell group voltages(0xDCxx) —  4 DIDs
#     D. Temperatures       (0xDDxx) —  4 DIDs
#     E. State estimation   (0xDExx) —  3 DIDs
#     F. System health/cal  (0xD9xx) —  4 DIDs
#
# DTC SUMMARY: 10 DTCs covering cell voltage, temperature, isolation,
#   contactor, current sensor, CAN loss, and internal MCU fault.
#
# ROUTINE SUMMARY: 5 routines — SelfTest, ForcePassiveBalance,
#   ContactorFunctionalTest, ResetSoCToFullCharge, ClearFaultHistory.
#
# SPDX-License-Identifier: Apache-2.0
# =============================================================================

cmake_minimum_required(VERSION 3.20.0)

# [#414] EDS Kconfig comes from this tree, not whichever EDS module the
# workspace has. Must precede find_package(Zephyr).
include(${CMAKE_CURRENT_SOURCE_DIR}/../../cmake/eds_zephyr_module.cmake)

find_package(Zephyr REQUIRED HINTS $ENV{ZEPHYR_BASE})

project(bms_ecu
    VERSION     1.0.0
    LANGUAGES   C
    DESCRIPTION "Battery Management System ECU — Xaloqi EDS example"
)

set(CMAKE_C_STANDARD          11)
set(CMAKE_C_STANDARD_REQUIRED ON)
set(CMAKE_C_EXTENSIONS        OFF)

# ---------------------------------------------------------------------------
# Compiler flags
# ---------------------------------------------------------------------------
# [#515] -Wundef (MISRA 20.9) below applies to EDS code only: Zephyr, module and
# HAL headers are system includes for this target. See the cmake file.
include(${CMAKE_CURRENT_SOURCE_DIR}/../../cmake/eds_third_party_headers.cmake)
eds_third_party_headers_are_system(app)

target_compile_options(app PRIVATE
    -Wall -Wextra -Wshadow -Wdouble-promotion -Wundef
    -Wno-unused-parameter -Wno-sign-conversion
    -fstack-usage
)

# ---------------------------------------------------------------------------
# Paths
# ---------------------------------------------------------------------------
set(DIAG_ROOT           "${CMAKE_CURRENT_SOURCE_DIR}/../..")
set(DIAG_CONFIG_YAML    "${CMAKE_CURRENT_SOURCE_DIR}/diagnostics_config.yaml")
set(DIAG_CODEGEN_SCRIPT "${DIAG_ROOT}/tools/codegen.py")

# Generated files live in this example's own generated/ directory
# (separate from basic_ecu and ardep_ecu to allow independent configs)
set(DIAG_GENERATED_DIR  "${CMAKE_CURRENT_SOURCE_DIR}/generated")
set(CODEGEN_SENTINEL    "${DIAG_GENERATED_DIR}/generated_config.h")

# ---------------------------------------------------------------------------
# Code generation
# ---------------------------------------------------------------------------
option(DIAG_SKIP_CODEGEN
    "Skip auto-running tools/codegen.py (use pre-existing generated/ files)"
    OFF
)

if(NOT DIAG_SKIP_CODEGEN)
    find_package(Python3 COMPONENTS Interpreter QUIET)
    if(NOT Python3_FOUND)
        message(FATAL_ERROR
            "[BMS] Python3 not found. Run codegen manually:\n"
            "  python3 tools/codegen.py \\\n"
            "    --config  examples/bms_ecu/diagnostics_config.yaml \\\n"
            "    --out     examples/bms_ecu/generated/ \\\n"
            "    --safety-wrappers --asil-level B --test-gen\n"
            "Then re-configure with -DDIAG_SKIP_CODEGEN=ON\n"
        )
    endif()

    file(GLOB DIAG_TEMPLATES "${DIAG_ROOT}/tools/templates/*.j2")

    add_custom_command(
        OUTPUT   "${CODEGEN_SENTINEL}"
        COMMAND  "${Python3_EXECUTABLE}"
                 "${DIAG_CODEGEN_SCRIPT}"
                 --config "${DIAG_CONFIG_YAML}"
                 --out    "${DIAG_GENERATED_DIR}"
                 --safety-wrappers
                 --asil-level B
                 --no-manifest
        DEPENDS
            "${DIAG_CONFIG_YAML}"
            "${DIAG_CODEGEN_SCRIPT}"
            ${DIAG_TEMPLATES}
        COMMENT  "[BMS] Generating diagnostics sources..."
        VERBATIM
    )
    add_custom_target(bms_codegen DEPENDS "${CODEGEN_SENTINEL}")
else()
    message(STATUS "[BMS] DIAG_SKIP_CODEGEN=ON — using ${DIAG_GENERATED_DIR}")
endif()

# ---------------------------------------------------------------------------
# Include directories
# ---------------------------------------------------------------------------
target_include_directories(app PRIVATE
    ${DIAG_ROOT}/core
    ${DIAG_ROOT}/core/uds_services
    ${DIAG_ROOT}/transport
    ${DIAG_ROOT}/config
    ${DIAG_ROOT}/platform
    ${DIAG_ROOT}/platform/zephyr
    ${DIAG_GENERATED_DIR}
)

# ---------------------------------------------------------------------------
# Source files
# ---------------------------------------------------------------------------
# UDS service source list — set EDS_SERVICE_SRCS.
include(${DIAG_ROOT}/cmake/eds_service_sources.cmake)

target_sources(app PRIVATE
    # Application
    ${CMAKE_CURRENT_SOURCE_DIR}/src/main.c
    ${CMAKE_CURRENT_SOURCE_DIR}/src/bms_sim.c

    # UDS core
    ${DIAG_ROOT}/core/uds_server.c
    ${DIAG_ROOT}/core/uds_session.c
    ${DIAG_ROOT}/core/uds_security.c
    ${DIAG_ROOT}/core/uds_safety.c
    ${DIAG_ROOT}/core/uds_security_algo.c
    ${DIAG_ROOT}/core/uds_aes_cmac.c
    ${DIAG_ROOT}/core/uds_access_table.c
    ${DIAG_ROOT}/core/uds_comm_control.c
    ${DIAG_ROOT}/core/uds_session_stats.c
    ${DIAG_ROOT}/core/uds_security_nvm.c

    # UDS service handlers (all 16 SIDs + dispatch table).
    ${EDS_SERVICE_SRCS}
    ${DIAG_ROOT}/core/uds_transfer_ctx.c             # DFU transfer state machine
    ${DIAG_ROOT}/platform/uds_flash_ops.c            # Flash ops singleton
    ${DIAG_ROOT}/platform/uds_image_policy.c  # [#232] Image verification policy singleton

    # ISO-TP / CAN transport
    ${DIAG_ROOT}/transport/isotp.c
    ${DIAG_ROOT}/transport/can_transport.c
    ${DIAG_ROOT}/platform/zephyr/zephyr_can.c  # moved from transport/ — phase-housekeeping

    # Configuration databases
    ${DIAG_ROOT}/config/did_database.c
    ${DIAG_ROOT}/config/dtc_database.c
    ${DIAG_ROOT}/config/routine_database.c
    ${DIAG_ROOT}/config/dtc_mirror.c

    # Zephyr platform abstraction
    ${DIAG_ROOT}/platform/zephyr/zephyr_port.c
    ${DIAG_ROOT}/platform/zephyr/zephyr_mutex.c
    ${DIAG_ROOT}/platform/zephyr/zephyr_timer.c
    ${DIAG_ROOT}/platform/zephyr/zephyr_wdt.c
    ${DIAG_ROOT}/platform/zephyr/zephyr_platform_api.c  # eds_platform_* neutral interface

    # Generated sources (from diagnostics_config.yaml via codegen.py)
    ${DIAG_GENERATED_DIR}/did_handlers.c
    ${DIAG_GENERATED_DIR}/uds_init.c
    ${DIAG_GENERATED_DIR}/did_safety_wrappers.c
    ${DIAG_GENERATED_DIR}/routine_handlers.c
)

# NVM store: real Zephyr NVS on hardware, RAM mock on native_sim
if(CONFIG_BOARD_NATIVE_SIM)
    target_sources(app PRIVATE ${DIAG_ROOT}/platform/zephyr/nvm_store_mock.c)
else()
    target_sources(app PRIVATE ${DIAG_ROOT}/platform/zephyr/nvm_store.c)
endif()

if(NOT DIAG_SKIP_CODEGEN AND TARGET bms_codegen)
    add_dependencies(app bms_codegen)
endif()

# Suppress the uds_msg_buf_t _Static_assert for all Zephyr example builds.
# The Zephyr task stacks for these examples (4096-6144 bytes) are large enough
# to hold the struct if needed, but all EDS stack buffers are module-level
# statics — the assert would fire as a false positive on every compilation unit.
# Zephyr's native_sim gets this via the CMakeLists.txt native_sim block;
# hardware targets need it here.
target_compile_definitions(app PRIVATE EDS_MSG_BUF_MAX_STACK_BYTES=8192)
```

## prj.conf
```kconfig
# =============================================================================
# Xaloqi EDS
# examples/bms_ecu/prj.conf
#
# Base project configuration — applies to all board targets.
# Board-specific overrides: boards/native_sim/native_sim.conf
#
# PURPOSE: Battery Management System ECU — automotive diagnostics base config.
#
# STACK SIZE NOTE:
#   CONFIG_DIAG_TASK_STACK_SIZE is set larger than basic_ecu (4096) because
#   the BMS has 24 DIDs and 5 routines, resulting in a larger handler table
#   traversal depth and deeper call stack during state estimation callbacks.
# =============================================================================

# --- CAN driver base ---
CONFIG_CAN=y
CONFIG_CAN_INIT_PRIORITY=80
CONFIG_STATS=y

# --- Kernel / threading ---
CONFIG_MULTITHREADING=y
CONFIG_THREAD_STACK_INFO=y
CONFIG_THREAD_NAME=y

# --- Tick rate: 1 ms required for ISO-TP timer accuracy ---
CONFIG_SYS_CLOCK_TICKS_PER_SEC=1000
CONFIG_TICKLESS_KERNEL=n

# --- Watchdog ---
CONFIG_WATCHDOG=y
CONFIG_DIAG_WDT_WINDOW_MS=100

# --- Logging ---
CONFIG_LOG=y
CONFIG_LOG_DEFAULT_LEVEL=3
CONFIG_LOG_BUFFER_SIZE=2048

# --- Safety hardening ---
CONFIG_ASSERT=y
CONFIG_STACK_SENTINEL=y

# --- C library ---
CONFIG_NEWLIB_LIBC=y
# [#498] Fail the build, rather than silently link picolibc, if newlib is unavailable.
CONFIG_EDS_REQUIRE_NEWLIB=y

# --- No heap (MISRA-21.3 / EDS safety rules) ---
CONFIG_HEAP_MEM_POOL_SIZE=0

# --- UDS session timing / SecurityAccess lockout: diagnostics_config.yaml (EDS#455);
#     ISO-TP timeouts: EDS defaults, ISO 15765-2:2024 1000 ms (EDS#453) ---
# P2_server_max = 50 ms (BMS SoC estimation may take up to 30 ms)

# --- Diagnostics task stack ---
# BMS controller: 24 DIDs, 5 routines — larger than basic_ecu
CONFIG_DIAG_TASK_STACK_SIZE=6144
CONFIG_DIAG_TASK_PRIORITY=5

# --- Build output ---
CONFIG_BUILD_OUTPUT_BIN=y
CONFIG_BUILD_OUTPUT_HEX=y
```

## boards/native_sim/native_sim.overlay
```dts
/*
 * =============================================================================
 * Xaloqi EDS
 * examples/bms_ecu/boards/native_sim/native_sim.overlay
 *
 * Device Tree overlay for the native_sim (host simulation) board target.
 *
 * PURPOSE:
 *   Enables a virtual CAN controller backed by Zephyr's CAN loopback driver.
 *   This allows the full BMS diagnostics stack to run on a Linux/macOS host
 *   without real hardware, routing all CAN TX frames back to the RX path.
 *
 * SIMULATION USAGE:
 *   west build -b native_sim examples/bms_ecu \
 *     -- -DDIAG_SKIP_CODEGEN=ON \
 *     -DDTC_OVERLAY_FILE=examples/bms_ecu/boards/native_sim/native_sim.overlay
 *   ./build/zephyr/zephyr.exe
 *
 * NOTE: This overlay is identical in structure to the root boards/native_sim
 *       overlay. It is duplicated here so that the bms_ecu example can be
 *       built independently without requiring the caller to reference the
 *       root boards/ directory.
 * =============================================================================
 */

/ {
	aliases {
		/* Map the 'can0' alias used in main.c to the loopback CAN device. */
		can0 = &can_loopback0;
	};
};

/*
 * Loopback CAN controller node.
 *
 * compatible = "zephyr,can-loopback": Software loopback driver.
 * Frames sent via can_send() are immediately queued to the RX filter.
 *
 * bitrate: 500000 bps (ISO 15765-4 default for 11-bit addressing).
 */
&can_loopback0 {
	status = "okay";
	bitrate   = <500000>;
};
```

## src/main.c
```c
// SPDX-License-Identifier: Apache-2.0
// Copyright (c) 2026 Xaloqi
/*
 * =============================================================================
 * Xaloqi EDS
 * FILE: examples/bms_ecu/src/main.c
 *
 * PURPOSE: Battery Management System (BMS) ECU — application entry point.
 *
 * TARGET:  Generic automotive passenger-car BMS ECU.
 *          Tested on native_sim and nucleo_h743zi (STM32H743ZI Cortex-M7).
 *          Portable to any Zephyr-supported board with CAN peripheral.
 *
 * ECU ROLE:
 *   This example models the main controller ECU of a passenger-car BMS for
 *   a 96s Li-Ion pack (8 groups of 12 cells). The BMS is responsible for:
 *     - Cell voltage monitoring (4 group voltage DIDs, per-group aggregation)
 *     - Pack voltage and current measurement
 *     - Temperature monitoring (NTC sensors: cell stack, coolant, PCB)
 *     - State-of-Charge (SoC) and State-of-Health (SoH) estimation
 *     - Contactor control (main +/-, pre-charge) and weld detection
 *     - Passive and active cell balancing
 *     - Isolation monitoring (IMD interface)
 *     - Fault flag bitmask (quick triage DID) and DTC logging
 *
 * DIAGNOSTICS OVERVIEW:
 *   24 DIDs generated from examples/bms_ecu/diagnostics_config.yaml.
 *   All DID handlers are wrapped by the ASIL-B-oriented 5-step validation chain.
 *   10 DTCs covering all safety-relevant BMS faults.
 *   5 RoutineControl procedures: SelfTest, ForcePassiveBalance,
 *     ContactorFunctionalTest, ResetSoCToFullCharge, ClearFaultHistory.
 *   Diagnostic test suite: 24 per-DID test files + firmware integration tests.
 *   Total generated test artifacts: 31 files in generated/tests/.
 *
 * DID HANDLER PATTERN:
 *   The live DIDs are "source: app" in diagnostics_config.yaml: codegen emits
 *   no handler body and src/bms_sim.c defines did_read_<name>() /
 *   did_write_<name>() (declared in generated/did_handlers.h). The registration
 *   table and the 5-step safety wrapper call them, so session, security and
 *   length are checked before they run. The identity DIDs (0xF1xx) keep their
 *   generated default values. bms_sim.c returns fixed boot values; replace
 *   them with real sensor reads, CAN signal decoding or NVM accesses.
 *
 * THREAD MODEL:
 *   main()       — platform init → UDS init → launch diag_task → exit
 *   diag_task    — 1 ms poll loop: CAN RX → ISO-TP → UDS dispatch → CAN TX
 *
 *   The DID handlers run on diag_task, so bms_sim.c needs no lock. If you add
 *   threads that update the pack state (cell monitor IC, current sensor, NTC
 *   ADC, IMD), guard it.
 *
 * STACK BUDGET:
 *   CONFIG_DIAG_TASK_STACK_SIZE = 6144 bytes.
 *   BMS has 24 DIDs + 5 routines; increased vs. basic_ecu (4096) to
 *   accommodate the larger handler dispatch table and SoC estimation callbacks.
 *
 * BUILDING (simulation, no hardware needed):
 *   west build -b native_sim examples/bms_ecu \
 *     -- -DDIAG_SKIP_CODEGEN=ON \
 *     -DDTC_OVERLAY_FILE=examples/bms_ecu/boards/native_sim/native_sim.overlay
 *   ./build/zephyr/zephyr.exe
 *
 * SAFETY   : ASIL-B candidate (ASIL-D target for production BMS).
 * STANDARD : MISRA C:2012 alignment intended.
 * LICENSE  : Apache-2.0
 * VERSION  : 1.0.0
 * =============================================================================
 */

/* --------------------------------------------------------------------------
 * Diagnostics stack headers
 * -------------------------------------------------------------------------- */
#include "uds_types.h"
#include "uds_server.h"
#include "uds_security_algo.h"
#include "uds_periodic.h"
#include "uds_session.h"
#include "isotp.h"
#include "can_transport.h"
#include "zephyr_port.h"
#include "zephyr_mutex.h"
#include "zephyr_timer.h"
#include "zephyr_wdt.h"
#include "nvm_store.h"

/* --------------------------------------------------------------------------
 * Generated headers (from diagnostics_config.yaml via codegen.py)
 * -------------------------------------------------------------------------- */
#include "uds_init.h"
#include "generated_config.h"
#include "did_handlers.h"
#include "bms_sim.h"

/* --------------------------------------------------------------------------
 * Zephyr headers
 * -------------------------------------------------------------------------- */
#include <zephyr/kernel.h>
#include <zephyr/device.h>
#include <zephyr/drivers/can.h>
#include <zephyr/logging/log.h>

LOG_MODULE_REGISTER(bms_ecu, LOG_LEVEL_INF);

/* =============================================================================
 * Configuration
 * ============================================================================= */

#define DIAG_CAN_DEV         DEVICE_DT_GET(DT_ALIAS(can0))
#define DIAG_RX_CAN_ID       ((uint32_t)GEN_CAN_RX_ID)   /* 0x7E0, physical */
#define DIAG_TX_CAN_ID       ((uint32_t)GEN_CAN_TX_ID)   /* 0x7E8: physical    */

#ifndef CONFIG_DIAG_TASK_STACK_SIZE
#define CONFIG_DIAG_TASK_STACK_SIZE   (6144U)
#endif

#ifndef CONFIG_DIAG_TASK_PRIORITY
#define CONFIG_DIAG_TASK_PRIORITY     (5)
#endif

/* Log a warning once every N overrun events, not every tick. */
#define DIAG_OVERRUN_LOG_THRESHOLD    (3U)

/* =============================================================================
 * Diagnostics Infrastructure
 *
 * [NEW-M2 FIX] This section replaces the stale diagnostics wiring that used
 * non-existent API functions from an earlier prototype version:
 *
 *   OLD (broken):                        NEW (current API):
 *   ─────────────────────────────────    ──────────────────────────────────────
 *   zephyr_port_init(can_dev)            zephyr_port_init(&port_cfg, &can)
 *   can_transport_get_instance()         can comes from zephyr_port_init output
 *   zephyr_can_init(t, dev, rx, tx)      replaced by zephyr_port_init
 *   isotp_init(&ch, transport)           handled internally by uds_generated_init
 *   uds_generated_init(&s_isotp_ch)      uds_generated_init(can, rx_id, tx_id)
 *   uds_server_poll()                    can_transport_receive + isotp_process_rx_frame
 *                                        + uds_server_process_request
 *
 * The pattern mirrors examples/basic_ecu/src/main.c exactly.
 * All BMS application state and DID/routine handlers above are unchanged.
 * ============================================================================= */

/* ── Static allocations ────────────────────────────────────────────────────── */

K_THREAD_STACK_DEFINE(s_diag_stack, CONFIG_DIAG_TASK_STACK_SIZE);
static struct k_thread s_diag_thread;

/* UDS message buffers — file scope to avoid stack exhaustion in thread. */
static uds_msg_buf_t s_req_buf;
static uds_msg_buf_t s_resp_buf;

/* Platform objects. */
static diag_mutex_t s_session_lock;  /**< Protects uds_session_ctx_t access.  */
static diag_mutex_t s_security_lock; /**< Protects uds_security_ctx_t access. */
static diag_timer_t s_tick_timer;    /**< 1 ms periodic tick.                 */
static diag_wdt_t   s_wdt;          /**< Hardware watchdog.                  */

/* ── Zephyr TRNG callback for UDS SecurityAccess [P1-SEC] ─────────────────── */
/*
 * Guard the entropy driver header and device handle on CONFIG_ENTROPY_GENERATOR.
 * When CONFIG_ENTROPY_GENERATOR=n (native_sim CI), the LFSR fallback inside
 * uds_security_algo.c is used automatically.
 */
#if defined(CONFIG_ENTROPY_GENERATOR)
#include <zephyr/drivers/entropy.h>
static const struct device *s_entropy_dev = NULL;

static uds_status_t diag_trng_cb(uint8_t *buf, uint8_t len)
{
    if ((s_entropy_dev == NULL) || !device_is_ready(s_entropy_dev)) {
        return UDS_STATUS_ERR_PLATFORM;
    }
    int rc = entropy_get_entropy(s_entropy_dev, buf, (size_t)len);
    return (rc == 0) ? UDS_STATUS_OK : UDS_STATUS_ERR_PLATFORM;
}
#endif /* CONFIG_ENTROPY_GENERATOR */

/**
 * @brief Initialise TRNG (if available) and register callback.
 *
 * Must be called before uds_generated_init() so that the RNG callback is
 * in place before the first SID 0x27 seed request.
 */
static int diag_security_algo_init(void)
{
#if defined(CONFIG_ENTROPY_GENERATOR)
    s_entropy_dev = DEVICE_DT_GET(DT_CHOSEN(zephyr_entropy));
    if (!device_is_ready(s_entropy_dev)) {
        LOG_WRN("[BMS][P1-SEC] TRNG device not ready — using LFSR fallback (dev only)");
        s_entropy_dev = NULL;
    } else {
        uds_security_algo_set_rng_cb(diag_trng_cb);
        LOG_INF("[BMS][P1-SEC] TRNG registered: %s", s_entropy_dev->name);
    }
#else
    LOG_WRN("[BMS][P1-SEC] No zephyr_entropy DTS node — LFSR seed fallback active. "
            "Add RNG DTS node and CONFIG_ENTROPY_GENERATOR=y for production.");
#endif /* CONFIG_ENTROPY_GENERATOR */

    /*
     * OEM KEY INJECTION PLACEHOLDER — replace before production.
     * See the Security Integration Guide (Professional tier — xaloqi.com)
     * for the full key provisioning workflow.
     */
    LOG_WRN("[BMS][P1-SEC] Using compile-time placeholder AES keys. "
            "Inject OTP keys before production.");
    return 0;
}

/* ── ISO-TP RX completion callback ────────────────────────────────────────── */
/*
 * Called from diag_task_entry() when isotp_process_rx_frame() has
 * reassembled a complete UDS PDU into a contiguous buffer.
 *
 * Acquires both session and security locks, dispatches to the UDS server,
 * and transmits the response via ISO-TP.
 *
 * TIMING: Must complete within GEN_P2_SERVER_MAX_MS (25 ms).
 */
static void on_isotp_rx_complete(
    const uint8_t *data,
    uint32_t       length,
    void          *arg)
{
    uds_server_ctx_t *srv    = (uds_server_ctx_t *)arg;
    isotp_ctx_t      *tp     = uds_generated_get_isotp();
    uds_status_t      status;
    uint16_t          i;

    if ((data == NULL) || (srv == NULL) || (tp == NULL)) {
        LOG_ERR("[BMS] on_isotp_rx_complete: NULL argument — PDU dropped.");
        return;
    }

    if ((length == (uint32_t)0U) || (length > (uint32_t)UDS_MAX_PAYLOAD_LEN)) {
        LOG_WRN("[BMS] on_isotp_rx_complete: invalid length %u — PDU dropped.",
                (unsigned)length);
        return;
    }

    for (i = (uint16_t)0U; i < (uint16_t)length; i++) {
        s_req_buf.data[i] = data[i];
    }
    s_req_buf.length  = (uint16_t)length;
    s_resp_buf.length = (uint16_t)0U;

    LOG_DBG("[BMS] UDS RX: SID=0x%02X len=%u",
            (unsigned)data[0], (unsigned)length);

    (void)diag_mutex_lock(&s_session_lock);
    (void)diag_mutex_lock(&s_security_lock);
    /* [EDS-toolchain#165] A functional request (ISO 15765-4) must not draw
     * the NRCs ISO 14229-1 Table 4 says to suppress. */
    uds_addressing_t addressing = UDS_ADDRESSING_PHYSICAL;
    (void)isotp_get_rx_addressing(tp, &addressing);
    status = uds_server_process_request_ex(srv, &s_req_buf, &s_resp_buf, addressing);
    (void)diag_mutex_unlock(&s_security_lock);
    (void)diag_mutex_unlock(&s_session_lock);

    if ((status != UDS_STATUS_OK) && (s_resp_buf.length == (uint16_t)0U)) {
        LOG_ERR("[BMS] UDS server error 0x%02X — no response generated.",
                (unsigned)status);
        return;
    }

    if (s_resp_buf.length > (uint16_t)0U) {
        LOG_DBG("[BMS] UDS TX: RSID=0x%02X len=%u",
                (unsigned)s_resp_buf.data[0], (unsigned)s_resp_buf.length);
        status = isotp_transmit(tp, s_resp_buf.data, s_resp_buf.length);
        if (status != UDS_STATUS_OK) {
            LOG_ERR("[BMS] ISO-TP TX error 0x%02X", (unsigned)status);
        }
    }

    /* [P2-0x11-01] Deferred reset: response is on the wire, now reset. */
    if (srv->pending_reset_type != (uint8_t)0U) {
        uint8_t reset_type = srv->pending_reset_type;
        srv->pending_reset_type = (uint8_t)0U;
        (void)zephyr_port_nvm_flush();
        k_msleep(50);  /* Allow ISO-TP TX to reach the wire before reset (As timer). */
        (void)zephyr_port_ecu_reset(reset_type);
        /* Does not return. */
    }
}

/* ── 1 ms tick callback ────────────────────────────────────────────────────── */

typedef struct tick_ctx {
    uds_server_ctx_t *srv;
    isotp_ctx_t      *tp;
} tick_ctx_t;

static void on_tick(void *arg)
{
    tick_ctx_t *ctx = (tick_ctx_t *)arg;

    if ((ctx == NULL) || (ctx->tp == NULL) || (ctx->srv == NULL)) {
        return;
    }

    (void)isotp_tick_1ms(ctx->tp);

    (void)diag_mutex_lock(&s_session_lock);
    (void)diag_mutex_lock(&s_security_lock);
    (void)uds_server_tick_1ms(ctx->srv);
    (void)uds_periodic_tick_1ms();
    (void)diag_mutex_unlock(&s_security_lock);
    (void)diag_mutex_unlock(&s_session_lock);
}

/* =============================================================================
 * Diagnostics Task
 *
 * Runs as a dedicated Zephyr thread at CONFIG_DIAG_TASK_PRIORITY.
 * Loops at ~1 ms intervals driven by the k_timer-backed diag_timer_t.
 *
 * Each iteration:
 *   1. Wait for 1 ms tick (blocks on semaphore from timer ISR).
 *   2. Poll CAN RX queue — forward frames to ISO-TP reassembler.
 *   3. Drive ISO-TP + UDS timers via on_tick() callback.
 *   4. Feed hardware watchdog.
 *   5. Check for overruns and log if threshold exceeded.
 *
 * Thread args (p1, p2, p3) match the k_thread_create() call in main():
 *   p1 — uds_server_ctx_t *srv
 *   p2 — can_transport_t  *can
 *   p3 — isotp_ctx_t      *tp
 * ============================================================================= */
static void diag_task_entry(void *p1, void *p2, void *p3)
{
    uds_server_ctx_t *srv = (uds_server_ctx_t *)p1;
    can_transport_t  *can = (can_transport_t  *)p2;
    isotp_ctx_t      *tp  = (isotp_ctx_t      *)p3;

    uds_status_t    status;
    uds_can_frame_t rx_frame;
    bool            frame_ready;
    uint32_t        overrun_count;
    uint32_t        prev_overrun = 0U;

    tick_ctx_t tick_ctx = { .srv = srv, .tp = tp };

    LOG_INF("[BMS] Diagnostics task started (stack %u bytes, priority %d).",
            (unsigned)CONFIG_DIAG_TASK_STACK_SIZE,
            (int)CONFIG_DIAG_TASK_PRIORITY);

    /* Start 1 ms periodic timer — callback is on_tick, arg is tick_ctx. */
    if (diag_timer_start(&s_tick_timer) != UDS_STATUS_OK) {
        LOG_ERR("[BMS] Failed to start 1 ms timer — aborting diag task.");
        return;
    }

    while (true) {

        /* ── [1] Wait for 1 ms tick ──────────────────────────────────────── */
        status = diag_timer_wait_tick(&s_tick_timer, 2U);
        if (status == UDS_STATUS_ERR_TIMEOUT) {
            LOG_WRN("[BMS] 1 ms tick timeout — continuing.");
        }

        /* ── [2] CAN RX poll ─────────────────────────────────────────────── */
        /* [EDS#558] Drain every queued frame, at most the queue depth. The Flow
         * Control BlockSize keeps a burst within the RX queue only if each
         * iteration empties it; one frame per tick loses CFs of long requests. */
        frame_ready = true;
        for (uint32_t rx_n = 0U;
             frame_ready && (rx_n < (uint32_t)EDS_CAN_RX_QUEUE_DEPTH); rx_n++) {
            frame_ready = false;
            status = can_transport_receive(can, &rx_frame, &frame_ready);

            if (status != UDS_STATUS_OK) {
                if (status == UDS_STATUS_ERR_CAN_BUS_OFF) {
                    LOG_ERR("[BMS] CAN bus-off detected.");
                    /*
                     * TODO [APPLICATION]: Implement bus-off recovery.
                     * For now log and continue — WDT will reset if bus stays off.
                     */
                } else {
                    LOG_DBG("[BMS] can_transport_receive error: 0x%02X",
                            (unsigned)status);
                }
            } else if (frame_ready) {
                status = isotp_process_rx_frame(
                    tp,
                    &rx_frame,
                    on_isotp_rx_complete,
                    (void *)srv
                );
                if ((status != UDS_STATUS_OK) &&
                    (status != (uds_status_t)UDS_STATUS_ERR_TP_FRAME_INVALID)) {
                    LOG_WRN("[BMS] ISO-TP RX error: 0x%02X", (unsigned)status);
                }
            } else {
                /* No frame this iteration — idle. */
            }
        }

        /* ── [3] 1 ms tick processing (ISO-TP + UDS + periodic timers) ─── */
        on_tick(&tick_ctx);

        /* ── [3a] Drain periodic push frames due this tick ───────────────── */
        {
            static uds_msg_buf_t s_periodic_frame;
            while (uds_periodic_pop_due(&s_periodic_frame) == UDS_STATUS_OK) {
                /* [EDS#546] A periodic message is a UUDT frame on its own CAN ID
                 * (ISO 14229-3 §8.5): it bypasses the ISO-TP channel, so it can
                 * go out while a multi-frame response is being sent.
                 * [EDS#194] Re-queue if the CAN driver refuses it instead of
                 * silently dropping this period; retry on the next 1ms tick and
                 * stop draining this tick. */
                if (isotp_transmit_uudt(tp, s_periodic_frame.data,
                                   (uint32_t)s_periodic_frame.length) != UDS_STATUS_OK) {
                    (void)uds_periodic_requeue_last();
                    break;
                }
            }
        }

        /* ── [4] Watchdog feed ───────────────────────────────────────────── */
        (void)diag_wdt_feed(&s_wdt);

        /* ── [5] Overrun detection ───────────────────────────────────────── */
        (void)diag_timer_pending_ticks(&s_tick_timer, &overrun_count);
        if (overrun_count > prev_overrun) {
            uint32_t new_overruns = overrun_count - prev_overrun;
            if (new_overruns >= DIAG_OVERRUN_LOG_THRESHOLD) {
                LOG_WRN("[BMS] Poll loop overrun: %u ticks missed.",
                        (unsigned)new_overruns);
            }
            prev_overrun = overrun_count;
        }

    } /* while (true) */
}

static void s_on_session_change(uds_session_type_t old_sess,
                                uds_session_type_t new_sess)
{
    (void)old_sess;
    if (new_sess == UDS_SESSION_DEFAULT) {
        (void)uds_periodic_cancel_all();
    }
}

/* =============================================================================
 * main() — Platform + stack initialisation, then start diagnostics thread.
 *
 * main() exits after starting the diagnostics thread. The Zephyr scheduler
 * takes over and the diagnostics thread runs indefinitely.
 *
 * [NEW-M2 FIX] Replaced stale 4-step manual CAN/ISO-TP wiring with the
 * current API:
 *   1. zephyr_port_init(&port_cfg, &can)   — CAN platform + filter install
 *   2. uds_generated_init(can, rx, tx)     — full stack init (includes ISO-TP)
 *   3. uds_generated_get_server() / get_isotp() — retrieve context pointers
 *   4. Pass srv/can/tp to diagnostics thread as p1/p2/p3
 * ============================================================================= */
int main(void)
{
    uds_status_t      st;
    can_transport_t  *can  = NULL;
    uds_server_ctx_t *srv  = NULL;
    isotp_ctx_t      *tp   = NULL;
    zephyr_port_cfg_t port_cfg;

    LOG_INF("=== BMS ECU — Xaloqi EDS v1.0.0 ===");
    LOG_INF("    24 DIDs | 10 DTCs | 5 Routines | ASIL-B");

    /* --- 1. Initialise BMS application state ----------------------------- */
    bms_sim_init();
    LOG_INF("[BMS] Application state initialised.");

    /* --- 2. Platform objects init --------------------------------------- */
    if (diag_mutex_init(&s_session_lock) != UDS_STATUS_OK) {
        LOG_ERR("[BMS] Session mutex init failed.");
        return -EIO;
    }
    if (diag_mutex_init(&s_security_lock) != UDS_STATUS_OK) {
        LOG_ERR("[BMS] Security mutex init failed.");
        return -EIO;
    }

    st = diag_wdt_init(&s_wdt);
    if (st != UDS_STATUS_OK) {
        /* Non-fatal — continue without WDT for CI/simulation. */
        LOG_WRN("[BMS] WDT init returned 0x%02X (non-fatal).", (unsigned)st);
    }

    /*
     * 1 ms timer: register on_tick callback now; start is deferred to
     * the diagnostics thread after full stack init completes.
     */
    st = diag_timer_init(&s_tick_timer, on_tick, NULL);
    if (st != UDS_STATUS_OK) {
        LOG_ERR("[BMS] Timer init failed: 0x%02X", (unsigned)st);
        return -EIO;
    }

    /* --- 3. Platform + CAN transport ------------------------------------ */
    const struct device *can_dev = DIAG_CAN_DEV;
    if (!device_is_ready(can_dev)) {
        LOG_ERR("[BMS] CAN device not ready — diagnostics disabled.");
        return -EIO;
    }

    (void)memset(&port_cfg, 0, sizeof(port_cfg));
    port_cfg.can_dev        = can_dev;
    port_cfg.physical_rx_id = DIAG_RX_CAN_ID;  /* physical request ID; the
                                     * 0x7DF functional filter is always installed */

    st = zephyr_port_init(&port_cfg, &can);
    if (st != UDS_STATUS_OK) {
        LOG_ERR("[BMS] zephyr_port_init failed: 0x%02X", (unsigned)st);
        return -EIO;
    }
    LOG_INF("[BMS] CAN transport ready (device: %s).", can_dev->name);

    /* --- 3.5. NVM store initialization ------------------------------------ */
    /*
     * [EDS#200] Must run before uds_generated_init() (dtc_mirror_init() at
     * Step 3.5 sits on top of nvm_store and silently no-ops until this
     * succeeds). This example only targets native_sim, where
     * platform/zephyr/nvm_store_mock.c (RAM-backed) is linked instead of
     * the real NVS backend — its nvm_store_init() ignores cfg entirely, so
     * NULL is correct here (see nvm_store.h: "may be NULL on host").
     */
    st = nvm_store_init(NULL);
    if (st != UDS_STATUS_OK) {
        LOG_ERR("[BMS] NVM store init failed: 0x%02X — DTC mirror will not "
                "survive reset this run.", (unsigned)st);
    }

    /* --- 4. Security algorithm init ------------------------------------- */
    /*
     * Must run before uds_generated_init() so that the TRNG callback and
     * any injected OEM keys are in place before the first seed request.
     */
    (void)diag_security_algo_init();

    /* --- 5. UDS stack initialisation (generated from YAML) -------------- */
    st = uds_generated_init(can, DIAG_RX_CAN_ID, DIAG_TX_CAN_ID);
    if (st != UDS_STATUS_OK) {
        LOG_ERR("[BMS] uds_generated_init failed: 0x%02X", (unsigned)st);
        return -EIO;
    }

    srv = uds_generated_get_server();
    tp  = uds_generated_get_isotp();

    if ((srv == NULL) || (tp == NULL)) {
        LOG_ERR("[BMS] Context accessors returned NULL after init.");
        return -EIO;
    }

    (void)uds_periodic_init();
    (void)uds_session_register_change_cb(srv->cfg.session_ctx,
                                          s_on_session_change);

    LOG_INF("[BMS] UDS stack initialised. 24 DIDs / 10 DTCs registered.");
    LOG_INF("[BMS]   RX CAN: 0x%03X  TX CAN: 0x%03X",
            (unsigned)DIAG_RX_CAN_ID, (unsigned)DIAG_TX_CAN_ID);

    /* --- 6. Launch diagnostics polling task ----------------------------- */
    /*
     * Pass srv (p1), can (p2), tp (p3) as thread arguments.
     * diag_task_entry() uses these directly — no global state needed.
     */
    (void)k_thread_create(
        &s_diag_thread,
        s_diag_stack,
        K_THREAD_STACK_SIZEOF(s_diag_stack),
        diag_task_entry,
        (void *)srv,
        (void *)can,
        (void *)tp,
        CONFIG_DIAG_TASK_PRIORITY,
        (uint32_t)0U,
        K_NO_WAIT
    );
    k_thread_name_set(&s_diag_thread, "bms_diag");

    LOG_INF("[BMS] Diagnostics task launched. ECU ready for scan-tool.");

    /* main() returns — Zephyr scheduler takes over. */
    return 0;
}
```

## src/bms_sim.c
```c
// SPDX-License-Identifier: Apache-2.0
// Copyright (c) 2026 Xaloqi
/*
 * =============================================================================
 * Xaloqi EDS
 * FILE: examples/bms_ecu/src/bms_sim.c
 *
 * PURPOSE: See bms_sim.h. Encodings follow diagnostics_config.yaml; every value
 *          is big-endian, temperatures are offset by +40 degC, SoC/SoH are
 *          0.4 %/LSB.
 * =============================================================================
 */

#include "bms_sim.h"

#include <stddef.h>
#include <stdint.h>

#include "uds_types.h"
#include "did_handlers.h"

/* Boot values */
#define BMS_PACK_VOLTAGE_MV      (357120UL)  /* 8 groups x 12 cells x 3.72 V    */
#define BMS_CELL_GROUP_MV        (44640U)    /* 12 cells x 3.72 V               */
#define BMS_TEMP_25C_RAW         (65U)       /* 25 degC + 40                    */
#define BMS_SOC_50PCT_RAW        (125U)      /* 0.4 %/LSB                       */
#define BMS_SOH_100PCT_RAW       (250U)
#define BMS_FULL_CAPACITY_WH     (75000UL)
#define BMS_OV_THRESHOLD_MV      (4200U)
#define BMS_UV_THRESHOLD_MV      (2800U)

/* Write ranges for the NMC thresholds (documented in the YAML) */
#define BMS_OV_MIN_MV            (3800U)
#define BMS_OV_MAX_MV            (4350U)
#define BMS_UV_MIN_MV            (2500U)
#define BMS_UV_MAX_MV            (3200U)

static struct {
    uint32_t pack_voltage_mV;
    int16_t  pack_current_100mA;
    int16_t  pack_power_10W;
    uint8_t  contactor_state;
    uint16_t isolation_resistance_kOhm;
    uint16_t cell_group_mV[4U];
    uint8_t  temp_cell_max_raw;
    uint8_t  temp_cell_min_raw;
    uint8_t  temp_coolant_inlet_raw;
    uint8_t  temp_bms_board_raw;
    uint8_t  soc_raw;
    uint8_t  soh_raw;
    uint8_t  balancing_state;
    uint16_t fault_flags;
    uint32_t full_charge_capacity_Wh;
    uint16_t ov_threshold_mV;
    uint16_t uv_threshold_mV;
} s_bms;

void bms_sim_init(void)
{
    uint8_t i;

    s_bms.pack_voltage_mV           = BMS_PACK_VOLTAGE_MV;
    s_bms.pack_current_100mA        = 0;          /* idle                       */
    s_bms.pack_power_10W            = 0;
    s_bms.contactor_state           = 0x00U;      /* all open                   */
    s_bms.isolation_resistance_kOhm = 0xFFFFU;    /* IMD not started            */
    for (i = 0U; i < 4U; i++) {
        s_bms.cell_group_mV[i] = BMS_CELL_GROUP_MV;
    }
    s_bms.temp_cell_max_raw         = BMS_TEMP_25C_RAW;
    s_bms.temp_cell_min_raw         = BMS_TEMP_25C_RAW;
    s_bms.temp_coolant_inlet_raw    = BMS_TEMP_25C_RAW;
    s_bms.temp_bms_board_raw        = BMS_TEMP_25C_RAW;
    s_bms.soc_raw                   = BMS_SOC_50PCT_RAW;
    s_bms.soh_raw                   = BMS_SOH_100PCT_RAW;
    s_bms.balancing_state           = 0x00U;
    s_bms.fault_flags               = 0x0000U;
    s_bms.full_charge_capacity_Wh   = BMS_FULL_CAPACITY_WH;
    s_bms.ov_threshold_mV           = BMS_OV_THRESHOLD_MV;
    s_bms.uv_threshold_mV           = BMS_UV_THRESHOLD_MV;
}

/* ---------------------------------------------------------------------------
 * Encoding helpers: validate the call, then write n big-endian bytes.
 * --------------------------------------------------------------------------- */

static uds_status_t put(uint8_t *buf, uint16_t buf_len, uint16_t *out_len,
                        uint32_t v, uint16_t n)
{
    uint16_t i;

    if ((buf == NULL) || (out_len == NULL)) { return UDS_STATUS_ERR_NULL_PTR; }
    if (buf_len < n) { return UDS_STATUS_ERR_BUFFER_OVERFLOW; }
    for (i = 0U; i < n; i++) {
        buf[i] = (uint8_t)((v >> (8U * (uint32_t)(n - 1U - i))) & 0xFFU);
    }
    *out_len = n;
    return UDS_STATUS_OK;
}

/* ---------------------------------------------------------------------------
 * Pack (0xDB00-0xDB04)
 * --------------------------------------------------------------------------- */

uds_status_t did_read_bms_packvoltage_mv(uint8_t *buf, uint16_t buf_len, uint16_t *out_len)
{ return put(buf, buf_len, out_len, s_bms.pack_voltage_mV, 4U); }

uds_status_t did_read_bms_packcurrent_100ma(uint8_t *buf, uint16_t buf_len, uint16_t *out_len)
{ return put(buf, buf_len, out_len, (uint32_t)(uint16_t)s_bms.pack_current_100mA, 2U); }

uds_status_t did_read_bms_packpower_10w(uint8_t *buf, uint16_t buf_len, uint16_t *out_len)
{ return put(buf, buf_len, out_len, (uint32_t)(uint16_t)s_bms.pack_power_10W, 2U); }

uds_status_t did_read_bms_contactorstate(uint8_t *buf, uint16_t buf_len, uint16_t *out_len)
{ return put(buf, buf_len, out_len, s_bms.contactor_state, 1U); }

uds_status_t did_read_bms_insulationresistance_kohm(uint8_t *buf, uint16_t buf_len, uint16_t *out_len)
{ return put(buf, buf_len, out_len, s_bms.isolation_resistance_kOhm, 2U); }

/* ---------------------------------------------------------------------------
 * Cell groups (0xDC01-0xDC04)
 * --------------------------------------------------------------------------- */

uds_status_t did_read_bms_cellgroup1_voltage_mv(uint8_t *buf, uint16_t buf_len, uint16_t *out_len)
{ return put(buf, buf_len, out_len, s_bms.cell_group_mV[0U], 2U); }

uds_status_t did_read_bms_cellgroup2_voltage_mv(uint8_t *buf, uint16_t buf_len, uint16_t *out_len)
{ return put(buf, buf_len, out_len, s_bms.cell_group_mV[1U], 2U); }

uds_status_t did_read_bms_cellgroup3_voltage_mv(uint8_t *buf, uint16_t buf_len, uint16_t *out_len)
{ return put(buf, buf_len, out_len, s_bms.cell_group_mV[2U], 2U); }

uds_status_t did_read_bms_cellgroup4_voltage_mv(uint8_t *buf, uint16_t buf_len, uint16_t *out_len)
{ return put(buf, buf_len, out_len, s_bms.cell_group_mV[3U], 2U); }

/* ---------------------------------------------------------------------------
 * Temperatures (0xDD00-0xDD03), State (0xDE00-0xDE02)
 * --------------------------------------------------------------------------- */

uds_status_t did_read_bms_maxcelltemperature_degc(uint8_t *buf, uint16_t buf_len, uint16_t *out_len)
{ return put(buf, buf_len, out_len, s_bms.temp_cell_max_raw, 1U); }

uds_status_t did_read_bms_mincelltemperature_degc(uint8_t *buf, uint16_t buf_len, uint16_t *out_len)
{ return put(buf, buf_len, out_len, s_bms.temp_cell_min_raw, 1U); }

uds_status_t did_read_bms_coolantinlettemperature_degc(uint8_t *buf, uint16_t buf_len, uint16_t *out_len)
{ return put(buf, buf_len, out_len, s_bms.temp_coolant_inlet_raw, 1U); }

uds_status_t did_read_bms_bmsboardtemperature_degc(uint8_t *buf, uint16_t buf_len, uint16_t *out_len)
{ return put(buf, buf_len, out_len, s_bms.temp_bms_board_raw, 1U); }

uds_status_t did_read_bms_stateofcharge_04pct(uint8_t *buf, uint16_t buf_len, uint16_t *out_len)
{ return put(buf, buf_len, out_len, s_bms.soc_raw, 1U); }

uds_status_t did_read_bms_stateofhealth_04pct(uint8_t *buf, uint16_t buf_len, uint16_t *out_len)
{ return put(buf, buf_len, out_len, s_bms.soh_raw, 1U); }

uds_status_t did_read_bms_balancingstatebitmask(uint8_t *buf, uint16_t buf_len, uint16_t *out_len)
{ return put(buf, buf_len, out_len, s_bms.balancing_state, 1U); }

/* ---------------------------------------------------------------------------
 * System health (0xD900, 0xD901) and thresholds (0xD910, 0xD911, read/write)
 * --------------------------------------------------------------------------- */

uds_status_t did_read_bms_faultflagsbitmask(uint8_t *buf, uint16_t buf_len, uint16_t *out_len)
{ return put(buf, buf_len, out_len, s_bms.fault_flags, 2U); }

uds_status_t did_read_bms_fullchargecapacity_wh(uint8_t *buf, uint16_t buf_len, uint16_t *out_len)
{ return put(buf, buf_len, out_len, s_bms.full_charge_capacity_Wh, 4U); }

uds_status_t did_read_bms_ovthreshold_mv(uint8_t *buf, uint16_t buf_len, uint16_t *out_len)
{ return put(buf, buf_len, out_len, s_bms.ov_threshold_mV, 2U); }

uds_status_t did_read_bms_uvthreshold_mv(uint8_t *buf, uint16_t buf_len, uint16_t *out_len)
{ return put(buf, buf_len, out_len, s_bms.uv_threshold_mV, 2U); }

static uds_status_t write_threshold(const uint8_t *buf, uint16_t len,
                                    uint16_t min_mv, uint16_t max_mv,
                                    uint16_t *dst)
{
    uint16_t t;

    if (buf == NULL) { return UDS_STATUS_ERR_NULL_PTR; }
    if (len != 2U) { return UDS_STATUS_ERR_INVALID_PARAM; }
    t = (uint16_t)(((uint16_t)buf[0U] << 8U) | (uint16_t)buf[1U]);
    if ((t < min_mv) || (t > max_mv)) {
        return UDS_STATUS_ERR_REQUEST_OUT_OF_RANGE;
    }
    *dst = t;
    return UDS_STATUS_OK;
}

uds_status_t did_write_bms_ovthreshold_mv(const uint8_t *buf, uint16_t len)
{ return write_threshold(buf, len, BMS_OV_MIN_MV, BMS_OV_MAX_MV, &s_bms.ov_threshold_mV); }

uds_status_t did_write_bms_uvthreshold_mv(const uint8_t *buf, uint16_t len)
{ return write_threshold(buf, len, BMS_UV_MIN_MV, BMS_UV_MAX_MV, &s_bms.uv_threshold_mV); }
```

## src/bms_sim.h
```c
// SPDX-License-Identifier: Apache-2.0
// Copyright (c) 2026 Xaloqi
/*
 * =============================================================================
 * Xaloqi EDS
 * FILE: examples/bms_ecu/src/bms_sim.h
 *
 * PURPOSE: Simulated battery pack behind the live DIDs of the BMS example.
 *
 *          The DIDs 0xD900/0xD901, 0xD910/0xD911, 0xDB00-0xDB04, 0xDC01-0xDC04,
 *          0xDD00-0xDD03 and 0xDE00-0xDE02 are declared "source: app" in
 *          diagnostics_config.yaml, so codegen emits no handler body for them.
 *          This module defines their did_read_<name>() / did_write_<name>()
 *          functions (declared in generated/did_handlers.h). The identity DIDs
 *          (0xF1xx) keep their generated default values.
 *
 *          The values are fixed at boot (an idle 50 % SoC pack at 25 degC); the
 *          two thresholds can be written over UDS. There is no cell monitor,
 *          current sensor or contactor behind them: replace the reads with your
 *          measurement layer.
 *
 *          Everything runs on the diag task thread, so no lock is needed. If
 *          you add measurement threads that update the state, guard it.
 * =============================================================================
 */

#ifndef BMS_SIM_H
#define BMS_SIM_H

/** Set the boot values. Call once before the UDS server starts. */
void bms_sim_init(void);

#endif /* BMS_SIM_H */
```
