## CMakeLists.txt
```
# examples/robot_joint_controller_ecu/CMakeLists.txt
cmake_minimum_required(VERSION 3.20.0)

# [#414] EDS Kconfig comes from this tree, not whichever EDS module the
# workspace has. Must precede find_package(Zephyr).
include(${CMAKE_CURRENT_SOURCE_DIR}/../../cmake/eds_zephyr_module.cmake)

find_package(Zephyr REQUIRED HINTS $ENV{ZEPHYR_BASE})

project(robot_joint_controller_ecu
    VERSION     1.0.0
    LANGUAGES   C
    DESCRIPTION "Robot Joint Controller ECU — Xaloqi EDS robotics example"
)

set(CMAKE_C_STANDARD          11)
set(CMAKE_C_STANDARD_REQUIRED ON)
set(CMAKE_C_EXTENSIONS        OFF)

# [#515] -Wundef (MISRA 20.9) below applies to EDS code only: Zephyr, module and
# HAL headers are system includes for this target. See the cmake file.
include(${CMAKE_CURRENT_SOURCE_DIR}/../../cmake/eds_third_party_headers.cmake)
eds_third_party_headers_are_system(app)

target_compile_options(app PRIVATE
    -Wall -Wextra -Wshadow -Wdouble-promotion -Wundef
    -Wno-unused-parameter -Wno-sign-conversion
    -fstack-usage
)

set(DIAG_ROOT           "${CMAKE_CURRENT_SOURCE_DIR}/../..")
set(DIAG_CONFIG_YAML    "${CMAKE_CURRENT_SOURCE_DIR}/diagnostics_config.yaml")
set(DIAG_CODEGEN_SCRIPT "${DIAG_ROOT}/tools/codegen.py")
set(DIAG_GENERATED_DIR  "${CMAKE_CURRENT_SOURCE_DIR}/generated")
set(CODEGEN_SENTINEL    "${DIAG_GENERATED_DIR}/generated_config.h")

option(DIAG_SKIP_CODEGEN "Skip codegen (use existing generated/ files)" OFF)

if(NOT DIAG_SKIP_CODEGEN)
    find_package(Python3 COMPONENTS Interpreter QUIET)
    if(NOT Python3_FOUND)
        message(FATAL_ERROR "Python3 not found. Use -DDIAG_SKIP_CODEGEN=ON")
    endif()
    file(GLOB DIAG_TEMPLATES "${DIAG_ROOT}/tools/templates/*.j2")
    add_custom_command(
        OUTPUT   "${CODEGEN_SENTINEL}"
        COMMAND  "${Python3_EXECUTABLE}" "${DIAG_CODEGEN_SCRIPT}"
                 --config "${DIAG_CONFIG_YAML}"
                 --out    "${DIAG_GENERATED_DIR}"
                 --safety-wrappers --asil-level B --no-manifest
        DEPENDS  "${DIAG_CONFIG_YAML}" "${DIAG_CODEGEN_SCRIPT}" ${DIAG_TEMPLATES}
        COMMENT  "[robot_ecu] Generating sources..."
        VERBATIM
    )
    add_custom_target(run_codegen DEPENDS "${CODEGEN_SENTINEL}")
endif()

target_include_directories(app PRIVATE
    ${DIAG_ROOT}/core
    ${DIAG_ROOT}/core/uds_services
    ${DIAG_ROOT}/transport
    ${DIAG_ROOT}/config
    ${DIAG_ROOT}/platform
    ${DIAG_ROOT}/platform/zephyr
    ${DIAG_GENERATED_DIR}
    ${CMAKE_CURRENT_SOURCE_DIR}/src
)

# UDS service source list — set EDS_SERVICE_SRCS.
include(${DIAG_ROOT}/cmake/eds_service_sources.cmake)

target_sources(app PRIVATE
    ${CMAKE_CURRENT_SOURCE_DIR}/src/main.c
    ${CMAKE_CURRENT_SOURCE_DIR}/src/joint_sim.c

    # UDS core
    ${DIAG_ROOT}/core/uds_server.c
    ${DIAG_ROOT}/core/uds_session.c
    ${DIAG_ROOT}/core/uds_security.c
    ${DIAG_ROOT}/core/uds_safety.c
    ${DIAG_ROOT}/core/uds_security_algo.c
    ${DIAG_ROOT}/core/uds_access_table.c
    ${DIAG_ROOT}/core/uds_comm_control.c
    ${DIAG_ROOT}/core/uds_session_stats.c
    ${DIAG_ROOT}/core/uds_security_nvm.c
    ${DIAG_ROOT}/core/uds_aes_cmac.c
    ${DIAG_ROOT}/core/uds_transfer_ctx.c

    # UDS service handlers (all 16 SIDs + dispatch table).
    ${EDS_SERVICE_SRCS}

    # ISO-TP + CAN
    ${DIAG_ROOT}/transport/isotp.c
    ${DIAG_ROOT}/transport/can_transport.c
    ${DIAG_ROOT}/platform/zephyr/zephyr_can.c  # moved from transport/ — phase-housekeeping

    # Databases
    ${DIAG_ROOT}/config/did_database.c
    ${DIAG_ROOT}/config/dtc_database.c
    ${DIAG_ROOT}/config/dtc_mirror.c
    ${DIAG_ROOT}/config/routine_database.c

    # Platform
    ${DIAG_ROOT}/platform/uds_flash_ops.c
    ${DIAG_ROOT}/platform/uds_image_policy.c  # [#232] Image verification policy singleton
    ${DIAG_ROOT}/platform/zephyr/zephyr_port.c
    ${DIAG_ROOT}/platform/zephyr/zephyr_mutex.c
    ${DIAG_ROOT}/platform/zephyr/zephyr_timer.c
    ${DIAG_ROOT}/platform/zephyr/zephyr_wdt.c
    ${DIAG_ROOT}/platform/zephyr/zephyr_platform_api.c

    # Generated
    ${DIAG_GENERATED_DIR}/did_handlers.c
    ${DIAG_GENERATED_DIR}/uds_init.c
    ${DIAG_GENERATED_DIR}/did_safety_wrappers.c
    ${DIAG_GENERATED_DIR}/routine_handlers.c
)

# [EDS#580] Bench only: mark DTC 0xA00101 permanent once it is confirmed, and
# (with boards/native_sim/native_sim_bench_nvs.conf) keep the DTC mirror in
# NVS on native_sim's flash simulator, so the permanent-DTC behaviour of
# EDS#534 / #537 can be shown over a reboot. Off by default.
option(DIAG_BENCH_PERMANENT_DTC "Bench only: mark the over-temperature DTC permanent when confirmed" OFF)
if(DIAG_BENCH_PERMANENT_DTC)
    target_sources(app PRIVATE ${DIAG_ROOT}/platform/zephyr/bench_permanent_dtc.c)
    target_compile_definitions(app PRIVATE DIAG_BENCH_PERMANENT_DTC=1)
endif()

if(CONFIG_BOARD_NATIVE_SIM AND NOT (DIAG_BENCH_PERMANENT_DTC AND CONFIG_NVS))
    target_sources(app PRIVATE ${DIAG_ROOT}/platform/zephyr/nvm_store_mock.c)
else()
    target_sources(app PRIVATE ${DIAG_ROOT}/platform/zephyr/nvm_store.c)
endif()

if(NOT DIAG_SKIP_CODEGEN AND TARGET run_codegen)
    add_dependencies(app run_codegen)
endif()

# Suppress the uds_msg_buf_t _Static_assert for all Zephyr example builds.
# The Zephyr task stacks for these examples (4096-6144 bytes) are large enough
# to hold the struct if needed, but all EDS stack buffers are module-level
# statics — the assert would fire as a false positive on every compilation unit.
# Zephyr's native_sim gets this via the CMakeLists.txt native_sim block;
# hardware targets need it here.
target_compile_definitions(app PRIVATE EDS_MSG_BUF_MAX_STACK_BYTES=8192)
```

## prj.conf
```kconfig
# =============================================================================
# Xaloqi EDS
# examples/basic_ecu/prj.conf
#
# Base project configuration — applies to ALL board targets.
# Board-specific overrides live in boards/<board>/<board>.conf.
#
# FIX: Removed CONFIG_MUTEX_SPIN_ON_OWNER=n.
#   This Kconfig symbol was removed from the Zephyr kernel in Zephyr 3.x.
#   Any attempt to assign a value to an undefined symbol triggers:
#     "attempt to assign the value 'n' to the undefined symbol MUTEX_SPIN_ON_OWNER"
#   Zephyr 3.7 treats this as a fatal Kconfig error, aborting the CMake
#   configure step with "error: Aborting due to Kconfig warnings".
#   The symbol does not exist on any platform in Zephyr 3.7.
# =============================================================================

# --- CAN driver ---
CONFIG_CAN=y
CONFIG_CAN_INIT_PRIORITY=80
CONFIG_STATS=y
CONFIG_CAN_STATS=y

# --- Kernel / threading ---
CONFIG_MULTITHREADING=y
CONFIG_THREAD_STACK_INFO=y
CONFIG_THREAD_NAME=y
CONFIG_THREAD_MONITOR=y

# --- Tick rate: 1 ms required for ISO-TP timer accuracy ---
CONFIG_SYS_CLOCK_TICKS_PER_SEC=1000
CONFIG_TICKLESS_KERNEL=n

# --- Watchdog ---
CONFIG_WATCHDOG=y
CONFIG_WDT_DISABLE_AT_BOOT=n
CONFIG_DIAG_WDT_WINDOW_MS=100

# --- Logging ---
CONFIG_LOG=y
CONFIG_LOG_DEFAULT_LEVEL=3
CONFIG_LOG_BACKEND_UART=y
CONFIG_LOG_BUFFER_SIZE=2048

# --- Safety hardening ---
CONFIG_ASSERT=y
CONFIG_STACK_CANARIES=y
CONFIG_STACK_SENTINEL=y

# --- C library ---
CONFIG_NEWLIB_LIBC=y

# --- No heap (MISRA-21.3) ---
CONFIG_HEAP_MEM_POOL_SIZE=0

# --- UDS stack parameters ---
CONFIG_UDS_SESSION_S3_TIMEOUT_MS=5000

# --- Diagnostics task ---
CONFIG_DIAG_TASK_STACK_SIZE=4096
CONFIG_DIAG_TASK_PRIORITY=5

# --- Build output ---
CONFIG_BUILD_OUTPUT_BIN=y
CONFIG_BUILD_OUTPUT_HEX=y
```

## boards/native_sim/native_sim.overlay
```dts
/*
 * Xaloqi EDS — robot_joint_controller_ecu
 * boards/native_sim/native_sim.overlay
 *
 * CAN loopback for native_sim simulation.
 * No sensor aliases needed — DID handlers return stub joint state values.
 * On real hardware, replace can0 alias with your CAN peripheral node.
 */
/ {
    aliases {
        can0 = &can_loopback0;
    };
};

&can_loopback0 {
    status = "okay";
    bitrate   = <500000>;
};
```

## boards/native_sim/native_sim_socketcan.overlay
```dts
/*
 * Xaloqi EDS — robot_joint_controller_ecu
 * boards/native_sim/native_sim_socketcan.overlay
 *
 * Host-reachable variant of native_sim.overlay: the `can0` alias points at the
 * board's own `can0` node (compatible "zephyr,native-linux-can"), which opens
 * a Linux SocketCAN interface, instead of the in-process can_loopback0 that no
 * tester can reach. Use with native_sim_socketcan.conf (README, "Run it and
 * query it from the host").
 *
 * The node's host interface is "zcan0" (Zephyr's boards/native/native_sim/
 * native_sim.dts). Create that interface, or give an existing one the
 * alternate name zcan0:
 *
 *   ip link add dev zcan0 type vcan && ip link set zcan0 up
 *   ip link property add dev vcan0 altname zcan0       # existing vcan0
 */
/ {
    aliases {
        can0 = &can0;
    };
};

&can0 {
    status = "okay";
};
```

## src/main.c
```c
/*
 * =============================================================================
 * Xaloqi EDS
 * FILE: examples/robot_joint_controller_ecu/src/main.c
 *
 * PURPOSE: Robot joint controller ECU — application entry point.
 *
 *          Single-axis robot joint controller exposing live joint state
 *          (position, velocity, torque, motor temperature) and fault
 *          history over ISO 14229 UDS / ISO-TP on CAN.
 *
 *          This example demonstrates that Xaloqi EDS works identically
 *          in robotics and automotive contexts. The UDS protocol, ASIL-B
 *          safety wrappers, and YAML-driven codegen are unchanged. Only
 *          the DID handler implementations change to read from your motor
 *          controller API instead of an automotive ECU signal bus.
 *
 * INTEGRATION PATTERN:
 *
 *   Your motor controller / robot OS provides:
 *     - Joint position (encoder counts → millidegrees)
 *     - Joint velocity (rad/s or rpm)
 *     - Motor torque (Nm)
 *     - Motor temperature (°C)
 *
 *   The five live DIDs (0xA000-0xA004) are "source: app" in
 *   diagnostics_config.yaml: codegen emits no body for them and the
 *   application defines did_read_<name>(). Here src/joint_sim.c defines them
 *   over a simulated joint; on a real controller you replace that file with
 *   reads of your motor API. Nothing in generated/ is edited by hand. The
 *   UDS session management, security access, DTC persistence and ISO-TP
 *   framing are handled by Xaloqi EDS.
 *
 * SUPPORTED INTERFACES:
 *   Zephyr: motor driver API (CONFIG_MOTOR=y), ADC for temperature,
 *           encoder via QDEC driver, or custom CAN-based servo driver
 *   FreeRTOS: replace the Zephyr APIs in joint_sim.c with your vendor HAL.
 *             See examples/basic_ecu_freertos/ for FreeRTOS platform wiring.
 *
 * THREAD MODEL (same as basic_ecu):
 *   main()        → init + start diag_task → returns
 *   diag_task     → 1 ms poll loop (ISO-TP + UDS dispatch)
 *
 * SPDX-License-Identifier: Apache-2.0
 * =============================================================================
 */

#include "uds_types.h"
#include "uds_server.h"
#include "uds_periodic.h"
#include "uds_session.h"
#include "isotp.h"
#include "can_transport.h"
#include "zephyr_port.h"
#include "zephyr_mutex.h"
#include "zephyr_timer.h"
#include "zephyr_wdt.h"
#include "nvm_store.h"
#include "uds_init.h"
#include "uds_security_algo.h"
#include "generated_config.h"
#include "joint_sim.h"
#if defined(DIAG_BENCH_PERMANENT_DTC)
#include "bench_permanent_dtc.h"
#include "eds_partition.h"
#include <zephyr/drivers/flash.h>
#endif

#include <zephyr/kernel.h>
#include <zephyr/device.h>
#include <zephyr/drivers/can.h>
#include <zephyr/logging/log.h>

LOG_MODULE_REGISTER(robot_ecu, LOG_LEVEL_INF);

/* ---------------------------------------------------------------------------
 * Configuration
 * ---------------------------------------------------------------------------*/

#define DIAG_CAN_DEV            DEVICE_DT_GET(DT_ALIAS(can0))
#define DIAG_RX_CAN_ID          ((uint32_t)GEN_CAN_RX_ID)   /* 0x7E0, physical */
#define DIAG_TX_CAN_ID          ((uint32_t)GEN_CAN_TX_ID)   /* 0x7E8 */

#ifndef CONFIG_DIAG_TASK_STACK_SIZE
#define CONFIG_DIAG_TASK_STACK_SIZE  (4096U)
#endif

#ifndef CONFIG_DIAG_TASK_PRIORITY
#define CONFIG_DIAG_TASK_PRIORITY    (5)
#endif

/* ---------------------------------------------------------------------------
 * Static allocations
 * ---------------------------------------------------------------------------*/

K_THREAD_STACK_DEFINE(s_diag_stack, CONFIG_DIAG_TASK_STACK_SIZE);
static struct k_thread s_diag_thread;

static uds_msg_buf_t s_req_buf;
static uds_msg_buf_t s_resp_buf;

static diag_mutex_t s_session_lock;
static diag_mutex_t s_security_lock;
static diag_timer_t s_tick_timer;
static diag_wdt_t   s_wdt;

/* ---------------------------------------------------------------------------
 * TRNG / security init
 * ---------------------------------------------------------------------------*/

#if defined(CONFIG_ENTROPY_GENERATOR)
#include <zephyr/drivers/entropy.h>
static const struct device *s_entropy_dev = NULL;

static uds_status_t trng_cb(uint8_t *buf, uint8_t len)
{
    if ((s_entropy_dev == NULL) || !device_is_ready(s_entropy_dev)) {
        return UDS_STATUS_ERR_PLATFORM;
    }
    return (entropy_get_entropy(s_entropy_dev, buf, (size_t)len) == 0)
           ? UDS_STATUS_OK : UDS_STATUS_ERR_PLATFORM;
}
#endif

static void security_init(void)
{
#if defined(CONFIG_ENTROPY_GENERATOR)
    s_entropy_dev = DEVICE_DT_GET(DT_CHOSEN(zephyr_entropy));
    if (device_is_ready(s_entropy_dev)) {
        uds_security_algo_set_rng_cb(trng_cb);
        LOG_INF("TRNG registered: %s", s_entropy_dev->name);
    } else {
        LOG_WRN("TRNG not ready — LFSR fallback (dev/CI only).");
    }
#else
    LOG_WRN("No entropy device — LFSR fallback (dev/CI only).");
#endif
    /*
     * OEM / robot manufacturer key injection placeholder.
     * Replace with keys loaded from secure storage or provisioned at
     * manufacturing time before deploying to production hardware.
     */
    LOG_WRN("Placeholder AES keys active — inject real keys before production.");
}

/* ---------------------------------------------------------------------------
 * ISO-TP RX completion callback
 * ---------------------------------------------------------------------------*/

static void on_isotp_rx_complete(const uint8_t *data, uint32_t length, void *arg)
{
    uds_server_ctx_t *srv = (uds_server_ctx_t *)arg;
    isotp_ctx_t      *tp  = uds_generated_get_isotp();
    uds_status_t      rc;
    uint16_t          i;

    if ((data == NULL) || (srv == NULL) || (tp == NULL)) { return; }
    if ((length == 0U) || (length > (uint32_t)UDS_MAX_PAYLOAD_LEN)) { return; }

    for (i = 0U; i < (uint16_t)length; i++) { s_req_buf.data[i] = data[i]; }
    s_req_buf.length  = (uint16_t)length;
    s_resp_buf.length = 0U;

    (void)diag_mutex_lock(&s_session_lock);
    (void)diag_mutex_lock(&s_security_lock);
    /* [EDS-toolchain#165] A functional request (ISO 15765-4) must not draw
     * the NRCs ISO 14229-1 Table 4 says to suppress. */
    uds_addressing_t addressing = UDS_ADDRESSING_PHYSICAL;
    (void)isotp_get_rx_addressing(tp, &addressing);
    rc = uds_server_process_request_ex(srv, &s_req_buf, &s_resp_buf, addressing);
    (void)diag_mutex_unlock(&s_security_lock);
    (void)diag_mutex_unlock(&s_session_lock);

    if (s_resp_buf.length > 0U) {
        (void)isotp_transmit(tp, s_resp_buf.data, s_resp_buf.length);
    } else if (rc != UDS_STATUS_OK) {
        LOG_ERR("UDS error 0x%02X, no response.", (unsigned)rc);
    }

    /* [P2-0x11-01] Deferred reset: response is on the wire, now reset. */
    if (srv->pending_reset_type != (uint8_t)0U) {
        uint8_t reset_type = srv->pending_reset_type;
        srv->pending_reset_type = (uint8_t)0U;
        (void)zephyr_port_nvm_flush();
        k_msleep(50);  /* Allow ISO-TP TX to reach the wire before reset (As timer). */
        (void)zephyr_port_ecu_reset(reset_type);
        /* Does not return. */
    }
}

/* ---------------------------------------------------------------------------
 * 1 ms tick
 * ---------------------------------------------------------------------------*/

typedef struct { uds_server_ctx_t *srv; isotp_ctx_t *tp; } tick_ctx_t;

static void on_tick(void *arg)
{
    tick_ctx_t *ctx = (tick_ctx_t *)arg;
    if ((ctx == NULL) || (ctx->tp == NULL) || (ctx->srv == NULL)) { return; }
    (void)isotp_tick_1ms(ctx->tp);
    (void)diag_mutex_lock(&s_session_lock);
    (void)diag_mutex_lock(&s_security_lock);
    (void)uds_server_tick_1ms(ctx->srv);
    (void)uds_periodic_tick_1ms();
    (void)diag_mutex_unlock(&s_security_lock);
    (void)diag_mutex_unlock(&s_session_lock);
}

/* ---------------------------------------------------------------------------
 * Diagnostics task
 * ---------------------------------------------------------------------------*/

static void diag_task_entry(void *p1, void *p2, void *p3)
{
    uds_server_ctx_t *srv = (uds_server_ctx_t *)p1;
    can_transport_t  *can = (can_transport_t  *)p2;
    isotp_ctx_t      *tp  = (isotp_ctx_t      *)p3;

    uds_status_t    rc;
    uds_can_frame_t rx_frame;
    bool            frame_ready;
    tick_ctx_t      tick_ctx = { .srv = srv, .tp = tp };

    if (diag_timer_start(&s_tick_timer) != UDS_STATUS_OK) {
        LOG_ERR("Timer start failed."); return;
    }

    LOG_INF("Diagnostics task running.");

    while (true) {
        (void)diag_timer_wait_tick(&s_tick_timer, 2U);

        /* [EDS#558] Drain every queued frame, at most the queue depth. The Flow
         * Control BlockSize keeps a burst within the RX queue only if each
         * iteration empties it; one frame per tick loses CFs of long requests. */
        frame_ready = true;
        for (uint32_t rx_n = 0U;
             frame_ready && (rx_n < (uint32_t)EDS_CAN_RX_QUEUE_DEPTH); rx_n++) {
            frame_ready = false;
            rc = can_transport_receive(can, &rx_frame, &frame_ready);

            if (rc == UDS_STATUS_ERR_CAN_BUS_OFF) {
                LOG_ERR("CAN bus-off.");
            } else if ((rc == UDS_STATUS_OK) && frame_ready) {
                (void)isotp_process_rx_frame(tp, &rx_frame,
                                              on_isotp_rx_complete, (void *)srv);
            }
        }

        on_tick(&tick_ctx);

        /* Same thread as the UDS dispatch above, so joint_sim needs no lock. */
        joint_sim_step(k_uptime_get_32());
#if defined(DIAG_BENCH_PERMANENT_DTC)
        /* [EDS#580] Bench only: re-marks 0xA00101 permanent every boot. */
        bench_permanent_dtc_step(JOINT_SIM_DTC_OVERTEMP);
#endif

        {
            static uds_msg_buf_t s_periodic_frame;
            while (uds_periodic_pop_due(&s_periodic_frame) == UDS_STATUS_OK) {
                /* [EDS#546] A periodic message is a UUDT frame on its own CAN ID
                 * (ISO 14229-3 §8.5): it bypasses the ISO-TP channel, so it can
                 * go out while a multi-frame response is being sent.
                 * [EDS#194] Re-queue if the CAN driver refuses it instead of
                 * silently dropping this period; retry on the next 1ms tick and
                 * stop draining this tick. */
                if (isotp_transmit_uudt(tp, s_periodic_frame.data,
                                   (uint32_t)s_periodic_frame.length) != UDS_STATUS_OK) {
                    (void)uds_periodic_requeue_last();
                    break;
                }
            }
        }

        (void)diag_wdt_feed(&s_wdt);
    }
}

static void s_on_session_change(uds_session_type_t old_sess,
                                uds_session_type_t new_sess)
{
    (void)old_sess;
    if (new_sess == UDS_SESSION_DEFAULT) {
        (void)uds_periodic_cancel_all();
    }
}

/* ---------------------------------------------------------------------------
 * main()
 * ---------------------------------------------------------------------------*/

int main(void)
{
    uds_status_t      rc;
    can_transport_t  *can = NULL;
    uds_server_ctx_t *srv = NULL;
    isotp_ctx_t      *tp  = NULL;

    LOG_INF("=============================================================");
    LOG_INF("Xaloqi EDS  v" GEN_ECU_VERSION "  —  RobotJointController");
    LOG_INF("  DIDs: %u   DTCs: %u",
            (unsigned)GEN_DID_COUNT, (unsigned)GEN_DTC_COUNT);
    LOG_INF("  Axis 0 (simulated): position 0xA000 · velocity 0xA001 · torque 0xA002");
    LOG_INF("  Motor temperature 0xA003 exceeds 85 degC %u s after boot -> DTC 0xA00101",
            (unsigned)(JOINT_SIM_TEMP_FAULT_AT_MS / 1000U));
    LOG_INF("  Faults: 0x19 subfunction 0x02 to read active DTCs");
    LOG_INF("=============================================================");

    /* Mutex init */
    if ((diag_mutex_init(&s_session_lock)  != UDS_STATUS_OK) ||
        (diag_mutex_init(&s_security_lock) != UDS_STATUS_OK)) {
        LOG_ERR("Mutex init failed."); return -1;
    }

    /* Watchdog */
    (void)diag_wdt_init(&s_wdt);

    /* 1 ms timer */
    rc = diag_timer_init(&s_tick_timer, on_tick, NULL);
    if (rc != UDS_STATUS_OK) {
        LOG_ERR("Timer init failed: 0x%02X", (unsigned)rc); return -1;
    }

    /* CAN transport */
    const zephyr_port_cfg_t port_cfg = {
        .can_dev        = DIAG_CAN_DEV,
        .physical_rx_id = DIAG_RX_CAN_ID,   /* alongside the 0x7DF functional filter */
    };
    rc = zephyr_port_init(&port_cfg, &can);
    if (rc != UDS_STATUS_OK) {
        LOG_ERR("Platform init failed: 0x%02X", (unsigned)rc); return -1;
    }

    /* NVM store */
    /*
     * [EDS#200] Must run before uds_generated_init() (dtc_mirror_init() at
     * Step 3.5 sits on top of nvm_store and silently no-ops until this
     * succeeds). This example only targets native_sim, where
     * platform/zephyr/nvm_store_mock.c (RAM-backed) is linked instead of
     * the real NVS backend — its nvm_store_init() ignores cfg entirely, so
     * NULL is correct here (see nvm_store.h: "may be NULL on host").
     */
#if defined(DIAG_BENCH_PERMANENT_DTC) && defined(CONFIG_NVS)
    /* [EDS#580] Bench: NVS on native_sim's flash simulator (storage_partition),
     * so the DTC mirror survives a reboot. */
    {
        const struct device    *nvs_dev = EDS_PARTITION_DEVICE(storage_partition);
        const off_t              nvs_off = EDS_PARTITION_OFFSET(storage_partition);
        const size_t              nvs_sz = EDS_PARTITION_SIZE(storage_partition);
        struct flash_pages_info  page_info;

        if (flash_get_page_info_by_offs(nvs_dev, nvs_off, &page_info) != 0) {
            rc = UDS_STATUS_ERR_PLATFORM;
        } else {
            const nvm_store_cfg_t nvm_cfg = {
                .flash_dev    = (const void *)nvs_dev,
                .flash_offset = (uint32_t)nvs_off,
                .sector_size  = (uint32_t)page_info.size,
                .sector_count = (uint8_t)(nvs_sz / page_info.size),
            };

            rc = nvm_store_init(&nvm_cfg);
        }
    }
#else
    rc = nvm_store_init(NULL);
#endif
    if (rc != UDS_STATUS_OK) {
        LOG_ERR("NVM store init failed: 0x%02X — DTC mirror will not "
                "survive reset this run.", (unsigned)rc);
    }

    /* Security */
    security_init();

    /* UDS stack */
    rc = uds_generated_init(can, DIAG_RX_CAN_ID, DIAG_TX_CAN_ID);
    if (rc != UDS_STATUS_OK) {
        LOG_ERR("UDS init failed: 0x%02X", (unsigned)rc); return -1;
    }

    srv = uds_generated_get_server();
    tp  = uds_generated_get_isotp();
    if ((srv == NULL) || (tp == NULL)) {
        LOG_ERR("NULL context after init."); return -1;
    }

    (void)uds_periodic_init();
    (void)uds_session_register_change_cb(srv->cfg.session_ctx,
                                          s_on_session_change);

    LOG_INF("UDS stack ready — awaiting diagnostic requests on CAN 0x7E0 (physical) / 0x7DF (functional)");

    /* Start diagnostics thread */
    (void)k_thread_create(
        &s_diag_thread, s_diag_stack,
        K_THREAD_STACK_SIZEOF(s_diag_stack),
        diag_task_entry,
        (void *)srv, (void *)can, (void *)tp,
        CONFIG_DIAG_TASK_PRIORITY, 0U, K_NO_WAIT
    );
    k_thread_name_set(&s_diag_thread, "diag_task");

    return 0;
}
```

## src/joint_sim.c
```c
/*
 * =============================================================================
 * Xaloqi EDS
 * FILE: examples/robot_joint_controller_ecu/src/joint_sim.c
 *
 * PURPOSE: Simulated joint behind DIDs 0xA000-0xA004. See joint_sim.h.
 *
 * MODEL (all integer, no malloc, no recursion, no floating point):
 *   position    triangle wave, +/-90 deg, 20 s per cycle -> 18 deg/s
 *   velocity    +/-3.00 rpm (the slope of the position), sign follows the
 *               direction of travel
 *   torque      0.40 Nm of friction in the direction of travel,
 *               plus a load proportional to the position (0.01 Nm per 5 deg)
 *   temperature 30 degC at boot, +1 degC/s, saturating at 100 degC
 *   status      ENABLED | HOME_COMPLETE; FAULT_ACTIVE | OVERTEMP once the
 *               temperature exceeds 85 degC
 *   DTC         0xA00101 is set while the temperature exceeds 85 degC
 *
 * ENCODINGS (diagnostics_config.yaml):
 *   0xA000 int32 BE, 0.001 deg      0xA001 int16 BE, 0.01 rpm
 *   0xA002 int16 BE, 0.01 Nm        0xA003 uint8, raw = degC + 40
 *   0xA004 uint8 bitmask
 *
 * SPDX-License-Identifier: Apache-2.0
 * =============================================================================
 */

#include "joint_sim.h"

#include "did_handlers.h"
#include "dtc_database.h"
#include "uds_types.h"

#include <stdbool.h>
#include <stddef.h>

/* 0xA004 bits (diagnostics_config.yaml). */
#define STATUS_ENABLED          (0x01U)
#define STATUS_FAULT_ACTIVE     (0x04U)
#define STATUS_HOME_COMPLETE    (0x08U)
#define STATUS_OVERTEMP         (0x10U)

/* ISO 14229-1 DTC status byte of a confirmed, currently failing DTC:
 * testFailed | testFailedThisOperationCycle | confirmedDTC |
 * testFailedSinceLastClear. Bit 4 (testNotCompletedSinceLastClear) is clear:
 * the test has run. */
#define DTC_STATUS_ACTIVE_CONFIRMED  (0x2BU)

/* Re-assert the DTC at most this often while the fault condition holds. */
#define DTC_REASSERT_PERIOD_MS  (100U)

#define MDEG_PER_MS             (180000 / 10000)  /* 18 mdeg/ms = 18 deg/s */
#define VELOCITY_CRPM           (300)             /* 3.00 rpm = 18 deg/s */
#define FRICTION_CNM            (40)              /* 0.40 Nm */
#define LOAD_MDEG_PER_CNM       (500)             /* 0.01 Nm per 0.5 deg */

typedef struct {
    int32_t  position_mdeg;
    int16_t  velocity_crpm;
    int16_t  torque_cnm;
    int16_t  temp_c;
    uint8_t  status;
} joint_state_t;

static joint_state_t s_joint;
static bool          s_started   = false;
static uint32_t      s_t0_ms     = 0U;
static uint32_t      s_last_dtc_ms = 0U;
static bool          s_have_state = false;

static void put_be16(uint8_t *buf, int16_t v)
{
    const uint16_t u = (uint16_t)v;
    buf[0] = (uint8_t)(u >> 8);
    buf[1] = (uint8_t)(u & 0xFFU);
}

static void put_be32(uint8_t *buf, int32_t v)
{
    const uint32_t u = (uint32_t)v;
    buf[0] = (uint8_t)(u >> 24);
    buf[1] = (uint8_t)((u >> 16) & 0xFFU);
    buf[2] = (uint8_t)((u >> 8) & 0xFFU);
    buf[3] = (uint8_t)(u & 0xFFU);
}

static void compute_state(uint32_t t_ms)
{
    const uint32_t phase   = t_ms % JOINT_SIM_SWEEP_PERIOD_MS;
    const uint32_t half    = JOINT_SIM_SWEEP_PERIOD_MS / 2U;
    const bool     forward = (phase < half);
    const int32_t  leg_ms  = (int32_t)(forward ? phase : (phase - half));
    const uint32_t secs    = t_ms / 1000U;
    int32_t        temp;

    if (forward) {
        s_joint.position_mdeg = -JOINT_SIM_SWEEP_AMPL_MDEG + (leg_ms * MDEG_PER_MS);
        s_joint.velocity_crpm = (int16_t)VELOCITY_CRPM;
    } else {
        s_joint.position_mdeg = JOINT_SIM_SWEEP_AMPL_MDEG - (leg_ms * MDEG_PER_MS);
        s_joint.velocity_crpm = (int16_t)(-VELOCITY_CRPM);
    }

    s_joint.torque_cnm = (int16_t)((forward ? FRICTION_CNM : -FRICTION_CNM) +
                                   (s_joint.position_mdeg / LOAD_MDEG_PER_CNM));

    /* Saturate before converting: secs can be as large as 2^32 / 1000. */
    temp = (secs >= (uint32_t)(JOINT_SIM_TEMP_MAX_C - JOINT_SIM_TEMP_START_C))
           ? (int32_t)JOINT_SIM_TEMP_MAX_C
           : (JOINT_SIM_TEMP_START_C + (int32_t)secs);
    s_joint.temp_c = (int16_t)temp;

    s_joint.status = (uint8_t)(STATUS_ENABLED | STATUS_HOME_COMPLETE);
    if (s_joint.temp_c > (int16_t)JOINT_SIM_TEMP_FAULT_C) {
        s_joint.status |= (uint8_t)(STATUS_FAULT_ACTIVE | STATUS_OVERTEMP);
    }
}

void joint_sim_step(uint32_t now_ms)
{
    uint32_t t_ms;

    if (!s_started) {
        s_started     = true;
        s_t0_ms       = now_ms;
        s_last_dtc_ms = now_ms;
    }
    t_ms = now_ms - s_t0_ms;  /* unsigned: correct across the 2^32 wrap */
    compute_state(t_ms);
    s_have_state = true;

    if (((s_joint.status & STATUS_OVERTEMP) != 0U) &&
        ((now_ms - s_last_dtc_ms) >= DTC_REASSERT_PERIOD_MS)) {
        /* Same call sensor_ecu's monitor uses. Refused (and retried at the
         * next period) while ControlDTCSetting is off. */
        s_last_dtc_ms = now_ms;
        (void)dtc_database_set_status(JOINT_SIM_DTC_OVERTEMP,
                                      (uint8_t)DTC_STATUS_ACTIVE_CONFIRMED);
    }
}

/* ---------------------------------------------------------------------------
 * DID readers (declared in generated/did_handlers.h)
 *
 * Before the first joint_sim_step() the joint reads as at t = 0, which keeps
 * a request that races the first loop iteration well defined.
 * ---------------------------------------------------------------------------*/

static void ensure_state(void)
{
    if (!s_have_state) {
        compute_state(0U);
    }
}

uds_status_t did_read_axis0position(uint8_t *buf, uint16_t buf_len,
                                    uint16_t *out_len)
{
    if ((buf == NULL) || (out_len == NULL)) { return UDS_STATUS_ERR_NULL_PTR; }
    if (buf_len < 4U) { return UDS_STATUS_ERR_BUFFER_OVERFLOW; }
    ensure_state();
    put_be32(buf, s_joint.position_mdeg);
    *out_len = 4U;
    return UDS_STATUS_OK;
}

uds_status_t did_read_axis0periodicposition(uint8_t *buf, uint16_t buf_len,
                                            uint16_t *out_len)
{
    /* 0xF200: the 0x2A-subscribable alias of 0xA000. */
    return did_read_axis0position(buf, buf_len, out_len);
}

uds_status_t did_read_axis0velocity(uint8_t *buf, uint16_t buf_len,
                                    uint16_t *out_len)
{
    if ((buf == NULL) || (out_len == NULL)) { return UDS_STATUS_ERR_NULL_PTR; }
    if (buf_len < 2U) { return UDS_STATUS_ERR_BUFFER_OVERFLOW; }
    ensure_state();
    put_be16(buf, s_joint.velocity_crpm);
    *out_len = 2U;
    return UDS_STATUS_OK;
}

uds_status_t did_read_axis0torque(uint8_t *buf, uint16_t buf_len,
                                  uint16_t *out_len)
{
    if ((buf == NULL) || (out_len == NULL)) { return UDS_STATUS_ERR_NULL_PTR; }
    if (buf_len < 2U) { return UDS_STATUS_ERR_BUFFER_OVERFLOW; }
    ensure_state();
    put_be16(buf, s_joint.torque_cnm);
    *out_len = 2U;
    return UDS_STATUS_OK;
}

uds_status_t did_read_axis0motortemperature(uint8_t *buf, uint16_t buf_len,
                                            uint16_t *out_len)
{
    if ((buf == NULL) || (out_len == NULL)) { return UDS_STATUS_ERR_NULL_PTR; }
    if (buf_len < 1U) { return UDS_STATUS_ERR_BUFFER_OVERFLOW; }
    ensure_state();
    buf[0] = (uint8_t)(s_joint.temp_c + 40);
    *out_len = 1U;
    return UDS_STATUS_OK;
}

uds_status_t did_read_axis0statusbitmask(uint8_t *buf, uint16_t buf_len,
                                         uint16_t *out_len)
{
    if ((buf == NULL) || (out_len == NULL)) { return UDS_STATUS_ERR_NULL_PTR; }
    if (buf_len < 1U) { return UDS_STATUS_ERR_BUFFER_OVERFLOW; }
    ensure_state();
    buf[0] = s_joint.status;
    *out_len = 1U;
    return UDS_STATUS_OK;
}
```

## src/joint_sim.h
```c
/*
 * =============================================================================
 * Xaloqi EDS
 * FILE: examples/robot_joint_controller_ecu/src/joint_sim.h
 *
 * PURPOSE: Simulated robot joint behind the five live Axis 0 DIDs.
 *
 *          The DIDs 0xA000-0xA004 are declared "source: app" in
 *          diagnostics_config.yaml, so codegen emits no handler body for them.
 *          This module defines did_read_axis0position() and its four
 *          siblings (declared in generated/did_handlers.h) and sets the
 *          over-temperature DTC.
 *
 *          Everything is a pure function of the time since boot, so a run is
 *          reproducible. There is no physical joint, motor or encoder.
 *
 * SPDX-License-Identifier: Apache-2.0
 * =============================================================================
 */

#ifndef JOINT_SIM_H
#define JOINT_SIM_H

#include <stdint.h>

/* Sweep: triangle wave between -/+ JOINT_SIM_SWEEP_AMPL_MDEG, one full cycle
 * (out and back) per JOINT_SIM_SWEEP_PERIOD_MS. Inside the soft limits the
 * YAML gives 0xA011/0xA012 (+/-170 degrees). */
#define JOINT_SIM_SWEEP_AMPL_MDEG     (90000)
#define JOINT_SIM_SWEEP_PERIOD_MS     (20000U)

/* Motor temperature: JOINT_SIM_TEMP_START_C at boot, +1 degC per second,
 * saturating at JOINT_SIM_TEMP_MAX_C. The fault threshold is the YAML's 85 degC
 * ("above this"), first exceeded at 86 degC, 56 s after boot. */
#define JOINT_SIM_TEMP_START_C        (30)
#define JOINT_SIM_TEMP_MAX_C          (100)
#define JOINT_SIM_TEMP_FAULT_C        (85)
#define JOINT_SIM_TEMP_FAULT_AT_MS    (56000U)

/** DTC 0xA00101, Axis 0 motor over-temperature (diagnostics_config.yaml). */
#define JOINT_SIM_DTC_OVERTEMP        (0xA00101UL)

/**
 * @brief Advance the simulation to now_ms and update the DTC.
 *
 * Call from the thread that also runs the UDS dispatch (diag_task): the DID
 * readers and this function then never run concurrently, and no lock is
 * needed. The first call fixes the time origin.
 *
 * @param[in] now_ms  Monotonic milliseconds (wraps at 2^32, handled).
 */
void joint_sim_step(uint32_t now_ms);

#endif /* JOINT_SIM_H */
```
